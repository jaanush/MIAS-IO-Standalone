VERSION ""

NS_ :

BS_:
BU_: ME SC01 BMS01 BMS PT
BO_ 1617 SC18_DebugSlowMpex: 8 SC18
 SG_ FeeInitStatus_SC18 m43 : 23|16@0+ (1,0) [0|65535] ""  PT
 SG_ pressureFiltered_SC18 m22 : 47|8@0+ (0.4,0) [0|102] "psi"  PT
 SG_ shunt2IntegralAs_SC18 m46 : 23|32@0- (1,0) [-2147483648|2147483647] "As"  PT
 SG_ shunt1IntegralAs_SC18 m45 : 31|32@0- (1,0) [-2147483648|2147483647] "As"  PT
 SG_ selfTestStartupFault_SC18 m22 : 39|8@0+ (1,0) [0|255] ""  PT
 SG_ sbcARTimerStatus_SC18 m45 : 11|4@0+ (1,0) [0|15] ""  PT
 SG_ sbcARTimerValue_SC18 m45 : 23|8@0+ (1,0) [0|255] "s"  PT
 SG_ ESM_EFUSE_SAFETY_CHECK_FAIL_SC18 m21 : 41|1@0+ (1,0) [0|0] ""  PT
 SG_ ESM_EFUSE_SINGLEBIT_ERROR_SC18 m21 : 42|1@0+ (1,0) [0|0] ""  PT
 SG_ cmbVAIndex_SC18 m44 : 31|8@0+ (1,0) [0|0] ""  PT
 SG_ minVACMB_SC18 m44 : 39|16@0+ (0.0001,0) [0|6.5] "V"  PT
 SG_ maxVACMB_SC18 m44 : 55|16@0+ (0.0001,0) [0|6.5] "V"  PT
 SG_ pumpInternalFaultError_SC18 m23 : 16|1@0+ (1,0) [0|0] ""  PT
 SG_ pumpShortCircuitError_SC18 m23 : 17|1@0+ (1,0) [0|0] ""  PT
 SG_ pumpElectricError_SC18 m23 : 19|2@0+ (1,0) [0|0] ""  PT
 SG_ pumpPostRunMode_SC18 m23 : 22|3@0+ (1,0) [0|0] ""  PT
 SG_ pumpRsError_SC18 m23 : 23|1@0+ (1,0) [0|0] ""  PT
 SG_ pumpWakeUpStatus_SC18 m23 : 25|2@0+ (1,0) [0|0] ""  PT
 SG_ pumpRpmMonStat_SC18 m23 : 27|2@0+ (1,0) [0|0] ""  PT
 SG_ pumpPwmInStat_SC18 m23 : 29|2@0+ (1,0) [0|0] ""  PT
 SG_ pumpDiagTriggered_SC18 m23 : 30|1@0+ (1,0) [0|0] ""  PT
 SG_ pumpHwFault_SC18 m23 : 31|1@0+ (1,0) [0|0] ""  PT
 SG_ pumpPumpState_SC18 m23 : 34|3@0+ (1,0) [0|0] ""  PT
 SG_ pumpBlockError_SC18 m23 : 36|2@0+ (1,0) [0|0] ""  PT
 SG_ pumpLinError_SC18 m23 : 37|1@0+ (1,0) [0|0] ""  PT
 SG_ pumpDryRun_SC18 m23 : 39|2@0+ (1,0) [0|0] ""  PT
 SG_ pumpOverCurrent_SC18 m23 : 41|2@0+ (1,0) [0|0] ""  PT
 SG_ pumpVoltageDeratingError_SC18 m23 : 42|1@0+ (1,0) [0|0] ""  PT
 SG_ pumpSupVoltageError_SC18 m23 : 44|2@0+ (1,0) [0|0] ""  PT
 SG_ pumpUnderVoltage_SC18 m23 : 45|1@0+ (1,0) [0|0] ""  PT
 SG_ pumpOverVoltage_SC18 m23 : 46|1@0+ (1,0) [0|0] ""  PT
 SG_ pumpTempProtect_SC18 m23 : 47|1@0+ (1,0) [0|0] ""  PT
 SG_ pumpOverTempDeratingErr_SC18 m23 : 48|1@0+ (1,0) [0|0] ""  PT
 SG_ pumpOverTemperature_SC18 m23 : 50|2@0+ (1,0) [0|0] ""  PT
 SG_ cmbSM30MinSettleTime_SC18 m44 : 15|16@0+ (1,0) [0|65535] "ms"  PT
 SG_ cmbSM30SettleTimeFault_SC18 m32 : 42|1@0+ (1,0) [0|1] ""  PT
 SG_ pressure2_SC18 m22 : 15|8@0+ (0.4,0) [0|102] "psi"  PT
 SG_ cmbSM29ScoutTempIndex_SC18 m42 : 15|8@0+ (1,0) [0|255] ""  PT
 SG_ cmbSM19ScoutPDO_SC18 m42 : 55|16@0+ (0.0001,0) [0|6.5] "V"  PT
 SG_ cmbMaxSM15ratio_SC18 m41 : 39|16@0+ (0.00390625,0) [0|255.99609375] ""  PT
 SG_ cmbMinSM15ratio_SC18 m41 : 55|16@0+ (0.00390625,0) [0|255.99609375] ""  PT
 SG_ cmbMinSM17Ratio m42 : 39|16@0+ (0.00390625,0) [0|255.99609375] ""  PT
 SG_ cmbMaxSM17Ratio m42 : 23|16@0+ (0.00390625,0) [0|255.99609375] ""  PT
 SG_ cmbMaxSM16DiffC2S_SC18 m41 : 23|16@0+ (0.2,0) [0|13107] "mV"  PT
 SG_ isolationResInternRelaxed_SC18 m32 : 23|16@0+ (2,0) [0|130000] "kOhm"  PT
 SG_ pressureSensH2Concentr_SC18 m40 : 55|16@0+ (0.0025,0) [0|163.8375] "% H2"  PT
 SG_ pressureSensIntakePres_SC18 m40 : 39|16@0+ (0.0078125,-250) [-250|251.99] "kPa"  PT
 SG_ pressureSensIntakeTemp_SC18 m40 : 23|16@0+ (0.03125,-273) [-273|1734.96875] "C"  PT
 SG_ pressureSensRelHumidity_SC18 m40 : 15|8@0+ (0.4,0) [0|100] "%"  PT
 SG_ isolationSelftestMaxDiff_SC18 m32 : 39|8@0+ (0.1,0) [0|25.5] "V"  PT
 SG_ FEESector2Flags_SC18 m22 : 23|16@0+ (1,0) [0|0] ""  PT
 SG_ appTask500HzMaxAvg_SC18 m41 : 15|8@0+ (0.02,0) [0|5.1] "ms"  PT
 SG_ safetyHangLastLinkReg_SC18 m39 : 23|32@0+ (1,0) [0|4294967295] ""  PT
 SG_ safetyHangPresentLinkReg_SC18 m38 : 23|32@0+ (1,0) [0|4294967295] ""  PT
 SG_ safetyHangDataFaultStatus_SC18 m37 : 23|32@0+ (1,0) [0|4294967295] ""  PT
 SG_ safetyHangDataFaultAddr_SC18 m36 : 23|32@0+ (1,0) [0|4294967295] ""  PT
 SG_ safetyHangLastARMMode_SC18 m35 : 63|8@0+ (1,0) [0|255] ""  PT
 SG_ safetyHangPresARMMode_SC18 m35 : 55|8@0+ (1,0) [0|255] ""  PT
 SG_ safetyHangESMGrp3Reg_SC18 m35 : 23|32@0+ (1,0) [0|4294967295] ""  PT
 SG_ safetyHangInstrFaultStatus_SC18 m34 : 23|32@0+ (1,0) [0|4294967295] ""  PT
 SG_ safetyHangInstrFaultAddr_SC18 m33 : 23|32@0+ (1,0) [0|4294967295] ""  PT
 SG_ pressure_SC18 m4 : 63|8@0+ (0.4,0) [0|102] "psi"  PT
 SG_ cmbMaxSM33Diff_SC18 m31 : 15|8@0+ (0.001,0) [0|0.255] "V"  PT
 SG_ cmbMinSM29Diff_SC18 m17 : 15|8@0+ (0.001,0) [0|0.255] "V"  PT
 SG_ cmbSM4MinIndex_SC18 m24 : 15|8@0+ (1,0) [0|0] ""  PT
 SG_ cmbSM4DiffC2_SC18 m31 : 23|16@0+ (0.0001,0) [0|6.5] "V"  PT
 SG_ cmbMinSM4Diff_SC18 m31 : 39|16@0+ (0.0001,0) [0|6.5] "V"  PT
 SG_ cmbMaxSM4Diff_SC18 m21 : 55|16@0+ (0.0001,0) [0|6.5] "V"  PT
 SG_ cmbSM27MinIndex_SC18 m15 : 63|8@0+ (1,0) [0|0] ""  PT
 SG_ cmbSM27DiffC2_SC18 m24 : 55|16@0+ (0.0001,0) [0|6.5] "V"  PT
 SG_ cmbMinSM27Diff_SC18 m31 : 55|16@0+ (0.0001,0) [0|6.5] "V"  PT
 SG_ cmbMaxSM27Diff_SC18 m25 : 55|16@0+ (0.0001,0) [0|6.5] "V"  PT
 SG_ adcDriverFail_SC18 m4 : 51|4@0+ (1,0) [0|0] ""  PT
 SG_ mainUcHvilState_SC18 m32 : 41|2@0+ (1,0) [0|0] ""  PT
 SG_ mainUcIntIsoErr_SC18 m32 : 13|2@0+ (1,0) [0|0] ""  PT
 SG_ mainUcExtIsoErr_SC18 m32 : 15|2@0+ (1,0) [0|0] ""  PT
 SG_ safetyUcThermalStatus_SC18 m32 : 9|2@0+ (1,0) [0|0] ""  PT
 SG_ mainUcThermalStatus_SC18 m32 : 11|2@0+ (1,0) [0|0] ""  PT
 SG_ selfTestErrorAddress_SC18 m30 : 23|32@0+ (1,0) [0|4294967295] ""  PT
 SG_ selfTestDataFaultStatus_SC18 m29 : 23|32@0+ (1,0) [0|4294967295] ""  PT
 SG_ selfTestInstrFaultAddr_SC18 m28 : 23|32@0+ (1,0) [0|4294967295] ""  PT
 SG_ selfTestDataFaultAddr_SC18 m27 : 23|32@0+ (1,0) [0|4294967295] ""  PT
 SG_ selfTestInstrFaultStatus_SC18 m26 : 23|32@0+ (1,0) [0|4294967295] ""  PT
 SG_ internalIsolationError_SC18 m25 : 11|2@0+ (1,0) [0|0] ""  PT
 SG_ externalIsolationError_SC18 m25 : 13|2@0+ (1,0) [0|0] ""  PT
 SG_ isolationTestState_SC18 m25 : 9|2@0+ (1,0) [0|0] ""  PT
 SG_ isolationResistanceIntern_SC18 m25 : 23|16@0+ (2,0) [0|130000] "kOhm"  PT
 SG_ isolationResistanceExtern_SC18 m25 : 39|16@0+ (2,0) [0|130000] "kOhm"  PT
 SG_ maxAdolV13Diff_SC18 m24 : 23|16@0+ (0.0001,0) [0|6.5] "V"  PT
 SG_ maxAdolV7Diff_SC18 m24 : 39|16@0+ (0.0001,0) [0|6.5] "V"  PT
 SG_ pumpType_SC18 m23 : 15|8@0+ (1,0) [0|0] ""  PT
 SG_ pumpPhaseCurrent_SC18 m18 : 47|8@0+ (0.1,0) [0|0] "A"  PT
 SG_ hvWithstandTestQual_SC18 m21 : 15|8@0+ (1,0) [0|255] ""  PT
 SG_ ESM_RAM_ODD_ADDR_UNCORR_SC18 m21 : 18|1@0+ (1,0) [0|0] ""  PT
 SG_ ESM_RAM_EVEN_ADDR_UNCORR_SC18 m21 : 17|1@0+ (1,0) [0|0] ""  PT
 SG_ ESM_FMC_UNCORR_ERR_SC18 m21 : 40|1@0+ (1,0) [0|0] ""  PT
 SG_ ESM_RAM_ODDECC_UNCORR_SC18 m21 : 23|1@0+ (1,0) [0|0] ""  PT
 SG_ ESM_RAM_EVENECC_UNCORR_SC18 m21 : 22|1@0+ (1,0) [0|0] ""  PT
 SG_ ESM_EFUSE_FARM_ERR_SC18 m21 : 21|1@0+ (1,0) [0|0] ""  PT
 SG_ ESM_RTI_WWD_NMI_SC18 m21 : 20|1@0+ (1,0) [0|0] ""  PT
 SG_ ESM_TCM_ECC_LIVE_LOCK_SC18 m21 : 19|1@0+ (1,0) [0|0] ""  PT
 SG_ ESM_RAM_ODD_UNCORR_ERR_SC18 m21 : 16|1@0+ (1,0) [0|0] ""  PT
 SG_ ESM_RAM_EVEN_UNCORR_ERR_SC18 m21 : 31|1@0+ (1,0) [0|0] ""  PT
 SG_ ESM_FMC_ADDR_UNCORR_ERR_SC18 m21 : 30|1@0+ (1,0) [0|0] ""  PT
 SG_ ESM_CCM4_COMPARE_FAULT_SC18 m21 : 29|1@0+ (1,0) [0|0] ""  PT
 SG_ ESM_RAM_ODD_CORR_ERR_SC18 m21 : 28|1@0+ (1,0) [0|0] ""  PT
 SG_ ESM_RAM_EVEN_CORR_ERR_SC18 m21 : 27|1@0+ (1,0) [0|0] ""  PT
 SG_ ESM_CLK_MONITOR_SC18 m21 : 26|1@0+ (1,0) [0|0] ""  PT
 SG_ ESM_PLL_SLIP_SC18 m21 : 25|1@0+ (1,0) [0|0] ""  PT
 SG_ ESM_FMC_CORR_ERR_SC18 m21 : 24|1@0+ (1,0) [0|0] ""  PT
 SG_ analogMMCUSleepTrigger_SC18 m20 : 55|8@0+ (0.015,0) [0|0] "V"  PT
 SG_ analogPyroLSDStatus_SC18 m20 : 63|8@0+ (0.015,0) [0|0] "V"  PT
 SG_ analogGPIO2Volt_SC18 m19 : 47|8@0+ (0.1,0) [0|25] "V"  PT
 SG_ analogGPIO2Current_SC18 m19 : 55|8@0+ (0.015,0) [0|3.825] "A"  PT
 SG_ analogGPIO1Volt_SC18 m19 : 63|8@0+ (0.1,0) [0|25] "V"  PT
 SG_ analogGPIO1Current_SC18 m20 : 15|8@0+ (0.015,0) [0|3.825] "A"  PT
 SG_ currentModuleMax_SC18 m1 : 55|16@0+ (0.1,-3200) [-3200|3200] "A"  PT
 SG_ currentModuleMin_SC18 m1 : 39|16@0+ (0.1,-3200) [-3200|3200] "A"  PT
 SG_ cmbSumOfCellSTATRef_SC18 m20 : 39|16@0+ (0.0015,0) [0|131.07] "V"  PT
 SG_ cmbSumOfCells_SC18 m20 : 23|16@0+ (0.0015,0) [0|131.07] "V"  PT
 SG_ maxCMBDieTemp_SC18 m1 : 31|8@0+ (1,-40) [-40|200] "C"  PT
 SG_ minCMBDieTemp_SC18 m1 : 23|8@0+ (1,-40) [-40|200] "C"  PT
 SG_ appTaskSpiRxTx_SC18 m16 : 15|8@0+ (0.02,0) [0|5.1] "ms"  PT
 SG_ variantCodingCounts_SC18 m4 : 39|8@0+ (1,0) [0|0] ""  PT
 SG_ cmbMaxUpdateTime_SC18 m17 : 23|8@0+ (2,0) [0|500] "ms"  PT
 SG_ pumpSetSpeed_SC18 m18 : 55|8@0+ (1,0) [0|255] "PCT"  PT
 SG_ hvilResistance_SC18 m17 : 31|8@0+ (2,0) [0|0] "Ohm"  PT
 SG_ cmbAvgUpdateTime_SC18 m18 : 63|8@0+ (2,0) [0|500] "ms"  PT
 SG_ pumpTemperature_SC18 m18 : 39|8@0+ (1,-50) [0|0] "C"  PT
 SG_ pumpSpeed_SC18 m18 : 15|8@0+ (1,0) [0|255] "PCT"  PT
 SG_ pumpVoltage_SC18 m18 : 23|8@0+ (0.1,0) [0|0] "V"  PT
 SG_ pumpCurrent_SC18 m18 : 31|8@0+ (0.1,0) [0|0] "A"  PT
 SG_ posLink3_SC18 m17 : 39|16@0+ (0.04,-1250) [-1250|1371.4] "V"  PT
 SG_ negLink3_SC18 m17 : 55|16@0+ (0.04,-1250) [-1250|1371.4] "V"  PT
 SG_ posLink2_SC18 m16 : 39|16@0+ (0.04,-1250) [-1250|1371.4] "V"  PT
 SG_ negLink2_SC18 m16 : 55|16@0+ (0.04,-1250) [-1250|1371.4] "V"  PT
 SG_ cmbNrOfSamples_SC18 m16 : 23|8@0+ (1,0) [0|0] ""  PT
 SG_ cmbTaskTime_SC18 m16 : 31|8@0+ (1,0) [0|0] "ms"  PT
 SG_ appTask500HzMax_SC18 m15 : 15|8@0+ (0.02,0) [0|5.1] "ms"  PT
 SG_ moduleCount_SC18 m6 : 15|8@0+ (1,0) [0|0] ""  PT
 SG_ analogHallSense_SC18 m15 : 23|16@0+ (0.0001,0) [0|6.5535] "V"  PT
 SG_ cmbMaxDiagStepPeriodicity_SC18 m15 : 55|8@0+ (4,0) [0|1019] "ms"  PT
 SG_ minBrickVoltageLimit_SC18 m15 : 39|16@0+ (0.0001,0) [0|6.5535] "V"  PT
 SG_ appTask100Hz_SC18 m14 : 63|8@0+ (0.02,0) [0|5.1] "ms"  PT
 SG_ appTask10Hz_SC18 m14 : 55|8@0+ (0.02,0) [0|5.1] "ms"  PT
 SG_ appTaskAnalog_SC18 m14 : 47|8@0+ (0.02,0) [0|5.1] "ms"  PT
 SG_ appTaskADC_SC18 m14 : 39|8@0+ (0.02,0) [0|5.1] "ms"  PT
 SG_ appTask500HzAvg_SC18 m14 : 31|8@0+ (0.02,0) [0|5.1] "ms"  PT
 SG_ appTaskSBC_SC18 m14 : 23|8@0+ (0.02,0) [0|5.1] "ms"  PT
 SG_ appTaskCMBDriver_SC18 m14 : 15|8@0+ (0.02,0) [0|5.1] "ms"  PT
 SG_ safetyInitTime_SC18 m12 : 15|8@0+ (2,0) [0|500] "ms"  PT
 SG_ debugSlowMpex_SC18 M : 7|8@0+ (1,0) [0|0] ""  PT
 SG_ sbcWUAuto_SC18 m11 : 9|1@0+ (1,0) [0|0] ""  PT
 SG_ sbcWUUnknown_SC18 m11 : 8|1@0+ (1,0) [0|0] ""  PT
 SG_ sbcWUDebug_SC18 m11 : 10|1@0+ (1,0) [0|0] ""  PT
 SG_ sbcWUPOR_SC18 m11 : 11|1@0+ (1,0) [0|0] ""  PT
 SG_ sbcWUPressure_SC18 m11 : 12|1@0+ (1,0) [0|0] ""  PT
 SG_ sbcWUClock_SC18 m11 : 13|1@0+ (1,0) [0|0] ""  PT
 SG_ sbcWUCAN_SC18 m11 : 14|1@0+ (1,0) [0|0] ""  PT
 SG_ sbcWUKey_SC18 m11 : 15|1@0+ (1,0) [0|0] ""  PT
 SG_ mux960N3VRef_SC18 m13 : 39|16@0+ (-0.000805664,0) [0|0] "V"  PT
 SG_ mux960P2P5VRef_SC18 m13 : 55|16@0+ (0.000805664,0) [0|0] "V"  PT
 SG_ mux440Gnd_SC18 m10 : 15|8@0+ (0.000805664,0) [0|0] "V"  PT
 SG_ analogHallGain_SC18 m13 : 23|16@0+ (1E-005,0.8) [0.8|1.455] "k"  PT
 SG_ analogHallOffset_SC18 m13 : 15|8@0+ (0.0001,-0.005) [-0.005|0.0205] "V"  PT
 SG_ negPackPrime_SC18 m12 : 55|16@0+ (0.04,-1250) [-1250|1250] "V"  PT
 SG_ posPackPrime_SC18 m12 : 39|16@0+ (0.04,-1250) [-1250|1250] "V"  PT
 SG_ packVoltage_SC18 m12 : 23|16@0+ (0.04,-1250) [-1250|1250] "V"  PT
 SG_ sleepTime_SC18 m11 : 23|16@0+ (1,0) [0|0] "s"  PT
 SG_ analogNegHVOffset_SC18 m10 : 63|8@0+ (1,-120) [-120|120] "Bits"  PT
 SG_ analogPosHVOffset_SC18 m10 : 55|8@0+ (1,-120) [-120|120] "Bits"  PT
 SG_ analogNegHVGain_SC18 m10 : 39|16@0+ (1E-005,0.8) [0|0] "k"  PT
 SG_ analogPosHVGain_SC18 m10 : 23|16@0+ (1E-005,0.8) [0.8|1.45535] "k"  PT
 SG_ mux910Gnd_SC18 m8 : 15|8@0+ (0.000805664,0) [0|0] "V"  PT
 SG_ mux960Gnd_SC18 m9 : 15|8@0+ (0.000805664,0) [0|0] "V"  PT
 SG_ analogAddr5_SC18 m9 : 55|16@0+ (0.000805861,0) [0|0] "V"  PT
 SG_ analogAddr4_SC18 m9 : 39|16@0+ (0.000805861,0) [0|0] "V"  PT
 SG_ analogAddr3_SC18 m9 : 23|16@0+ (0.000805861,0) [0|0] "V"  PT
 SG_ analogAddr2_SC18 m8 : 55|16@0+ (0.000805861,0) [0|0] "V"  PT
 SG_ analogAddr1_SC18 m8 : 39|16@0+ (0.000805861,0) [0|0] "V"  PT
 SG_ analogAddr0_SC18 m8 : 23|16@0+ (0.000805861,0) [0|0] "V"  PT
 SG_ sbcVREF2P5_SC18 m7 : 15|8@0+ (0.003222656,2.25) [2.25|3.0715] "V"  PT
 SG_ mux910N3VRef_SC18 m7 : 39|16@0+ (-0.000805664,0) [0|0] "V"  PT
 SG_ mux910P2P5VRef_SC18 m7 : 55|16@0+ (0.000805664,0) [0|0] "V"  PT
 SG_ analogHvilCurrentPWM_SC18 m3 : 31|8@0+ (1,0) [0|255] "mA"  PT
 SG_ analogSBCSupply_SC18 m4 : 47|8@0+ (0.1,0) [0|25] "V"  PT
 SG_ analogHvilCurrent_SC18 m3 : 23|8@0+ (1,0) [0|255] "mA"  PT
 SG_ analogPressureSense_SC18 m4 : 23|8@0+ (0.025,0) [0|6.375] "V"  PT
 SG_ analog5VSensorSupply_SC18 m4 : 15|8@0+ (0.025,0) [0|6.375] "V"  PT
 SG_ analogPrechgRel2CoilMinus_SC18 m2 : 23|8@0+ (0.2,0) [0|51] "V"  PT
 SG_ analogPrechgRel1CoilMinus_SC18 m3 : 55|8@0+ (0.2,0) [0|51] "V"  PT
 SG_ analogNegCntr3CoilMinus_SC18 m2 : 31|8@0+ (0.2,0) [0|51] "V"  PT
 SG_ analogNegCntr2CoilMinus_SC18 m2 : 39|8@0+ (0.2,0) [0|51] "V"  PT
 SG_ analogNegCntr1CoilMinus_SC18 m2 : 47|8@0+ (0.2,0) [0|51] "V"  PT
 SG_ analogPosCntr3CoilMinus_SC18 m2 : 55|8@0+ (0.2,0) [0|51] "V"  PT
 SG_ analogPosCntr2CoilMinus_SC18 m2 : 63|8@0+ (0.2,0) [0|51] "V"  PT
 SG_ analogPosCntr1CoilMinus_SC18 m3 : 15|8@0+ (0.2,0) [0|51] "V"  PT
 SG_ minModuleTemperature_SC18 m1 : 15|8@0+ (1,-40) [-40|200] "C"  PT
 SG_ maxModuleTemperature_SC18 m2 : 15|8@0+ (1,-40) [-40|200] "C"  PT
 SG_ analogHvilReturn_SC18 m3 : 39|8@0+ (0.1,0) [0|25] "V"  PT
 SG_ analog5VDSupply_SC18 m3 : 47|8@0+ (0.025,0) [0|6.375] "V"  PT
 SG_ analogHvilOut_SC18 m3 : 63|8@0+ (0.1,0) [0|25] "V"  PT
 SG_ analogCurrentSensor12V_SC18 m4 : 31|8@0+ (0.075,0) [0|19] "V"  PT
 SG_ cmbErrorCounter_SC18 m6 : 47|8@0+ (1,0) [0|255] ""  PT
 SG_ PECErrorCounter_SC18 m6 : 39|8@0+ (1,0) [0|255] ""  PT
 SG_ maxVREF2_SC18 m7 : 23|16@0+ (0.0001,0) [0|6.5] "V"  PT
 SG_ minVREF2_SC18 m6 : 55|16@0+ (0.0001,0) [0|6.5] "V"  PT
 SG_ currentPlausiCounter_SC18 m5 : 15|8@0+ (1,0) [0|0] ""  PT
 SG_ hallCurrentOffset_SC18 m5 : 39|16@0+ (0.001,-30) [-30|30] "A"  PT
 SG_ sumOfCurrentsFiltered_SC18 m5 : 23|16@0+ (0.1,-3200) [-3200|3353.5] "A"  PT
 SG_ hallCurrentAveraged_SC18 m5 : 55|16@0+ (0.1,-3200) [-3200|3200] "A"  PT
 SG_ analogHallSupply_SC18 m6 : 23|16@0+ (0.0005,0) [0|32.7675] "V"  PT
 SG_ SWVersion_SC18 m11 : 39|32@0+ (1,0) [0|4294967295] ""  PT
 SG_ contactorControlPos1_SC18 m19 : 23|4@0+ (1,0) [0|7] ""  PT
 SG_ contactorControlNeg1_SC18 m19 : 19|4@0+ (1,0) [0|7] ""  PT
 SG_ contactorControlPre1_SC18 m19 : 11|4@0+ (1,0) [0|7] ""  PT
 SG_ contactorControlPos2_SC18 m19 : 31|4@0+ (1,0) [0|7] ""  PT
 SG_ contactorControlNeg2_SC18 m19 : 27|4@0+ (1,0) [0|7] ""  PT
 SG_ contactorControlPre2_SC18 m19 : 15|4@0+ (1,0) [0|7] ""  PT
 SG_ contactorControlPos3_SC18 m19 : 39|4@0+ (1,0) [0|7] ""  PT
 SG_ contactorControlNeg3_SC18 m19 : 35|4@0+ (1,0) [0|7] ""  PT

BO_ 1681 SC18_DebugFastMpex: 8 SC18
 SG_ selfTestFaultCntrCtrl_SC18 m11 : 23|8@0+ (1,0) [0|0] ""  PT
 SG_ cmbASICFault_SC18 m11 : 15|8@0+ (1,0) [0|0] ""  PT
 SG_ DIGIO_PYRO_LSD_EN_SC18 m2 : 12|1@0+ (1,0) [0|0] ""  PT
 SG_ mainUcExtIsoResistance_SC18 m10 : 55|16@0+ (1,0) [0|0] "KOhm"  PT
 SG_ BMS_C38_AR2MsgFault_SC18 m10 : 47|2@0+ (1,0) [0|0] ""  PT
 SG_ stateCoolant_SC18 m10 : 45|1@0+ (1,0) [0|0] ""  PT
 SG_ stateThermalEvent_SC18 m10 : 44|1@0+ (1,0) [0|0] ""  PT
 SG_ stateCANTx_SC18 m10 : 43|1@0+ (1,0) [0|0] ""  PT
 SG_ CANTxFaultTriggerFailed_SC18 m10 : 42|1@0+ (1,0) [0|0] ""  PT
 SG_ CANTxBMS1ST3MsgFault_SC18 m10 : 10|1@0+ (1,0) [0|0] ""  PT
 SG_ CANTxBMSDispReqMsgFault_SC18 m10 : 9|1@0+ (1,0) [0|0] ""  PT
 SG_ CANTxHVBatMsgFault_SC18 m10 : 8|1@0+ (1,0) [0|0] ""  PT
 SG_ mainUcCntrCtrlReq_SC18 m10 : 41|2@0+ (1,0) [0|0] ""  PT
 SG_ mainUcCntrWeldState_SC18 m10 : 39|4@0+ (1,0) [0|0] ""  PT
 SG_ safetyUcCntrState_SC18 m10 : 33|2@0+ (1,0) [0|0] ""  PT
 SG_ mainUcCntrState_SC18 m10 : 35|2@0+ (1,0) [0|0] ""  PT
 SG_ safetyCANMsg4Fault_SC18 m10 : 31|4@0+ (1,0) [0|0] ""  PT
 SG_ safetyCANMsg3Fault_SC18 m10 : 27|4@0+ (1,0) [0|0] ""  PT
 SG_ safetyCANMsg2Fault_SC18 m10 : 23|4@0+ (1,0) [0|0] ""  PT
 SG_ safetyCANMsg1Fault_SC18 m10 : 19|4@0+ (1,0) [0|0] ""  PT
 SG_ cmbBalancingDesired_SC18 m10 : 15|1@0+ (1,0) [0|0] ""  PT
 SG_ DIGIO_GPIO1_ON_SC18 m2 : 10|1@0+ (1,0) [0|0] ""  PT
 SG_ DIGIO_ZDW_LSD_EN_SC18 m2 : 11|1@0+ (1,0) [0|0] ""  PT
 SG_ currentShortCircuit_SC18 m2 : 9|1@0+ (1,0) [0|0] ""  PT
 SG_ contactorCntrSelfTest_SC18 m10 : 14|4@0+ (1,0) [0|15] ""  PT
 SG_ maxBrickVoltage_SC18 m11 : 39|16@0+ (0.0001,0) [0|6.5] "V"  PT
 SG_ minBrickVoltage_SC18 m11 : 55|16@0+ (0.0001,0) [0|6.5] "V"  PT
 SG_ cmbLastUpdateTime_SC18 m0 : 55|8@0+ (2,0) [0|500] "ms"  PT
 SG_ weldCheckState_SC18 m2 : 15|3@0+ (1,0) [0|0] ""  PT
 SG_ debugFastMpex_SC18 M : 7|8@0+ (1,0) [0|0] ""  PT
 SG_ SPIRxTxTimeAllPckts_SC18 m0 : 63|8@0+ (2,0) [0|500] "ms"  PT
 SG_ sleepRqASW_SC18 m2 : 8|1@0+ (1,0) [0|0] ""  PT
 SG_ prechgCtr1OnReqASW_SC18 m1 : 27|1@0+ (1,0) [0|0] ""  PT
 SG_ negCtr1OnReqASW_SC18 m1 : 25|1@0+ (1,0) [0|0] ""  PT
 SG_ posCtr1OnReqASW_SC18 m1 : 26|1@0+ (1,0) [0|0] ""  PT
 SG_ key_SC18 m1 : 24|1@0+ (1,0) [0|0] ""  PT
 SG_ stateContactorControl_SC18 m0 : 41|1@0+ (1,0) [0|0] ""  PT
 SG_ DIGIO_MULTIPLEX_m101_S3_SC18 m0 : 40|1@0+ (1,0) [0|0] ""  PT
 SG_ analogCntrPwrPlus_SC18 m1 : 15|8@0+ (0.2,0) [0|50] "V"  PT
 SG_ weldedState_SC18 m11 : 25|2@0+ (1,0) [0|3] ""  PT
 SG_ stateVoltage_SC18 m0 : 43|1@0+ (1,0) [0|0] ""  PT
 SG_ stateTemperature_SC18 m0 : 44|1@0+ (1,0) [0|0] ""  PT
 SG_ stateSelfTest_SC18 m0 : 45|1@0+ (1,0) [0|0] ""  PT
 SG_ stateHVIL_SC18 m0 : 46|1@0+ (1,0) [0|0] ""  PT
 SG_ stateCurrent_SC18 m0 : 47|1@0+ (1,0) [0|0] ""  PT
 SG_ stateCrash2_SC18 m0 : 36|1@0+ (1,0) [0|0] ""  PT
 SG_ stateCrash1_SC18 m0 : 37|1@0+ (1,0) [0|0] ""  PT
 SG_ stateContactors_SC18 m0 : 38|1@0+ (1,0) [0|0] ""  PT
 SG_ stateCANRx_SC18 m0 : 39|1@0+ (1,0) [0|0] ""  PT
 SG_ itemState_SC18 m0 : 35|4@0+ (1,0) [0|0] ""  PT
 SG_ DIGIO_SAFETY_GPIO0_SC18 m0 : 8|1@0+ (1,0) [0|0] ""  PT
 SG_ DIGIO_SC_LED501_CONTROL_SC18 m0 : 9|1@0+ (1,0) [0|0] ""  PT
 SG_ DIGIO_LNK_ISO_TST_SW_SC18 m0 : 10|1@0+ (1,0) [0|0] ""  PT
 SG_ DIGIO_SC_LED500_CONTROL_SC18 m0 : 11|1@0+ (1,0) [0|0] ""  PT
 SG_ DIGIO_POS_CNTR1_ON_SC18 m0 : 12|1@0+ (1,0) [0|0] ""  PT
 SG_ DIGIO_NEG_CNTR3_ON_SC18 m0 : 13|1@0+ (1,0) [0|0] ""  PT
 SG_ DIGIO_PRECHG_REL2_ON_SC18 m0 : 14|1@0+ (1,0) [0|0] ""  PT
 SG_ DIGIO_NEG_ISO_TEST_SW_SC18 m0 : 15|1@0+ (1,0) [0|0] ""  PT
 SG_ DIGIO_PRECHG_REL1_ON_SC18 m0 : 16|1@0+ (1,0) [0|0] ""  PT
 SG_ DIGIO_POS_ISO_TEST_SC18 m0 : 17|1@0+ (1,0) [0|0] ""  PT
 SG_ DIGIO_HVIL_PWM_SC18 m0 : 18|1@0+ (1,0) [0|0] ""  PT
 SG_ DIGIO_CNTR_HISIDE_ON_SC_SC18 m0 : 19|1@0+ (1,0) [0|0] ""  PT
 SG_ DIGIO_CRASH_DETECT_SC18 m0 : 20|1@0+ (1,0) [0|0] ""  PT
 SG_ DIGIO_NEG_CNTR2_ON_SC18 m0 : 21|1@0+ (1,0) [0|0] ""  PT
 SG_ DIGIO_NEG_CNTR1_ON_SC18 m0 : 22|1@0+ (1,0) [0|0] ""  PT
 SG_ DIGIO_POS_CNTR3_ON_SC18 m0 : 23|1@0+ (1,0) [0|0] ""  PT
 SG_ DIGIO_POS_CNTR2_ON_SC18 m0 : 24|1@0+ (1,0) [0|0] ""  PT
 SG_ DIGIO_MULTIPLEX_m101_S2_SC18 m0 : 25|1@0+ (1,0) [0|0] ""  PT
 SG_ DIGIO_MULTIPLEX_8TO1_S1_SC18 m0 : 26|1@0+ (1,0) [0|0] ""  PT
 SG_ DIGIO_CNTR_CLOSE_OK_CHCKD_SC18 m0 : 27|1@0+ (1,0) [0|0] ""  PT
 SG_ DIGIO_MULTIPLEX_8TO1_S2_SC18 m0 : 28|1@0+ (1,0) [0|0] ""  PT
 SG_ DIGIO_CNTR_CLOSE_OK_SC18 m0 : 29|1@0+ (1,0) [0|0] ""  PT
 SG_ DIGIO_MULTIPLEX_m101_S1_SC18 m0 : 30|1@0+ (1,0) [0|0] ""  PT
 SG_ DIGIO_CNTR_HISIDE_ON_CHCKD_SC18 m0 : 31|1@0+ (1,0) [0|0] ""  PT
 SG_ posPack_SC18 m2 : 23|16@0+ (0.04,-1250) [-1250|1250] "V"  PT
 SG_ posLink_SC18 m2 : 55|16@0+ (0.04,-1250) [-1250|1371.4] "V"  PT
 SG_ negPack_SC18 m2 : 39|16@0+ (0.04,-1250) [-1250|1250] "V"  PT
 SG_ negLink_SC18 m1 : 39|16@0+ (0.04,-1250) [-1250|1371.4] "V"  PT
 SG_ hallCurrent_SC18 m1 : 23|12@0+ (0.6,-1200) [-1200|1257] "A"  PT
 SG_ analogCntrPwrPlusISense_SC18 m1 : 63|8@0+ (0.05,0) [0|12.5] "A"  PT
 SG_ analogCntrPwrPlusSwitched_SC18 m1 : 55|8@0+ (0.2,0) [0|50] "V"  PT
 SG_ BIT_ANALOG_REF_FAIL_SC18 m3 : 8|1@0+ (1,0) [0|0] ""  PT
 SG_ BIT_ANALOG_ADCDRIVER_FAIL_SC18 m3 : 9|1@0+ (1,0) [0|0] ""  PT
 SG_ BIT_ANALOG_MUX910_HW_SC18 m3 : 10|1@0+ (1,0) [0|0] ""  PT
 SG_ BIT_ANALOG_MUX960_HW_SC18 m3 : 11|1@0+ (1,0) [0|0] ""  PT
 SG_ BIT_ANALOG_MUX301_HW_SC18 m3 : 12|1@0+ (1,0) [0|0] ""  PT
 SG_ BIT_ANALOG_MUX440_HW_SC18 m3 : 13|1@0+ (1,0) [0|0] ""  PT
 SG_ BIT_ANALOG_5VA_FAIL_SC18 m3 : 14|1@0+ (1,0) [0|0] ""  PT
 SG_ BIT_ANALOG_HV_SIGN_SC18 m3 : 15|1@0+ (1,0) [0|0] ""  PT
 SG_ BIT_CAN_ISENSE01_MIA_SC18 m3 : 24|1@0+ (1,0) [0|0] ""  PT
 SG_ BIT_CAN_ISENSE02_MIA_SC18 m3 : 25|1@0+ (1,0) [0|0] ""  PT
 SG_ BIT_CAN_ISENSE03_MIA_SC18 m3 : 26|1@0+ (1,0) [0|0] ""  PT
 SG_ BIT_CAN_ISENSE04_MIA_SC18 m3 : 27|1@0+ (1,0) [0|0] ""  PT
 SG_ BIT_CAN_ISENSE05_MIA_SC18 m3 : 28|1@0+ (1,0) [0|0] ""  PT
 SG_ BIT_CAN_PT_MIA_SC18 m3 : 29|1@0+ (1,0) [0|0] ""  PT
 SG_ BIT_CAN_PT_CRC_SC18 m3 : 30|1@0+ (1,0) [0|0] ""  PT
 SG_ BIT_CAN_PT_ALIVE_SC18 m3 : 31|1@0+ (1,0) [0|0] ""  PT
 SG_ BIT_CAN_SAFETYLIN_MIA_SC18 m3 : 32|1@0+ (1,0) [0|0] ""  PT
 SG_ BIT_CAN_SAFETYLIN_SHUTDOWN_SC18 m3 : 33|1@0+ (1,0) [0|0] ""  PT
 SG_ BIT_CMB_GPIO_SHORT_SC18 m3 : 40|1@0+ (1,0) [0|0] ""  PT
 SG_ BIT_CMB_C2S_LEAK_SC18 m3 : 41|1@0+ (1,0) [0|0] ""  PT
 SG_ BIT_CMB_SENSE_LINE_SC18 m3 : 42|1@0+ (1,0) [0|0] ""  PT
 SG_ BIT_CMB_SUMOFCELL_CHECK_SC18 m3 : 43|1@0+ (1,0) [0|0] ""  PT
 SG_ BIT_CMB_DRIVER_TIMING_SC18 m3 : 44|1@0+ (1,0) [0|0] ""  PT
 SG_ BIT_CMB_CLEAR_SC18 m3 : 45|1@0+ (1,0) [0|0] ""  PT
 SG_ BIT_CMB_SELFTEST_SC18 m3 : 46|1@0+ (1,0) [0|0] ""  PT
 SG_ BIT_CMB_GPIO_OPEN_SC18 m3 : 47|1@0+ (1,0) [0|0] ""  PT
 SG_ BIT_CMB_CELLV_RANGE_ERR_SC18 m3 : 48|1@0+ (1,0) [0|0] ""  PT
 SG_ BIT_CMB_ADOL_CHECK_SC18 m3 : 49|1@0+ (1,0) [0|0] ""  PT
 SG_ BIT_CMB_BALANCING_STUCK_SC18 m3 : 50|1@0+ (1,0) [0|0] ""  PT
 SG_ BIT_CMB_SUPPLY_SC18 m3 : 51|1@0+ (1,0) [0|0] ""  PT
 SG_ BIT_CMB_DEFECT_SC18 m3 : 52|1@0+ (1,0) [0|0] ""  PT
 SG_ BIT_CMB_PEC_ERROR_SC18 m3 : 53|1@0+ (1,0) [0|0] ""  PT
 SG_ BIT_CMB_GPIO_ERROR_SC18 m3 : 54|1@0+ (1,0) [0|0] ""  PT
 SG_ BIT_CMB_DIGTLREDNCY_LF_SC18 m3 : 55|1@0+ (1,0) [0|0] ""  PT
 SG_ BIT_CCTRL_SELFTEST_SC18 m4 : 8|1@0+ (1,0) [0|0] ""  PT
 SG_ BIT_CCTRL_DRIVER_FAULT_SC18 m4 : 9|1@0+ (1,0) [0|0] ""  PT
 SG_ BIT_CCTRL_HISIDE_STCLSD_SC18 m4 : 10|1@0+ (1,0) [0|0] ""  PT
 SG_ BIT_CCTRL_LOSIDE_STCLSD_SC18 m4 : 11|1@0+ (1,0) [0|0] ""  PT
 SG_ BIT_CCTRL_HISIDE_STUCK_OPEN_SC18 m4 : 12|1@0+ (1,0) [0|0] ""  PT
 SG_ BIT_CCTRL_HVOLTAGE_COND_SC18 m4 : 13|1@0+ (1,0) [0|0] ""  PT
 SG_ BIT_CCTRL_POS1_OPENCIRC_SC18 m4 : 14|1@0+ (1,0) [0|0] ""  PT
 SG_ BIT_CCTRL_NEG1_OPENCIRC_SC18 m4 : 15|1@0+ (1,0) [0|0] ""  PT
 SG_ BIT_CCTRL_PRECHG1_OPENCIRC_SC18 m4 : 16|1@0+ (1,0) [0|0] ""  PT
 SG_ BIT_CCTRL_POS2_OPENCIRC_SC18 m4 : 17|1@0+ (1,0) [0|0] ""  PT
 SG_ BIT_CCTRL_NEG2_OPENCIRC_SC18 m4 : 18|1@0+ (1,0) [0|0] ""  PT
 SG_ BIT_CCTRL_LOSDE_STOPEN_SC18 m4 : 19|1@0+ (1,0) [0|0] ""  PT
 SG_ BIT_CCTRL_POS3_OPENCIRC_SC18 m4 : 20|1@0+ (1,0) [0|0] ""  PT
 SG_ BIT_CCTRL_PRECHG2_OPENCIRC_SC18 m4 : 21|1@0+ (1,0) [0|0] ""  PT
 SG_ BIT_CCTRL_ITEM_OFF_OPEN_SC18 m4 : 22|1@0+ (1,0) [0|0] ""  PT
 SG_ BIT_CCTRL_UNEXPECTED_OPEN_SC18 m4 : 23|1@0+ (1,0) [0|0] ""  PT
 SG_ BIT_CNTR_ISOLATION_SC18 m4 : 24|1@0+ (1,0) [0|0] ""  PT
 SG_ BIT_CNTR_ISO_AND_POT_WELD_SC18 m4 : 25|1@0+ (1,0) [0|0] ""  PT
 SG_ BIT_CNTR_POS1_WELDED_SC18 m4 : 26|1@0+ (1,0) [0|0] ""  PT
 SG_ BIT_CNTR_NEG1_WELDED_SC18 m4 : 27|1@0+ (1,0) [0|0] ""  PT
 SG_ BIT_CNTR_POS2_WELDED_SC18 m4 : 28|1@0+ (1,0) [0|0] ""  PT
 SG_ BIT_CNTR_NEG2_WELDED_SC18 m4 : 29|1@0+ (1,0) [0|0] ""  PT
 SG_ BIT_CNTR_POS3_WELDED_SC18 m4 : 30|1@0+ (1,0) [0|0] ""  PT
 SG_ BIT_CNTR_NEG3_WELDED_SC18 m4 : 31|1@0+ (1,0) [0|0] ""  PT
 SG_ BIT_CNTR_P_ANDOR_N_WELD_SC18 m4 : 32|1@0+ (1,0) [0|0] ""  PT
 SG_ BIT_CNTR_HIGH_CY_SC18 m4 : 33|1@0+ (1,0) [0|0] ""  PT
 SG_ BIT_CNTR_WELDCHECK_TIMEOUT_SC18 m4 : 34|1@0+ (1,0) [0|0] ""  PT
 SG_ BIT_CURRENT_PLAUSIBILITY_SC18 m4 : 40|1@0+ (1,0) [0|0] ""  PT
 SG_ BIT_CURRENT_OVERCHARGE_SC18 m4 : 41|1@0+ (1,0) [0|0] ""  PT
 SG_ BIT_CURRENT_OVERDISCHARGE_SC18 m4 : 42|1@0+ (1,0) [0|0] ""  PT
 SG_ BIT_CURRENT_ISENSE1_INVALID_SC18 m4 : 43|1@0+ (1,0) [0|0] ""  PT
 SG_ BIT_CURRENT_ISENSE2_INVALID_SC18 m4 : 44|1@0+ (1,0) [0|0] ""  PT
 SG_ BIT_CURRENT_ISENSE3_INVALID_SC18 m4 : 45|1@0+ (1,0) [0|0] ""  PT
 SG_ BIT_CURRENT_ISENSE4_INVALID_SC18 m4 : 46|1@0+ (1,0) [0|0] ""  PT
 SG_ BIT_CURRENT_ISENSE5_INVALID_SC18 m4 : 47|1@0+ (1,0) [0|0] ""  PT
 SG_ BIT_CURRENT_HALL_INVALID_SC18 m4 : 48|1@0+ (1,0) [0|0] ""  PT
 SG_ BIT_CURRENT_OFFSET_FAULT_SC18 m4 : 49|1@0+ (1,0) [0|0] ""  PT
 SG_ BIT_FLUXGATE1_CURRENT_FAULT_SC18 m5 : 8|1@0+ (1,0) [0|0] ""  PT
 SG_ BIT_FLUXGATE_12V_LOW_SC18 m5 : 18|1@0+ (1,0) [0|0] ""  PT
 SG_ BIT_HALL_INVALID_SC18 m5 : 24|1@0+ (1,0) [0|0] ""  PT
 SG_ BIT_HALL_PWR_FAIL_LO_SC18 m5 : 25|1@0+ (1,0) [0|0] ""  PT
 SG_ BIT_HALL_SENSELO_SC18 m5 : 26|1@0+ (1,0) [0|0] ""  PT
 SG_ BIT_HALL_SENSEHI_SC18 m5 : 27|1@0+ (1,0) [0|0] ""  PT
 SG_ BIT_HVIL_HW_FAULT_SC18 m5 : 40|1@0+ (1,0) [0|0] ""  PT
 SG_ BIT_HVIL_OPEN_CIRCUIT_SC18 m5 : 41|1@0+ (1,0) [0|0] ""  PT
 SG_ BIT_HVIL_SHORT_SUPPLY_SC18 m5 : 42|1@0+ (1,0) [0|0] ""  PT
 SG_ BIT_HVIL_SHORT_CHASSIS_SC18 m5 : 43|1@0+ (1,0) [0|0] ""  PT
 SG_ BIT_HVIL_RESISTANCE_HIGH_SC18 m5 : 44|1@0+ (1,0) [0|0] ""  PT
 SG_ BIT_HVIL_SHORT_CIRCUIT_SC18 m5 : 45|1@0+ (1,0) [0|0] ""  PT
 SG_ BIT_ISASHUNT1_CURRENT_FAULT_SC18 m7 : 24|1@0+ (1,0) [0|0] ""  PT
 SG_ BIT_ISASHUNT2_CURRENT_FAULT_SC18 m7 : 25|1@0+ (1,0) [0|0] ""  PT
 SG_ BIT_ISASHUNT3_CURRENT_FAULT_SC18 m7 : 26|1@0+ (1,0) [0|0] ""  PT
 SG_ BIT_ISASHUNT4_CURRENT_FAULT_SC18 m7 : 27|1@0+ (1,0) [0|0] ""  PT
 SG_ BIT_ISASHUNT5_CURRENT_FAULT_SC18 m7 : 28|1@0+ (1,0) [0|0] ""  PT
 SG_ BIT_ISASHUNT1_CHARGE_FAULT_SC18 m7 : 29|1@0+ (1,0) [0|0] ""  PT
 SG_ BIT_ISASHUNT2_CHARGE_FAULT_SC18 m7 : 30|1@0+ (1,0) [0|0] ""  PT
 SG_ BIT_ISASHUNT3_CHARGE_FAULT_SC18 m7 : 31|1@0+ (1,0) [0|0] ""  PT
 SG_ BIT_ISASHUNT4_CHARGE_FAULT_SC18 m7 : 32|1@0+ (1,0) [0|0] ""  PT
 SG_ BIT_ISASHUNT5_CHARGE_FAULT_SC18 m7 : 33|1@0+ (1,0) [0|0] ""  PT
 SG_ BIT_ISASHUNT_SUPPLY_LOW_SC18 m7 : 34|1@0+ (1,0) [0|0] ""  PT
 SG_ BIT_LINK_POS_HW_FAIL_SC18 m7 : 40|1@0+ (1,0) [0|0] ""  PT
 SG_ BIT_LINK_NEG_HW_FAIL_SC18 m7 : 41|1@0+ (1,0) [0|0] ""  PT
 SG_ BIT_PUMP_LIN_FAILURE_SC18 m8 : 8|1@0+ (1,0) [0|0] ""  PT
 SG_ BIT_PUMP_OVERTEMPERATURE_SC18 m8 : 9|1@0+ (1,0) [0|0] ""  PT
 SG_ BIT_PUMP_SPEED_HIGH_SC18 m8 : 10|1@0+ (1,0) [0|0] ""  PT
 SG_ BIT_PUMP_SPEED_LOW_SC18 m8 : 11|1@0+ (1,0) [0|0] ""  PT
 SG_ BIT_PUMP_DRY_RUN_SC18 m8 : 12|1@0+ (1,0) [0|0] ""  PT
 SG_ BIT_SBC_VCORE_OOR_SC18 m6 : 8|1@0+ (1,0) [0|0] ""  PT
 SG_ BIT_SBC_SELFTEST_SC18 m6 : 9|1@0+ (1,0) [0|0] ""  PT
 SG_ BIT_SBC_INIT_SC18 m6 : 10|1@0+ (1,0) [0|0] ""  PT
 SG_ BIT_SBC_WATCHDOG_SC18 m6 : 11|1@0+ (1,0) [0|0] ""  PT
 SG_ BIT_SBC_FECBITFLIP_SC18 m6 : 12|1@0+ (1,0) [0|0] ""  PT
 SG_ BIT_SBC_VREUV_SC18 m6 : 13|1@0+ (1,0) [0|0] ""  PT
 SG_ BIT_SBC_FAILSAFE_SC18 m6 : 14|1@0+ (1,0) [0|0] ""  PT
 SG_ BIT_SBC_VAUX_OOR_SC18 m6 : 15|1@0+ (1,0) [0|0] ""  PT
 SG_ BIT_SBC_VCCA_OOR_SC18 m6 : 16|1@0+ (1,0) [0|0] ""  PT
 SG_ BIT_SBC_FCRBM_OOR_SC18 m6 : 17|1@0+ (1,0) [0|0] ""  PT
 SG_ BIT_SBC_FLT_ERR_CNTR_SC18 m6 : 18|1@0+ (1,0) [0|0] ""  PT
 SG_ BIT_SBC_FS0B_FAIL_SC18 m6 : 19|1@0+ (1,0) [0|0] ""  PT
 SG_ BIT_SBC_SPI_ERRORS_SC18 m6 : 20|1@0+ (1,0) [0|0] ""  PT
 SG_ BIT_SBC_SPI_TX_FAIL_SC18 m6 : 21|1@0+ (1,0) [0|0] ""  PT
 SG_ BIT_SBC_NERROR_ACTIVE_SC18 m6 : 22|1@0+ (1,0) [0|0] ""  PT
 SG_ BIT_SELFTEST_RAM_SC18 m6 : 24|1@0+ (1,0) [0|0] ""  PT
 SG_ BIT_SELFTEST_FLASH_SC18 m6 : 25|1@0+ (1,0) [0|0] ""  PT
 SG_ BIT_SELFTEST_CLOCK_SC18 m6 : 26|1@0+ (1,0) [0|0] ""  PT
 SG_ BIT_SELFTEST_WATCHDOG_SC18 m6 : 27|1@0+ (1,0) [0|0] ""  PT
 SG_ BIT_SELFTEST_STACK_SC18 m6 : 28|1@0+ (1,0) [0|0] ""  PT
 SG_ BIT_SELFTEST_L2L3_SC18 m6 : 29|1@0+ (1,0) [0|0] ""  PT
 SG_ BIT_SELFTEST_EFUSE_SC18 m6 : 30|1@0+ (1,0) [0|0] ""  PT
 SG_ BIT_SELFTEST_EXCEPTION_SC18 m6 : 31|1@0+ (1,0) [0|0] ""  PT
 SG_ BIT_SELFTEST_5VD_FAIL_SC18 m6 : 32|1@0+ (1,0) [0|0] ""  PT
 SG_ BIT_SELFTEST_VIM_SC18 m6 : 33|1@0+ (1,0) [0|0] ""  PT
 SG_ BIT_SELFTEST_TASKTIME_SC18 m6 : 34|1@0+ (1,0) [0|0] ""  PT
 SG_ BIT_SELFTEST_RTI_SC18 m6 : 35|1@0+ (1,0) [0|0] ""  PT
 SG_ BIT_SELFTEST_ESM_SC18 m6 : 36|1@0+ (1,0) [0|0] ""  PT
 SG_ BIT_SELFTEST_IOM_SC18 m6 : 37|1@0+ (1,0) [0|0] ""  PT
 SG_ BIT_SELFTEST_SBC_SC18 m6 : 38|1@0+ (1,0) [0|0] ""  PT
 SG_ BIT_SELFTEST_STARTUP_SC18 m6 : 39|1@0+ (1,0) [0|0] ""  PT
 SG_ BIT_TEMP_MODULEOVERTEMP_SC18 m6 : 40|1@0+ (1,0) [0|0] ""  PT
 SG_ BIT_TEMP_MODULETEMP_INVALID_SC18 m6 : 41|1@0+ (1,0) [0|0] ""  PT
 SG_ BIT_TEMP_NTC_OPENWIRE_SC18 m6 : 42|1@0+ (1,0) [0|0] ""  PT
 SG_ BIT_TEMP_NTC_SHORT_SC18 m6 : 43|1@0+ (1,0) [0|0] ""  PT
 SG_ BIT_TEMP_PLAUSIBILITY_SC18 m6 : 44|1@0+ (1,0) [0|0] ""  PT
 SG_ BIT_VOLTAGE_BRICKV_INVALID_SC18 m7 : 8|1@0+ (1,0) [0|0] ""  PT
 SG_ BIT_VOLTAGE_BRICKUV_SC18 m7 : 9|1@0+ (1,0) [0|0] ""  PT
 SG_ BIT_VOLTAGE_BRICKOV_SC18 m7 : 10|1@0+ (1,0) [0|0] ""  PT
 SG_ BIT_VOLTAGE_BRICKDEEPDSCHG_SC18 m7 : 11|1@0+ (1,0) [0|0] ""  PT
 SG_ BIT_VOLTAGE_PACKV_INVALID_SC18 m7 : 12|1@0+ (1,0) [0|0] ""  PT
 SG_ BIT_VOLTAGE_PLAUSIBILITY_SC18 m7 : 13|1@0+ (1,0) [0|0] ""  PT
 SG_ BIT_VOLTAGE_CMB_PLAUSI_SC18 m7 : 14|1@0+ (1,0) [0|0] ""  PT
 SG_ BIT_VOLTAGE_SENSE_OPENWIRE_SC18 m7 : 15|1@0+ (1,0) [0|0] ""  PT
 SG_ BIT_VOLTAGE_BRICKV_FROZEN_SC18 m7 : 16|1@0+ (1,0) [0|0] ""  PT
 SG_ BIT_PUMP_BLOCK_SC18 m8 : 13|1@0+ (1,0) [0|0] ""  PT
 SG_ BIT_PUMP_SUPPLY_SC18 m8 : 14|1@0+ (1,0) [0|0] ""  PT
 SG_ BIT_PUMP_OVERCURRENT_SC18 m8 : 15|1@0+ (1,0) [0|0] ""  PT
 SG_ BIT_PUMP_ELECTRIC_SC18 m8 : 16|1@0+ (1,0) [0|0] ""  PT
 SG_ BIT_PUMP_RS_SC18 m8 : 17|1@0+ (1,0) [0|0] ""  PT
 SG_ BIT_HALL_PWR_FAIL_HI_SC18 m5 : 28|1@0+ (1,0) [0|0] ""  PT
 SG_ BIT_VOLTAGE_OUT_OF_RANGE_SC18 m7 : 17|1@0+ (1,0) [0|0] ""  PT
 SG_ BIT_ISO_OFF_TIME_SHORT_SC18 m8 : 24|1@0+ (1,0) [0|0] ""  PT
 SG_ BIT_ISO_ON_TIME_SHORT_SC18 m8 : 25|1@0+ (1,0) [0|0] ""  PT
 SG_ BIT_ISO_INTERNAL_INACTIVE_SC18 m8 : 26|1@0+ (1,0) [0|0] ""  PT
 SG_ BIT_ISO_SW_STATE_INVALID_SC18 m8 : 27|1@0+ (1,0) [0|0] ""  PT
 SG_ BIT_ISO_PACKV_SNA_SWOFF_SC18 m8 : 28|1@0+ (1,0) [0|0] ""  PT
 SG_ BIT_ISO_PACKV_SNA_SWON_SC18 m8 : 29|1@0+ (1,0) [0|0] ""  PT
 SG_ BIT_ISO_EXTERNAL_INACTIVE_SC18 m8 : 30|1@0+ (1,0) [0|0] ""  PT
 SG_ BIT_CANTX_CNTR_STAT_FAULT_SC18 m8 : 40|1@0+ (1,0) [0|0] ""  PT
 SG_ BIT_CANTX_CNTR_WELD_FAULT_SC18 m8 : 41|1@0+ (1,0) [0|0] ""  PT
 SG_ BIT_CANTX_THERMAL_FAULT_SC18 m8 : 42|1@0+ (1,0) [0|0] ""  PT
 SG_ BIT_CANTX_ISOLATION_FAULT_SC18 m8 : 43|1@0+ (1,0) [0|0] ""  PT
 SG_ BIT_CANTX_HVIL_FAULT_SC18 m8 : 44|1@0+ (1,0) [0|0] ""  PT
 SG_ BIT_VOLTAGE_STATELATCHED_SC18 m7 : 18|1@0+ (1,0) [0|0] ""  PT
 SG_ BIT_CANTX_ISOLATION_PREFLT_SC18 m8 : 45|1@0+ (1,0) [0|0] ""  PT
 SG_ BIT_CANTX_FLTRIGGER_FAILED_SC18 m8 : 46|1@0+ (1,0) [0|0] ""  PT
 SG_ BIT_ISO_TEST_SWITCH_FAULT_SC18 m8 : 31|1@0+ (1,0) [0|0] ""  PT
 SG_ BIT_THERMAL_ADC_FAULT_SC18 m9 : 8|1@0+ (1,0) [0|0] ""  PT
 SG_ BIT_THERMAL_PRESSURE_VHI_SC18 m9 : 9|1@0+ (1,0) [0|0] ""  PT
 SG_ BIT_THERMAL_PRESSURE_VLO_SC18 m9 : 10|1@0+ (1,0) [0|0] ""  PT
 SG_ BIT_THERMAL_PRIMARY_EVT_SC18 m9 : 11|1@0+ (1,0) [0|0] ""  PT
 SG_ BIT_THERMAL_SECONRY_EVT_SC18 m9 : 12|1@0+ (1,0) [0|0] ""  PT
 SG_ BIT_THERMAL_PRESSURE_INV_SC18 m9 : 13|1@0+ (1,0) [0|0] ""  PT
 SG_ BIT_THERMAL_EVTLATCHED_SC18 m9 : 14|1@0+ (1,0) [0|0] ""  PT
 SG_ BIT_COOLANT_CANMIA_SC18 m9 : 24|1@0+ (1,0) [0|0] ""  PT
 SG_ BIT_COOLANT_SENSRFAIL_SC18 m9 : 25|1@0+ (1,0) [0|0] ""  PT
 SG_ BIT_COOLANT_WATERDETCD_SC18 m9 : 26|1@0+ (1,0) [0|0] ""  PT
 SG_ BIT_COOLANT_LATCHED_SC18 m9 : 27|1@0+ (1,0) [0|0] ""  PT
 SG_ BIT_ANALOG_PULLUP_DSBLD_SC18 m3 : 17|1@0+ (1,0) [0|0] ""  PT
 SG_ BIT_ANALOG_PULLUP_DSBLRQ_SC18 m3 : 16|1@0+ (1,0) [0|0] ""  PT
 SG_ BIT_SBC_REG_ERROR_SC18 m6 : 23|1@0+ (1,0) [0|0] ""  PT
 SG_ BIT_CURRENT_LATCHED_SC18 m4 : 50|1@0+ (1,0) [0|0] ""  PT
 SG_ BIT_TEMP_LATCHED_SC18 m6 : 45|1@0+ (1,0) [0|0] ""  PT
 SG_ BIT_ISO_PLAUSI_SWOFF_SC18 m8 : 32|1@0+ (1,0) [0|0] ""  PT
 SG_ BIT_ISO_PLAUSI_SWON_SC18 m8 : 33|1@0+ (1,0) [0|0] ""  PT
 SG_ BIT_ISO_RELAXED_INACTIVE_SC18 m8 : 34|1@0+ (1,0) [0|0] ""  PT
 SG_ BIT_THERMAL_PRESSURE_MIA_SC18 m9 : 15|1@0+ (1,0) [0|0] ""  PT
 SG_ BIT_LINK_PACK_MISMATCH_SC18 m7 : 42|1@0+ (1,0) [0|0] ""  PT
 SG_ BIT_CAN_PT_EMERGENCY_SC18 m3 : 34|1@0+ (1,0) [0|0] ""  PT
 SG_ BIT_THERMAL_PRES_SUPPLY_OOR_SC18 m9 : 16|1@0+ (1,0) [0|0] ""  PT
 SG_ BIT_CAN_SM_DISABLE_SC18 m3 : 35|1@0+ (1,0) [0|0] ""  PT
 SG_ BIT_THERMAL_PRESSURE_FLT_SC18 m9 : 17|1@0+ (1,0) [0|0] ""  PT
 SG_ BIT_CURRENT_SENSOR_FAULT_SC18 m9 : 40|1@0+ (1,0) [0|0] ""  PT
 SG_ BIT_CURRENT_SENSOR_CHARGE_FAULT_SC18 m9 : 45|1@0+ (1,0) [0|0] ""  PT
 SG_ BIT_CURRENT_SENSOR_SUP_LOW_SC18 m9 : 50|1@0+ (1,0) [0|0] ""  PT
 SG_ BIT_THERMAL_H2SENSE_FAULT_SC18 m9 : 18|1@0+ (1,0) [0|0] ""  PT
 SG_ BIT_VOLTAGE_BRICKCOUNT_INVALID_SC18 m7 : 19|1@0+ (1,0) [0|0] ""  PT

BO_ 1937 BMS18_DebugOnboard: 7 BMS18
 SG_ cmbCoolantTemp08_BMS18 m8 : 55|8@0+ (1,-40) [-40|200] "C"  PT
 SG_ cmbCoolantTemp07_BMS18 m7 : 55|8@0+ (1,-40) [-40|200] "C"  PT
 SG_ cmbCoolantTemp06_BMS18 m6 : 55|8@0+ (1,-40) [-40|200] "C"  PT
 SG_ cmbCoolantTemp05_BMS18 m5 : 55|8@0+ (1,-40) [-40|200] "C"  PT
 SG_ cmbCoolantTemp04_BMS18 m4 : 55|8@0+ (1,-40) [-40|200] "C"  PT
 SG_ cmbCoolantTemp03_BMS18 m3 : 55|8@0+ (1,-40) [-40|200] "C"  PT
 SG_ cmbCoolantTemp02_BMS18 m2 : 55|8@0+ (1,-40) [-40|200] "C"  PT
 SG_ cmbCoolantTemp01_BMS18 m1 : 55|8@0+ (1,-40) [-40|200] "C"  PT
 SG_ cmbOnboardPressure32_BMS18 m32 : 39|16@0+ (1,0) [0|600] "kPa"  PT
 SG_ cmbOnboardPressure31_BMS18 m31 : 39|16@0+ (1,0) [0|600] "kPa"  PT
 SG_ cmbOnboardPressure30_BMS18 m30 : 39|16@0+ (1,0) [0|600] "kPa"  PT
 SG_ cmbOnboardPressure29_BMS18 m29 : 39|16@0+ (1,0) [0|600] "kPa"  PT
 SG_ cmbOnboardPressure28_BMS18 m28 : 39|16@0+ (1,0) [0|600] "kPa"  PT
 SG_ cmbOnboardPressure27_BMS18 m27 : 39|16@0+ (1,0) [0|600] "kPa"  PT
 SG_ cmbOnboardPressure26_BMS18 m26 : 39|16@0+ (1,0) [0|600] "kPa"  PT
 SG_ cmbOnboardPressure25_BMS18 m25 : 39|16@0+ (1,0) [0|600] "kPa"  PT
 SG_ cmbOnboardPressure24_BMS18 m24 : 39|16@0+ (1,0) [0|600] "kPa"  PT
 SG_ cmbOnboardPressure23_BMS18 m23 : 39|16@0+ (1,0) [0|600] "kPa"  PT
 SG_ cmbOnboardPressure22_BMS18 m22 : 39|16@0+ (1,0) [0|600] "kPa"  PT
 SG_ cmbOnboardPressure21_BMS18 m21 : 39|16@0+ (1,0) [0|600] "kPa"  PT
 SG_ cmbOnboardPressure20_BMS18 m20 : 39|16@0+ (1,0) [0|600] "kPa"  PT
 SG_ cmbOnboardPressure19_BMS18 m19 : 39|16@0+ (1,0) [0|600] "kPa"  PT
 SG_ cmbOnboardPressure18_BMS18 m18 : 39|16@0+ (1,0) [0|600] "kPa"  PT
 SG_ cmbOnboardPressure17_BMS18 m17 : 39|16@0+ (1,0) [0|600] "kPa"  PT
 SG_ cmbOnboardPressure16_BMS18 m16 : 39|16@0+ (1,0) [0|600] "kPa"  PT
 SG_ cmbOnboardPressure15_BMS18 m15 : 39|16@0+ (1,0) [0|600] "kPa"  PT
 SG_ cmbOnboardPressure14_BMS18 m14 : 39|16@0+ (1,0) [0|600] "kPa"  PT
 SG_ cmbOnboardPressure13_BMS18 m13 : 39|16@0+ (1,0) [0|600] "kPa"  PT
 SG_ cmbOnboardPressure12_BMS18 m12 : 39|16@0+ (1,0) [0|600] "kPa"  PT
 SG_ cmbOnboardPressure11_BMS18 m11 : 39|16@0+ (1,0) [0|600] "kPa"  PT
 SG_ cmbOnboardPressure10_BMS18 m10 : 39|16@0+ (1,0) [0|600] "kPa"  PT
 SG_ cmbOnboardPressure09_BMS18 m9 : 39|16@0+ (1,0) [0|600] "kPa"  PT
 SG_ cmbOnboardPressure08_BMS18 m8 : 39|16@0+ (1,0) [0|600] "kPa"  PT
 SG_ cmbOnboardPressure07_BMS18 m7 : 39|16@0+ (1,0) [0|600] "kPa"  PT
 SG_ cmbOnboardPressure06_BMS18 m6 : 39|16@0+ (1,0) [0|600] "kPa"  PT
 SG_ cmbOnboardPressure05_BMS18 m5 : 39|16@0+ (1,0) [0|600] "kPa"  PT
 SG_ cmbOnboardPressure04_BMS18 m4 : 39|16@0+ (1,0) [0|600] "kPa"  PT
 SG_ cmbOnboardPressure03_BMS18 m3 : 39|16@0+ (1,0) [0|600] "kPa"  PT
 SG_ cmbOnboardPressure02_BMS18 m2 : 39|16@0+ (1,0) [0|600] "kPa"  PT
 SG_ cmbOnboardPressure01_BMS18 m1 : 39|16@0+ (1,0) [0|600] "kPa"  PT
 SG_ onboardMultiplexor_BMS18 M : 7|8@0+ (1,0) [0|0] ""  PT
 SG_ minCmbOnboardTemperature_BMS18 m0 : 31|8@0+ (1,-40) [-40|200] "C"  PT
 SG_ minCmbOnboardHumidity_BMS18 m0 : 47|8@0+ (0.5,0) [0|120] "PCT"  PT
 SG_ maxCmbOnboardTemperature_BMS18 m0 : 39|8@0+ (1,-40) [-40|200] "C"  PT
 SG_ maxCmbOnboardHumidity_BMS18 m0 : 55|8@0+ (0.5,0) [0|120] "PCT"  PT
 SG_ bmsOnboardTemperature_BMS18 m0 : 15|8@0+ (1,-40) [-40|200] "C"  PT
 SG_ bmsOnboardHumidity_BMS18 m0 : 23|8@0+ (0.5,0) [0|120] "PCT"  PT
 SG_ cmbOnboardTemperature01_BMS18 m1 : 15|8@0+ (1,-40) [-40|200] "C"  PT
 SG_ cmbOnboardHumidity01_BMS18 m1 : 23|8@0+ (0.5,0) [0|120] "PCT"  PT
 SG_ moduleHeaterCurrent01_BMS18 m1 : 31|8@0+ (0.05,0) [0|10] "A"  PT
 SG_ cmbOnboardTemperature02_BMS18 m2 : 15|8@0+ (1,-40) [-40|200] "C"  PT
 SG_ cmbOnboardHumidity02_BMS18 m2 : 23|8@0+ (0.5,0) [0|120] "PCT"  PT
 SG_ moduleHeaterCurrent02_BMS18 m2 : 31|8@0+ (0.05,0) [0|10] "A"  PT
 SG_ cmbOnboardTemperature03_BMS18 m3 : 15|8@0+ (1,-40) [-40|200] "C"  PT
 SG_ cmbOnboardHumidity03_BMS18 m3 : 23|8@0+ (0.5,0) [0|120] "PCT"  PT
 SG_ moduleHeaterCurrent03_BMS18 m3 : 31|8@0+ (0.05,0) [0|10] "A"  PT
 SG_ cmbOnboardTemperature04_BMS18 m4 : 15|8@0+ (1,-40) [-40|200] "C"  PT
 SG_ cmbOnboardHumidity04_BMS18 m4 : 23|8@0+ (0.5,0) [0|120] "PCT"  PT
 SG_ moduleHeaterCurrent04_BMS18 m4 : 31|8@0+ (0.05,0) [0|10] "A"  PT
 SG_ cmbOnboardTemperature05_BMS18 m5 : 15|8@0+ (1,-40) [-40|200] "C"  PT
 SG_ cmbOnboardHumidity05_BMS18 m5 : 23|8@0+ (0.5,0) [0|120] "PCT"  PT
 SG_ moduleHeaterCurrent05_BMS18 m5 : 31|8@0+ (0.05,0) [0|10] "A"  PT
 SG_ cmbOnboardTemperature06_BMS18 m6 : 15|8@0+ (1,-40) [-40|200] "C"  PT
 SG_ cmbOnboardHumidity06_BMS18 m6 : 23|8@0+ (0.5,0) [0|120] "PCT"  PT
 SG_ moduleHeaterCurrent06_BMS18 m6 : 31|8@0+ (0.05,0) [0|10] "A"  PT
 SG_ cmbOnboardTemperature07_BMS18 m7 : 15|8@0+ (1,-40) [-40|200] "C"  PT
 SG_ cmbOnboardHumidity07_BMS18 m7 : 23|8@0+ (0.5,0) [0|120] "PCT"  PT
 SG_ moduleHeaterCurrent07_BMS18 m7 : 31|8@0+ (0.05,0) [0|10] "A"  PT
 SG_ cmbOnboardTemperature08_BMS18 m8 : 15|8@0+ (1,-40) [-40|200] "C"  PT
 SG_ cmbOnboardHumidity08_BMS18 m8 : 23|8@0+ (0.5,0) [0|120] "PCT"  PT
 SG_ moduleHeaterCurrent08_BMS18 m8 : 31|8@0+ (0.05,0) [0|10] "A"  PT
 SG_ cmbOnboardTemperature09_BMS18 m9 : 15|8@0+ (1,-40) [-40|200] "C"  PT
 SG_ cmbOnboardHumidity09_BMS18 m9 : 23|8@0+ (0.5,0) [0|120] "PCT"  PT
 SG_ moduleHeaterCurrent09_BMS18 m9 : 31|8@0+ (0.05,0) [0|10] "A"  PT
 SG_ cmbOnboardTemperature10_BMS18 m10 : 15|8@0+ (1,-40) [-40|200] "C"  PT
 SG_ cmbOnboardHumidity10_BMS18 m10 : 23|8@0+ (0.5,0) [0|120] "PCT"  PT
 SG_ moduleHeaterCurrent10_BMS18 m10 : 31|8@0+ (0.05,0) [0|10] "A"  PT
 SG_ cmbOnboardTemperature11_BMS18 m11 : 15|8@0+ (1,-40) [-40|200] "C"  PT
 SG_ cmbOnboardHumidity11_BMS18 m11 : 23|8@0+ (0.5,0) [0|120] "PCT"  PT
 SG_ moduleHeaterCurrent11_BMS18 m11 : 31|8@0+ (0.05,0) [0|10] "A"  PT
 SG_ cmbOnboardTemperature12_BMS18 m12 : 15|8@0+ (1,-40) [-40|200] "C"  PT
 SG_ cmbOnboardHumidity12_BMS18 m12 : 23|8@0+ (0.5,0) [0|120] "PCT"  PT
 SG_ moduleHeaterCurrent12_BMS18 m12 : 31|8@0+ (0.05,0) [0|10] "A"  PT
 SG_ cmbOnboardTemperature13_BMS18 m13 : 15|8@0+ (1,-40) [-40|200] "C"  PT
 SG_ cmbOnboardHumidity13_BMS18 m13 : 23|8@0+ (0.5,0) [0|120] "PCT"  PT
 SG_ moduleHeaterCurrent13_BMS18 m13 : 31|8@0+ (0.05,0) [0|10] "A"  PT
 SG_ cmbOnboardTemperature14_BMS18 m14 : 15|8@0+ (1,-40) [-40|200] "C"  PT
 SG_ cmbOnboardHumidity14_BMS18 m14 : 23|8@0+ (0.5,0) [0|120] "PCT"  PT
 SG_ moduleHeaterCurrent14_BMS18 m14 : 31|8@0+ (0.05,0) [0|10] "A"  PT
 SG_ cmbOnboardTemperature15_BMS18 m15 : 15|8@0+ (1,-40) [-40|200] "C"  PT
 SG_ cmbOnboardHumidity15_BMS18 m15 : 23|8@0+ (0.5,0) [0|120] "PCT"  PT
 SG_ moduleHeaterCurrent15_BMS18 m15 : 31|8@0+ (0.05,0) [0|10] "A"  PT
 SG_ cmbOnboardTemperature16_BMS18 m16 : 15|8@0+ (1,-40) [-40|200] "C"  PT
 SG_ cmbOnboardHumidity16_BMS18 m16 : 23|8@0+ (0.5,0) [0|120] "PCT"  PT
 SG_ moduleHeaterCurrent16_BMS18 m16 : 31|8@0+ (0.05,0) [0|10] "A"  PT
 SG_ cmbOnboardTemperature17_BMS18 m17 : 15|8@0+ (1,-40) [-40|200] "C"  PT
 SG_ cmbOnboardHumidity17_BMS18 m17 : 23|8@0+ (0.5,0) [0|120] "PCT"  PT
 SG_ moduleHeaterCurrent17_BMS18 m17 : 31|8@0+ (0.05,0) [0|10] "A"  PT
 SG_ cmbOnboardTemperature18_BMS18 m18 : 15|8@0+ (1,-40) [-40|200] "C"  PT
 SG_ cmbOnboardHumidity18_BMS18 m18 : 23|8@0+ (0.5,0) [0|120] "PCT"  PT
 SG_ moduleHeaterCurrent18_BMS18 m18 : 31|8@0+ (0.05,0) [0|10] "A"  PT
 SG_ cmbOnboardTemperature19_BMS18 m19 : 15|8@0+ (1,-40) [-40|200] "C"  PT
 SG_ cmbOnboardHumidity19_BMS18 m19 : 23|8@0+ (0.5,0) [0|120] "PCT"  PT
 SG_ moduleHeaterCurrent19_BMS18 m19 : 31|8@0+ (0.05,0) [0|10] "A"  PT
 SG_ cmbOnboardTemperature20_BMS18 m20 : 15|8@0+ (1,-40) [-40|200] "C"  PT
 SG_ cmbOnboardHumidity20_BMS18 m20 : 23|8@0+ (0.5,0) [0|120] "PCT"  PT
 SG_ moduleHeaterCurrent20_BMS18 m20 : 31|8@0+ (0.05,0) [0|10] "A"  PT
 SG_ cmbOnboardTemperature21_BMS18 m21 : 15|8@0+ (1,-40) [-40|200] "C"  PT
 SG_ cmbOnboardHumidity21_BMS18 m21 : 23|8@0+ (0.5,0) [0|120] "PCT"  PT
 SG_ moduleHeaterCurrent21_BMS18 m21 : 31|8@0+ (0.05,0) [0|10] "A"  PT
 SG_ cmbOnboardTemperature22_BMS18 m22 : 15|8@0+ (1,-40) [-40|200] "C"  PT
 SG_ cmbOnboardHumidity22_BMS18 m22 : 23|8@0+ (0.5,0) [0|120] "PCT"  PT
 SG_ moduleHeaterCurrent22_BMS18 m22 : 31|8@0+ (0.05,0) [0|10] "A"  PT
 SG_ cmbOnboardTemperature23_BMS18 m23 : 15|8@0+ (1,-40) [-40|200] "C"  PT
 SG_ cmbOnboardHumidity23_BMS18 m23 : 23|8@0+ (0.5,0) [0|120] "PCT"  PT
 SG_ moduleHeaterCurrent23_BMS18 m23 : 31|8@0+ (0.05,0) [0|10] "A"  PT
 SG_ cmbOnboardTemperature24_BMS18 m24 : 15|8@0+ (1,-40) [-40|200] "C"  PT
 SG_ cmbOnboardHumidity24_BMS18 m24 : 23|8@0+ (0.5,0) [0|120] "PCT"  PT
 SG_ moduleHeaterCurrent24_BMS18 m24 : 31|8@0+ (0.05,0) [0|10] "A"  PT
 SG_ cmbOnboardTemperature25_BMS18 m25 : 15|8@0+ (1,-40) [-40|200] "C"  PT
 SG_ cmbOnboardHumidity25_BMS18 m25 : 23|8@0+ (0.5,0) [0|120] "PCT"  PT
 SG_ moduleHeaterCurrent25_BMS18 m25 : 31|8@0+ (0.05,0) [0|10] "A"  PT
 SG_ cmbOnboardTemperature26_BMS18 m26 : 15|8@0+ (1,-40) [-40|200] "C"  PT
 SG_ cmbOnboardHumidity26_BMS18 m26 : 23|8@0+ (0.5,0) [0|120] "PCT"  PT
 SG_ moduleHeaterCurrent26_BMS18 m26 : 31|8@0+ (0.05,0) [0|10] "A"  PT
 SG_ cmbOnboardTemperature27_BMS18 m27 : 15|8@0+ (1,-40) [-40|200] "C"  PT
 SG_ cmbOnboardHumidity27_BMS18 m27 : 23|8@0+ (0.5,0) [0|120] "PCT"  PT
 SG_ moduleHeaterCurrent27_BMS18 m27 : 31|8@0+ (0.05,0) [0|10] "A"  PT
 SG_ cmbOnboardTemperature28_BMS18 m28 : 15|8@0+ (1,-40) [-40|200] "C"  PT
 SG_ cmbOnboardHumidity28_BMS18 m28 : 23|8@0+ (0.5,0) [0|120] "PCT"  PT
 SG_ moduleHeaterCurrent28_BMS18 m28 : 31|8@0+ (0.05,0) [0|10] "A"  PT
 SG_ cmbOnboardTemperature29_BMS18 m29 : 15|8@0+ (1,-40) [-40|200] "C"  PT
 SG_ cmbOnboardHumidity29_BMS18 m29 : 23|8@0+ (0.5,0) [0|120] "PCT"  PT
 SG_ moduleHeaterCurrent29_BMS18 m29 : 31|8@0+ (0.05,0) [0|10] "A"  PT
 SG_ cmbOnboardTemperature30_BMS18 m30 : 15|8@0+ (1,-40) [-40|200] "C"  PT
 SG_ cmbOnboardHumidity30_BMS18 m30 : 23|8@0+ (0.5,0) [0|120] "PCT"  PT
 SG_ moduleHeaterCurrent30_BMS18 m30 : 31|8@0+ (0.05,0) [0|10] "A"  PT
 SG_ cmbOnboardTemperature31_BMS18 m31 : 15|8@0+ (1,-40) [-40|200] "C"  PT
 SG_ cmbOnboardHumidity31_BMS18 m31 : 23|8@0+ (0.5,0) [0|120] "PCT"  PT
 SG_ moduleHeaterCurrent31_BMS18 m31 : 31|8@0+ (0.05,0) [0|10] "A"  PT
 SG_ cmbOnboardTemperature32_BMS18 m32 : 15|8@0+ (1,-40) [-40|200] "C"  PT
 SG_ cmbOnboardHumidity32_BMS18 m32 : 23|8@0+ (0.5,0) [0|120] "PCT"  PT
 SG_ moduleHeaterCurrent32_BMS18 m32 : 31|8@0+ (0.05,0) [0|10] "A"  PT

BO_ 2001 BMS18_DebugCMB: 8 BMS18
 SG_ cmbMultiplexor_BMS18 M : 7|8@0+ (1,0) [0|0] ""  PT
 SG_ moduleTemperature01_BMS18 m1 : 15|8@0+ (1,-40) [-40|200] "C"  PT
 SG_ brickVoltage001_BMS18 m1 : 23|16@0+ (0.0001,0) [0|6.5] "V"  PT
 SG_ brickVoltage002_BMS18 m1 : 39|16@0+ (0.0001,0) [0|6.5] "V"  PT
 SG_ brickVoltage003_BMS18 m1 : 55|16@0+ (0.0001,0) [0|6.5] "V"  PT
 SG_ moduleTemperature02_BMS18 m2 : 15|8@0+ (1,-40) [-40|200] "C"  PT
 SG_ brickVoltage004_BMS18 m2 : 23|16@0+ (0.0001,0) [0|6.5] "V"  PT
 SG_ brickVoltage005_BMS18 m2 : 39|16@0+ (0.0001,0) [0|6.5] "V"  PT
 SG_ brickVoltage006_BMS18 m2 : 55|16@0+ (0.0001,0) [0|6.5] "V"  PT
 SG_ moduleTemperature03_BMS18 m3 : 15|8@0+ (1,-40) [-40|200] "C"  PT
 SG_ brickVoltage007_BMS18 m3 : 23|16@0+ (0.0001,0) [0|6.5] "V"  PT
 SG_ brickVoltage008_BMS18 m3 : 39|16@0+ (0.0001,0) [0|6.5] "V"  PT
 SG_ brickVoltage009_BMS18 m3 : 55|16@0+ (0.0001,0) [0|6.5] "V"  PT
 SG_ moduleTemperature04_BMS18 m4 : 15|8@0+ (1,-40) [-40|200] "C"  PT
 SG_ brickVoltage010_BMS18 m4 : 23|16@0+ (0.0001,0) [0|6.5] "V"  PT
 SG_ brickVoltage011_BMS18 m4 : 39|16@0+ (0.0001,0) [0|6.5] "V"  PT
 SG_ brickVoltage012_BMS18 m4 : 55|16@0+ (0.0001,0) [0|6.5] "V"  PT
 SG_ moduleTemperature05_BMS18 m5 : 15|8@0+ (1,-40) [-40|200] "C"  PT
 SG_ brickVoltage013_BMS18 m5 : 23|16@0+ (0.0001,0) [0|6.5] "V"  PT
 SG_ brickVoltage014_BMS18 m5 : 39|16@0+ (0.0001,0) [0|6.5] "V"  PT
 SG_ brickVoltage015_BMS18 m5 : 55|16@0+ (0.0001,0) [0|6.5] "V"  PT
 SG_ moduleTemperature06_BMS18 m6 : 15|8@0+ (1,-40) [-40|200] "C"  PT
 SG_ brickVoltage016_BMS18 m6 : 23|16@0+ (0.0001,0) [0|6.5] "V"  PT
 SG_ brickVoltage017_BMS18 m6 : 39|16@0+ (0.0001,0) [0|6.5] "V"  PT
 SG_ brickVoltage018_BMS18 m6 : 55|16@0+ (0.0001,0) [0|6.5] "V"  PT
 SG_ moduleTemperature07_BMS18 m7 : 15|8@0+ (1,-40) [-40|200] "C"  PT
 SG_ brickVoltage019_BMS18 m7 : 23|16@0+ (0.0001,0) [0|6.5] "V"  PT
 SG_ brickVoltage020_BMS18 m7 : 39|16@0+ (0.0001,0) [0|6.5] "V"  PT
 SG_ brickVoltage021_BMS18 m7 : 55|16@0+ (0.0001,0) [0|6.5] "V"  PT
 SG_ moduleTemperature08_BMS18 m8 : 15|8@0+ (1,-40) [-40|200] "C"  PT
 SG_ brickVoltage022_BMS18 m8 : 23|16@0+ (0.0001,0) [0|6.5] "V"  PT
 SG_ brickVoltage023_BMS18 m8 : 39|16@0+ (0.0001,0) [0|6.5] "V"  PT
 SG_ brickVoltage024_BMS18 m8 : 55|16@0+ (0.0001,0) [0|6.5] "V"  PT
 SG_ moduleTemperature09_BMS18 m9 : 15|8@0+ (1,-40) [-40|200] "C"  PT
 SG_ brickVoltage025_BMS18 m9 : 23|16@0+ (0.0001,0) [0|6.5] "V"  PT
 SG_ brickVoltage026_BMS18 m9 : 39|16@0+ (0.0001,0) [0|6.5] "V"  PT
 SG_ brickVoltage027_BMS18 m9 : 55|16@0+ (0.0001,0) [0|6.5] "V"  PT
 SG_ moduleTemperature10_BMS18 m10 : 15|8@0+ (1,-40) [-40|200] "C"  PT
 SG_ brickVoltage028_BMS18 m10 : 23|16@0+ (0.0001,0) [0|6.5] "V"  PT
 SG_ brickVoltage029_BMS18 m10 : 39|16@0+ (0.0001,0) [0|6.5] "V"  PT
 SG_ brickVoltage030_BMS18 m10 : 55|16@0+ (0.0001,0) [0|6.5] "V"  PT
 SG_ moduleTemperature11_BMS18 m11 : 15|8@0+ (1,-40) [-40|200] "C"  PT
 SG_ brickVoltage031_BMS18 m11 : 23|16@0+ (0.0001,0) [0|6.5] "V"  PT
 SG_ brickVoltage032_BMS18 m11 : 39|16@0+ (0.0001,0) [0|6.5] "V"  PT
 SG_ brickVoltage033_BMS18 m11 : 55|16@0+ (0.0001,0) [0|6.5] "V"  PT
 SG_ moduleTemperature12_BMS18 m12 : 15|8@0+ (1,-40) [-40|200] "C"  PT
 SG_ brickVoltage034_BMS18 m12 : 23|16@0+ (0.0001,0) [0|6.5] "V"  PT
 SG_ brickVoltage035_BMS18 m12 : 39|16@0+ (0.0001,0) [0|6.5] "V"  PT
 SG_ brickVoltage036_BMS18 m12 : 55|16@0+ (0.0001,0) [0|6.5] "V"  PT
 SG_ moduleTemperature13_BMS18 m13 : 15|8@0+ (1,-40) [-40|200] "C"  PT
 SG_ brickVoltage037_BMS18 m13 : 23|16@0+ (0.0001,0) [0|6.5] "V"  PT
 SG_ brickVoltage038_BMS18 m13 : 39|16@0+ (0.0001,0) [0|6.5] "V"  PT
 SG_ brickVoltage039_BMS18 m13 : 55|16@0+ (0.0001,0) [0|6.5] "V"  PT
 SG_ moduleTemperature14_BMS18 m14 : 15|8@0+ (1,-40) [-40|200] "C"  PT
 SG_ brickVoltage040_BMS18 m14 : 23|16@0+ (0.0001,0) [0|6.5] "V"  PT
 SG_ brickVoltage041_BMS18 m14 : 39|16@0+ (0.0001,0) [0|6.5] "V"  PT
 SG_ brickVoltage042_BMS18 m14 : 55|16@0+ (0.0001,0) [0|6.5] "V"  PT
 SG_ moduleTemperature15_BMS18 m15 : 15|8@0+ (1,-40) [-40|200] "C"  PT
 SG_ brickVoltage043_BMS18 m15 : 23|16@0+ (0.0001,0) [0|6.5] "V"  PT
 SG_ brickVoltage044_BMS18 m15 : 39|16@0+ (0.0001,0) [0|6.5] "V"  PT
 SG_ brickVoltage045_BMS18 m15 : 55|16@0+ (0.0001,0) [0|6.5] "V"  PT
 SG_ moduleTemperature16_BMS18 m16 : 15|8@0+ (1,-40) [-40|200] "C"  PT
 SG_ brickVoltage046_BMS18 m16 : 23|16@0+ (0.0001,0) [0|6.5] "V"  PT
 SG_ brickVoltage047_BMS18 m16 : 39|16@0+ (0.0001,0) [0|6.5] "V"  PT
 SG_ brickVoltage048_BMS18 m16 : 55|16@0+ (0.0001,0) [0|6.5] "V"  PT
 SG_ moduleTemperature17_BMS18 m17 : 15|8@0+ (1,-40) [-40|200] "C"  PT
 SG_ brickVoltage049_BMS18 m17 : 23|16@0+ (0.0001,0) [0|6.5] "V"  PT
 SG_ brickVoltage050_BMS18 m17 : 39|16@0+ (0.0001,0) [0|6.5] "V"  PT
 SG_ brickVoltage051_BMS18 m17 : 55|16@0+ (0.0001,0) [0|6.5] "V"  PT
 SG_ moduleTemperature18_BMS18 m18 : 15|8@0+ (1,-40) [-40|200] "C"  PT
 SG_ brickVoltage052_BMS18 m18 : 23|16@0+ (0.0001,0) [0|6.5] "V"  PT
 SG_ brickVoltage053_BMS18 m18 : 39|16@0+ (0.0001,0) [0|6.5] "V"  PT
 SG_ brickVoltage054_BMS18 m18 : 55|16@0+ (0.0001,0) [0|6.5] "V"  PT
 SG_ moduleTemperature19_BMS18 m19 : 15|8@0+ (1,-40) [-40|200] "C"  PT
 SG_ brickVoltage055_BMS18 m19 : 23|16@0+ (0.0001,0) [0|6.5] "V"  PT
 SG_ brickVoltage056_BMS18 m19 : 39|16@0+ (0.0001,0) [0|6.5] "V"  PT
 SG_ brickVoltage057_BMS18 m19 : 55|16@0+ (0.0001,0) [0|6.5] "V"  PT
 SG_ moduleTemperature20_BMS18 m20 : 15|8@0+ (1,-40) [-40|200] "C"  PT
 SG_ brickVoltage058_BMS18 m20 : 23|16@0+ (0.0001,0) [0|6.5] "V"  PT
 SG_ brickVoltage059_BMS18 m20 : 39|16@0+ (0.0001,0) [0|6.5] "V"  PT
 SG_ brickVoltage060_BMS18 m20 : 55|16@0+ (0.0001,0) [0|6.5] "V"  PT
 SG_ moduleTemperature21_BMS18 m21 : 15|8@0+ (1,-40) [-40|200] "C"  PT
 SG_ brickVoltage061_BMS18 m21 : 23|16@0+ (0.0001,0) [0|6.5] "V"  PT
 SG_ brickVoltage062_BMS18 m21 : 39|16@0+ (0.0001,0) [0|6.5] "V"  PT
 SG_ brickVoltage063_BMS18 m21 : 55|16@0+ (0.0001,0) [0|6.5] "V"  PT
 SG_ moduleTemperature22_BMS18 m22 : 15|8@0+ (1,-40) [-40|200] "C"  PT
 SG_ brickVoltage064_BMS18 m22 : 23|16@0+ (0.0001,0) [0|6.5] "V"  PT
 SG_ brickVoltage065_BMS18 m22 : 39|16@0+ (0.0001,0) [0|6.5] "V"  PT
 SG_ brickVoltage066_BMS18 m22 : 55|16@0+ (0.0001,0) [0|6.5] "V"  PT
 SG_ moduleTemperature23_BMS18 m23 : 15|8@0+ (1,-40) [-40|200] "C"  PT
 SG_ brickVoltage067_BMS18 m23 : 23|16@0+ (0.0001,0) [0|6.5] "V"  PT
 SG_ brickVoltage068_BMS18 m23 : 39|16@0+ (0.0001,0) [0|6.5] "V"  PT
 SG_ brickVoltage069_BMS18 m23 : 55|16@0+ (0.0001,0) [0|6.5] "V"  PT
 SG_ moduleTemperature24_BMS18 m24 : 15|8@0+ (1,-40) [-40|200] "C"  PT
 SG_ brickVoltage070_BMS18 m24 : 23|16@0+ (0.0001,0) [0|6.5] "V"  PT
 SG_ brickVoltage071_BMS18 m24 : 39|16@0+ (0.0001,0) [0|6.5] "V"  PT
 SG_ brickVoltage072_BMS18 m24 : 55|16@0+ (0.0001,0) [0|6.5] "V"  PT
 SG_ moduleTemperature25_BMS18 m25 : 15|8@0+ (1,-40) [-40|200] "C"  PT
 SG_ brickVoltage073_BMS18 m25 : 23|16@0+ (0.0001,0) [0|6.5] "V"  PT
 SG_ brickVoltage074_BMS18 m25 : 39|16@0+ (0.0001,0) [0|6.5] "V"  PT
 SG_ brickVoltage075_BMS18 m25 : 55|16@0+ (0.0001,0) [0|6.5] "V"  PT
 SG_ moduleTemperature26_BMS18 m26 : 15|8@0+ (1,-40) [-40|200] "C"  PT
 SG_ brickVoltage076_BMS18 m26 : 23|16@0+ (0.0001,0) [0|6.5] "V"  PT
 SG_ brickVoltage077_BMS18 m26 : 39|16@0+ (0.0001,0) [0|6.5] "V"  PT
 SG_ brickVoltage078_BMS18 m26 : 55|16@0+ (0.0001,0) [0|6.5] "V"  PT
 SG_ moduleTemperature27_BMS18 m27 : 15|8@0+ (1,-40) [-40|200] "C"  PT
 SG_ brickVoltage079_BMS18 m27 : 23|16@0+ (0.0001,0) [0|6.5] "V"  PT
 SG_ brickVoltage080_BMS18 m27 : 39|16@0+ (0.0001,0) [0|6.5] "V"  PT
 SG_ brickVoltage081_BMS18 m27 : 55|16@0+ (0.0001,0) [0|6.5] "V"  PT
 SG_ moduleTemperature28_BMS18 m28 : 15|8@0+ (1,-40) [-40|200] "C"  PT
 SG_ brickVoltage082_BMS18 m28 : 23|16@0+ (0.0001,0) [0|6.5] "V"  PT
 SG_ brickVoltage083_BMS18 m28 : 39|16@0+ (0.0001,0) [0|6.5] "V"  PT
 SG_ brickVoltage084_BMS18 m28 : 55|16@0+ (0.0001,0) [0|6.5] "V"  PT
 SG_ moduleTemperature29_BMS18 m29 : 15|8@0+ (1,-40) [-40|200] "C"  PT
 SG_ brickVoltage085_BMS18 m29 : 23|16@0+ (0.0001,0) [0|6.5] "V"  PT
 SG_ brickVoltage086_BMS18 m29 : 39|16@0+ (0.0001,0) [0|6.5] "V"  PT
 SG_ brickVoltage087_BMS18 m29 : 55|16@0+ (0.0001,0) [0|6.5] "V"  PT
 SG_ moduleTemperature30_BMS18 m30 : 15|8@0+ (1,-40) [-40|200] "C"  PT
 SG_ brickVoltage088_BMS18 m30 : 23|16@0+ (0.0001,0) [0|6.5] "V"  PT
 SG_ brickVoltage089_BMS18 m30 : 39|16@0+ (0.0001,0) [0|6.5] "V"  PT
 SG_ brickVoltage090_BMS18 m30 : 55|16@0+ (0.0001,0) [0|6.5] "V"  PT
 SG_ moduleTemperature31_BMS18 m31 : 15|8@0+ (1,-40) [-40|200] "C"  PT
 SG_ brickVoltage091_BMS18 m31 : 23|16@0+ (0.0001,0) [0|6.5] "V"  PT
 SG_ brickVoltage092_BMS18 m31 : 39|16@0+ (0.0001,0) [0|6.5] "V"  PT
 SG_ brickVoltage093_BMS18 m31 : 55|16@0+ (0.0001,0) [0|6.5] "V"  PT
 SG_ moduleTemperature32_BMS18 m32 : 15|8@0+ (1,-40) [-40|200] "C"  PT
 SG_ brickVoltage094_BMS18 m32 : 23|16@0+ (0.0001,0) [0|6.5] "V"  PT
 SG_ brickVoltage095_BMS18 m32 : 39|16@0+ (0.0001,0) [0|6.5] "V"  PT
 SG_ brickVoltage096_BMS18 m32 : 55|16@0+ (0.0001,0) [0|6.5] "V"  PT
 SG_ brickVoltage097_BMS18 m33 : 23|16@0+ (0.0001,0) [0|6.5] "V"  PT
 SG_ brickVoltage098_BMS18 m33 : 39|16@0+ (0.0001,0) [0|6.5] "V"  PT
 SG_ brickVoltage099_BMS18 m33 : 55|16@0+ (0.0001,0) [0|6.5] "V"  PT
 SG_ brickVoltage100_BMS18 m34 : 23|16@0+ (0.0001,0) [0|6.5] "V"  PT
 SG_ brickVoltage101_BMS18 m34 : 39|16@0+ (0.0001,0) [0|6.5] "V"  PT
 SG_ brickVoltage102_BMS18 m34 : 55|16@0+ (0.0001,0) [0|6.5] "V"  PT
 SG_ brickVoltage103_BMS18 m35 : 23|16@0+ (0.0001,0) [0|6.5] "V"  PT
 SG_ brickVoltage104_BMS18 m35 : 39|16@0+ (0.0001,0) [0|6.5] "V"  PT
 SG_ brickVoltage105_BMS18 m35 : 55|16@0+ (0.0001,0) [0|6.5] "V"  PT
 SG_ brickVoltage106_BMS18 m36 : 23|16@0+ (0.0001,0) [0|6.5] "V"  PT
 SG_ brickVoltage107_BMS18 m36 : 39|16@0+ (0.0001,0) [0|6.5] "V"  PT
 SG_ brickVoltage108_BMS18 m36 : 55|16@0+ (0.0001,0) [0|6.5] "V"  PT
 SG_ brickVoltage109_BMS18 m37 : 23|16@0+ (0.0001,0) [0|6.5] "V"  PT
 SG_ brickVoltage110_BMS18 m37 : 39|16@0+ (0.0001,0) [0|6.5] "V"  PT
 SG_ brickVoltage111_BMS18 m37 : 55|16@0+ (0.0001,0) [0|6.5] "V"  PT
 SG_ brickVoltage112_BMS18 m38 : 23|16@0+ (0.0001,0) [0|6.5] "V"  PT
 SG_ brickVoltage113_BMS18 m38 : 39|16@0+ (0.0001,0) [0|6.5] "V"  PT
 SG_ brickVoltage114_BMS18 m38 : 55|16@0+ (0.0001,0) [0|6.5] "V"  PT
 SG_ brickVoltage115_BMS18 m39 : 23|16@0+ (0.0001,0) [0|6.5] "V"  PT
 SG_ brickVoltage116_BMS18 m39 : 39|16@0+ (0.0001,0) [0|6.5] "V"  PT
 SG_ brickVoltage117_BMS18 m39 : 55|16@0+ (0.0001,0) [0|6.5] "V"  PT
 SG_ brickVoltage118_BMS18 m40 : 23|16@0+ (0.0001,0) [0|6.5] "V"  PT
 SG_ brickVoltage119_BMS18 m40 : 39|16@0+ (0.0001,0) [0|6.5] "V"  PT
 SG_ brickVoltage120_BMS18 m40 : 55|16@0+ (0.0001,0) [0|6.5] "V"  PT
 SG_ brickVoltage121_BMS18 m41 : 23|16@0+ (0.0001,0) [0|6.5] "V"  PT
 SG_ brickVoltage122_BMS18 m41 : 39|16@0+ (0.0001,0) [0|6.5] "V"  PT
 SG_ brickVoltage123_BMS18 m41 : 55|16@0+ (0.0001,0) [0|6.5] "V"  PT
 SG_ brickVoltage124_BMS18 m42 : 23|16@0+ (0.0001,0) [0|6.5] "V"  PT
 SG_ brickVoltage125_BMS18 m42 : 39|16@0+ (0.0001,0) [0|6.5] "V"  PT
 SG_ brickVoltage126_BMS18 m42 : 55|16@0+ (0.0001,0) [0|6.5] "V"  PT
 SG_ brickVoltage127_BMS18 m43 : 23|16@0+ (0.0001,0) [0|6.5] "V"  PT
 SG_ brickVoltage128_BMS18 m43 : 39|16@0+ (0.0001,0) [0|6.5] "V"  PT
 SG_ brickVoltage129_BMS18 m43 : 55|16@0+ (0.0001,0) [0|6.5] "V"  PT
 SG_ brickVoltage130_BMS18 m44 : 23|16@0+ (0.0001,0) [0|6.5] "V"  PT
 SG_ brickVoltage131_BMS18 m44 : 39|16@0+ (0.0001,0) [0|6.5] "V"  PT
 SG_ brickVoltage132_BMS18 m44 : 55|16@0+ (0.0001,0) [0|6.5] "V"  PT
 SG_ brickVoltage133_BMS18 m45 : 23|16@0+ (0.0001,0) [0|6.5] "V"  PT
 SG_ brickVoltage134_BMS18 m45 : 39|16@0+ (0.0001,0) [0|6.5] "V"  PT
 SG_ brickVoltage135_BMS18 m45 : 55|16@0+ (0.0001,0) [0|6.5] "V"  PT
 SG_ brickVoltage136_BMS18 m46 : 23|16@0+ (0.0001,0) [0|6.5] "V"  PT
 SG_ brickVoltage137_BMS18 m46 : 39|16@0+ (0.0001,0) [0|6.5] "V"  PT
 SG_ brickVoltage138_BMS18 m46 : 55|16@0+ (0.0001,0) [0|6.5] "V"  PT
 SG_ brickVoltage139_BMS18 m47 : 23|16@0+ (0.0001,0) [0|6.5] "V"  PT
 SG_ brickVoltage140_BMS18 m47 : 39|16@0+ (0.0001,0) [0|6.5] "V"  PT
 SG_ brickVoltage141_BMS18 m47 : 55|16@0+ (0.0001,0) [0|6.5] "V"  PT
 SG_ brickVoltage142_BMS18 m48 : 23|16@0+ (0.0001,0) [0|6.5] "V"  PT
 SG_ brickVoltage143_BMS18 m48 : 39|16@0+ (0.0001,0) [0|6.5] "V"  PT
 SG_ brickVoltage144_BMS18 m48 : 55|16@0+ (0.0001,0) [0|6.5] "V"  PT
 SG_ brickVoltage145_BMS18 m49 : 23|16@0+ (0.0001,0) [0|6.5] "V"  PT
 SG_ brickVoltage146_BMS18 m49 : 39|16@0+ (0.0001,0) [0|6.5] "V"  PT
 SG_ brickVoltage147_BMS18 m49 : 55|16@0+ (0.0001,0) [0|6.5] "V"  PT
 SG_ brickVoltage148_BMS18 m50 : 23|16@0+ (0.0001,0) [0|6.5] "V"  PT
 SG_ brickVoltage149_BMS18 m50 : 39|16@0+ (0.0001,0) [0|6.5] "V"  PT
 SG_ brickVoltage150_BMS18 m50 : 55|16@0+ (0.0001,0) [0|6.5] "V"  PT
 SG_ brickVoltage151_BMS18 m51 : 23|16@0+ (0.0001,0) [0|6.5] "V"  PT
 SG_ brickVoltage152_BMS18 m51 : 39|16@0+ (0.0001,0) [0|6.5] "V"  PT
 SG_ brickVoltage153_BMS18 m51 : 55|16@0+ (0.0001,0) [0|6.5] "V"  PT
 SG_ brickVoltage154_BMS18 m52 : 23|16@0+ (0.0001,0) [0|6.5] "V"  PT
 SG_ brickVoltage155_BMS18 m52 : 39|16@0+ (0.0001,0) [0|6.5] "V"  PT
 SG_ brickVoltage156_BMS18 m52 : 55|16@0+ (0.0001,0) [0|6.5] "V"  PT
 SG_ brickVoltage157_BMS18 m53 : 23|16@0+ (0.0001,0) [0|6.5] "V"  PT
 SG_ brickVoltage158_BMS18 m53 : 39|16@0+ (0.0001,0) [0|6.5] "V"  PT
 SG_ brickVoltage159_BMS18 m53 : 55|16@0+ (0.0001,0) [0|6.5] "V"  PT
 SG_ brickVoltage160_BMS18 m54 : 23|16@0+ (0.0001,0) [0|6.5] "V"  PT
 SG_ brickVoltage161_BMS18 m54 : 39|16@0+ (0.0001,0) [0|6.5] "V"  PT
 SG_ brickVoltage162_BMS18 m54 : 55|16@0+ (0.0001,0) [0|6.5] "V"  PT
 SG_ brickVoltage163_BMS18 m55 : 23|16@0+ (0.0001,0) [0|6.5] "V"  PT
 SG_ brickVoltage164_BMS18 m55 : 39|16@0+ (0.0001,0) [0|6.5] "V"  PT
 SG_ brickVoltage165_BMS18 m55 : 55|16@0+ (0.0001,0) [0|6.5] "V"  PT
 SG_ brickVoltage166_BMS18 m56 : 23|16@0+ (0.0001,0) [0|6.5] "V"  PT
 SG_ brickVoltage167_BMS18 m56 : 39|16@0+ (0.0001,0) [0|6.5] "V"  PT
 SG_ brickVoltage168_BMS18 m56 : 55|16@0+ (0.0001,0) [0|6.5] "V"  PT
 SG_ brickVoltage169_BMS18 m57 : 23|16@0+ (0.0001,0) [0|6.5] "V"  PT
 SG_ brickVoltage170_BMS18 m57 : 39|16@0+ (0.0001,0) [0|6.5] "V"  PT
 SG_ brickVoltage171_BMS18 m57 : 55|16@0+ (0.0001,0) [0|6.5] "V"  PT
 SG_ brickVoltage172_BMS18 m58 : 23|16@0+ (0.0001,0) [0|6.5] "V"  PT
 SG_ brickVoltage173_BMS18 m58 : 39|16@0+ (0.0001,0) [0|6.5] "V"  PT
 SG_ brickVoltage174_BMS18 m58 : 55|16@0+ (0.0001,0) [0|6.5] "V"  PT
 SG_ brickVoltage175_BMS18 m59 : 23|16@0+ (0.0001,0) [0|6.5] "V"  PT
 SG_ brickVoltage176_BMS18 m59 : 39|16@0+ (0.0001,0) [0|6.5] "V"  PT
 SG_ brickVoltage177_BMS18 m59 : 55|16@0+ (0.0001,0) [0|6.5] "V"  PT
 SG_ brickVoltage178_BMS18 m60 : 23|16@0+ (0.0001,0) [0|6.5] "V"  PT
 SG_ brickVoltage179_BMS18 m60 : 39|16@0+ (0.0001,0) [0|6.5] "V"  PT
 SG_ brickVoltage180_BMS18 m60 : 55|16@0+ (0.0001,0) [0|6.5] "V"  PT
 SG_ brickVoltage181_BMS18 m61 : 23|16@0+ (0.0001,0) [0|6.5] "V"  PT
 SG_ brickVoltage182_BMS18 m61 : 39|16@0+ (0.0001,0) [0|6.5] "V"  PT
 SG_ brickVoltage183_BMS18 m61 : 55|16@0+ (0.0001,0) [0|6.5] "V"  PT
 SG_ brickVoltage184_BMS18 m62 : 23|16@0+ (0.0001,0) [0|6.5] "V"  PT
 SG_ brickVoltage185_BMS18 m62 : 39|16@0+ (0.0001,0) [0|6.5] "V"  PT
 SG_ brickVoltage186_BMS18 m62 : 55|16@0+ (0.0001,0) [0|6.5] "V"  PT
 SG_ brickVoltage187_BMS18 m63 : 23|16@0+ (0.0001,0) [0|6.5] "V"  PT
 SG_ brickVoltage188_BMS18 m63 : 39|16@0+ (0.0001,0) [0|6.5] "V"  PT
 SG_ brickVoltage189_BMS18 m63 : 55|16@0+ (0.0001,0) [0|6.5] "V"  PT
 SG_ brickVoltage190_BMS18 m64 : 23|16@0+ (0.0001,0) [0|6.5] "V"  PT
 SG_ brickVoltage191_BMS18 m64 : 39|16@0+ (0.0001,0) [0|6.5] "V"  PT
 SG_ brickVoltage192_BMS18 m64 : 55|16@0+ (0.0001,0) [0|6.5] "V"  PT
 SG_ brickVoltage193_BMS18 m65 : 23|16@0+ (0.0001,0) [0|6.5] "V"  PT
 SG_ brickVoltage194_BMS18 m65 : 39|16@0+ (0.0001,0) [0|6.5] "V"  PT
 SG_ brickVoltage195_BMS18 m65 : 55|16@0+ (0.0001,0) [0|6.5] "V"  PT
 SG_ brickVoltage196_BMS18 m66 : 23|16@0+ (0.0001,0) [0|6.5] "V"  PT
 SG_ brickVoltage197_BMS18 m66 : 39|16@0+ (0.0001,0) [0|6.5] "V"  PT
 SG_ brickVoltage198_BMS18 m66 : 55|16@0+ (0.0001,0) [0|6.5] "V"  PT
 SG_ brickVoltage199_BMS18 m67 : 23|16@0+ (0.0001,0) [0|6.5] "V"  PT
 SG_ brickVoltage200_BMS18 m67 : 39|16@0+ (0.0001,0) [0|6.5] "V"  PT
 SG_ brickVoltage201_BMS18 m67 : 55|16@0+ (0.0001,0) [0|6.5] "V"  PT
 SG_ brickVoltage202_BMS18 m68 : 23|16@0+ (0.0001,0) [0|6.5] "V"  PT
 SG_ brickVoltage203_BMS18 m68 : 39|16@0+ (0.0001,0) [0|6.5] "V"  PT
 SG_ brickVoltage204_BMS18 m68 : 55|16@0+ (0.0001,0) [0|6.5] "V"  PT
 SG_ brickVoltage205_BMS18 m69 : 23|16@0+ (0.0001,0) [0|6.5] "V"  PT
 SG_ brickVoltage206_BMS18 m69 : 39|16@0+ (0.0001,0) [0|6.5] "V"  PT
 SG_ brickVoltage207_BMS18 m69 : 55|16@0+ (0.0001,0) [0|6.5] "V"  PT
 SG_ brickVoltage208_BMS18 m70 : 23|16@0+ (0.0001,0) [0|6.5] "V"  PT
 SG_ brickVoltage209_BMS18 m70 : 39|16@0+ (0.0001,0) [0|6.5] "V"  PT
 SG_ brickVoltage210_BMS18 m70 : 55|16@0+ (0.0001,0) [0|6.5] "V"  PT
 SG_ brickVoltage211_BMS18 m71 : 23|16@0+ (0.0001,0) [0|6.5] "V"  PT
 SG_ brickVoltage212_BMS18 m71 : 39|16@0+ (0.0001,0) [0|6.5] "V"  PT
 SG_ brickVoltage213_BMS18 m71 : 55|16@0+ (0.0001,0) [0|6.5] "V"  PT
 SG_ brickVoltage214_BMS18 m72 : 23|16@0+ (0.0001,0) [0|6.5] "V"  PT
 SG_ brickVoltage215_BMS18 m72 : 39|16@0+ (0.0001,0) [0|6.5] "V"  PT
 SG_ brickVoltage216_BMS18 m72 : 55|16@0+ (0.0001,0) [0|6.5] "V"  PT
 SG_ brickVoltage217_BMS18 m73 : 23|16@0+ (0.0001,0) [0|6.5] "V"  PT
 SG_ brickVoltage218_BMS18 m73 : 39|16@0+ (0.0001,0) [0|6.5] "V"  PT
 SG_ brickVoltage219_BMS18 m73 : 55|16@0+ (0.0001,0) [0|6.5] "V"  PT
 SG_ brickVoltage220_BMS18 m74 : 23|16@0+ (0.0001,0) [0|6.5] "V"  PT
 SG_ brickVoltage221_BMS18 m74 : 39|16@0+ (0.0001,0) [0|6.5] "V"  PT
 SG_ brickVoltage222_BMS18 m74 : 55|16@0+ (0.0001,0) [0|6.5] "V"  PT
 SG_ brickVoltage223_BMS18 m75 : 23|16@0+ (0.0001,0) [0|6.5] "V"  PT
 SG_ brickVoltage224_BMS18 m75 : 39|16@0+ (0.0001,0) [0|6.5] "V"  PT
 SG_ brickVoltage225_BMS18 m75 : 55|16@0+ (0.0001,0) [0|6.5] "V"  PT
 SG_ brickVoltage226_BMS18 m76 : 23|16@0+ (0.0001,0) [0|6.5] "V"  PT
 SG_ brickVoltage227_BMS18 m76 : 39|16@0+ (0.0001,0) [0|6.5] "V"  PT
 SG_ brickVoltage228_BMS18 m76 : 55|16@0+ (0.0001,0) [0|6.5] "V"  PT
 SG_ brickVoltage229_BMS18 m77 : 23|16@0+ (0.0001,0) [0|6.5] "V"  PT
 SG_ brickVoltage230_BMS18 m77 : 39|16@0+ (0.0001,0) [0|6.5] "V"  PT
 SG_ brickVoltage231_BMS18 m77 : 55|16@0+ (0.0001,0) [0|6.5] "V"  PT
 SG_ brickVoltage232_BMS18 m78 : 23|16@0+ (0.0001,0) [0|6.5] "V"  PT
 SG_ brickVoltage233_BMS18 m78 : 39|16@0+ (0.0001,0) [0|6.5] "V"  PT
 SG_ brickVoltage234_BMS18 m78 : 55|16@0+ (0.0001,0) [0|6.5] "V"  PT
 SG_ brickVoltage235_BMS18 m79 : 23|16@0+ (0.0001,0) [0|6.5] "V"  PT
 SG_ brickVoltage236_BMS18 m79 : 39|16@0+ (0.0001,0) [0|6.5] "V"  PT
 SG_ brickVoltage237_BMS18 m79 : 55|16@0+ (0.0001,0) [0|6.5] "V"  PT
 SG_ brickVoltage238_BMS18 m80 : 23|16@0+ (0.0001,0) [0|6.5] "V"  PT
 SG_ brickVoltage239_BMS18 m80 : 39|16@0+ (0.0001,0) [0|6.5] "V"  PT
 SG_ brickVoltage240_BMS18 m80 : 55|16@0+ (0.0001,0) [0|6.5] "V"  PT
 SG_ brickVoltage241_BMS18 m81 : 23|16@0+ (0.0001,0) [0|6.5] "V"  PT
 SG_ brickVoltage242_BMS18 m81 : 39|16@0+ (0.0001,0) [0|6.5] "V"  PT
 SG_ brickVoltage243_BMS18 m81 : 55|16@0+ (0.0001,0) [0|6.5] "V"  PT
 SG_ brickVoltage244_BMS18 m82 : 23|16@0+ (0.0001,0) [0|6.5] "V"  PT
 SG_ brickVoltage245_BMS18 m82 : 39|16@0+ (0.0001,0) [0|6.5] "V"  PT
 SG_ brickVoltage246_BMS18 m82 : 55|16@0+ (0.0001,0) [0|6.5] "V"  PT
 SG_ brickVoltage247_BMS18 m83 : 23|16@0+ (0.0001,0) [0|6.5] "V"  PT
 SG_ brickVoltage248_BMS18 m83 : 39|16@0+ (0.0001,0) [0|6.5] "V"  PT
 SG_ brickVoltage249_BMS18 m83 : 55|16@0+ (0.0001,0) [0|6.5] "V"  PT
 SG_ brickVoltage250_BMS18 m84 : 23|16@0+ (0.0001,0) [0|6.5] "V"  PT
 SG_ brickVoltage251_BMS18 m84 : 39|16@0+ (0.0001,0) [0|6.5] "V"  PT
 SG_ brickVoltage252_BMS18 m84 : 55|16@0+ (0.0001,0) [0|6.5] "V"  PT
 SG_ brickVoltage253_BMS18 m85 : 23|16@0+ (0.0001,0) [0|6.5] "V"  PT
 SG_ brickVoltage254_BMS18 m85 : 39|16@0+ (0.0001,0) [0|6.5] "V"  PT
 SG_ brickVoltage255_BMS18 m85 : 55|16@0+ (0.0001,0) [0|6.5] "V"  PT
 SG_ brickVoltage256_BMS18 m86 : 23|16@0+ (0.0001,0) [0|6.5] "V"  PT
 SG_ brickVoltage257_BMS18 m86 : 39|16@0+ (0.0001,0) [0|6.5] "V"  PT
 SG_ brickVoltage258_BMS18 m86 : 55|16@0+ (0.0001,0) [0|6.5] "V"  PT
 SG_ brickVoltage259_BMS18 m87 : 23|16@0+ (0.0001,0) [0|6.5] "V"  PT
 SG_ brickVoltage260_BMS18 m87 : 39|16@0+ (0.0001,0) [0|6.5] "V"  PT
 SG_ brickVoltage261_BMS18 m87 : 55|16@0+ (0.0001,0) [0|6.5] "V"  PT
 SG_ brickVoltage262_BMS18 m88 : 23|16@0+ (0.0001,0) [0|6.5] "V"  PT
 SG_ brickVoltage263_BMS18 m88 : 39|16@0+ (0.0001,0) [0|6.5] "V"  PT
 SG_ brickVoltage264_BMS18 m88 : 55|16@0+ (0.0001,0) [0|6.5] "V"  PT
 SG_ brickVoltage265_BMS18 m89 : 23|16@0+ (0.0001,0) [0|6.5] "V"  PT
 SG_ brickVoltage266_BMS18 m89 : 39|16@0+ (0.0001,0) [0|6.5] "V"  PT
 SG_ brickVoltage267_BMS18 m89 : 55|16@0+ (0.0001,0) [0|6.5] "V"  PT
 SG_ brickVoltage268_BMS18 m90 : 23|16@0+ (0.0001,0) [0|6.5] "V"  PT
 SG_ brickVoltage269_BMS18 m90 : 39|16@0+ (0.0001,0) [0|6.5] "V"  PT
 SG_ brickVoltage270_BMS18 m90 : 55|16@0+ (0.0001,0) [0|6.5] "V"  PT
 SG_ brickVoltage271_BMS18 m91 : 23|16@0+ (0.0001,0) [0|6.5] "V"  PT
 SG_ brickVoltage272_BMS18 m91 : 39|16@0+ (0.0001,0) [0|6.5] "V"  PT
 SG_ brickVoltage273_BMS18 m91 : 55|16@0+ (0.0001,0) [0|6.5] "V"  PT
 SG_ brickVoltage274_BMS18 m92 : 23|16@0+ (0.0001,0) [0|6.5] "V"  PT
 SG_ brickVoltage275_BMS18 m92 : 39|16@0+ (0.0001,0) [0|6.5] "V"  PT
 SG_ brickVoltage276_BMS18 m92 : 55|16@0+ (0.0001,0) [0|6.5] "V"  PT
 SG_ brickVoltage277_BMS18 m93 : 23|16@0+ (0.0001,0) [0|6.5] "V"  PT
 SG_ brickVoltage278_BMS18 m93 : 39|16@0+ (0.0001,0) [0|6.5] "V"  PT
 SG_ brickVoltage279_BMS18 m93 : 55|16@0+ (0.0001,0) [0|6.5] "V"  PT
 SG_ brickVoltage280_BMS18 m94 : 23|16@0+ (0.0001,0) [0|6.5] "V"  PT
 SG_ brickVoltage281_BMS18 m94 : 39|16@0+ (0.0001,0) [0|6.5] "V"  PT
 SG_ brickVoltage282_BMS18 m94 : 55|16@0+ (0.0001,0) [0|6.5] "V"  PT
 SG_ brickVoltage283_BMS18 m95 : 23|16@0+ (0.0001,0) [0|6.5] "V"  PT
 SG_ brickVoltage284_BMS18 m95 : 39|16@0+ (0.0001,0) [0|6.5] "V"  PT
 SG_ brickVoltage285_BMS18 m95 : 55|16@0+ (0.0001,0) [0|6.5] "V"  PT
 SG_ brickVoltage286_BMS18 m96 : 23|16@0+ (0.0001,0) [0|6.5] "V"  PT
 SG_ brickVoltage287_BMS18 m96 : 39|16@0+ (0.0001,0) [0|6.5] "V"  PT
 SG_ brickVoltage288_BMS18 m96 : 55|16@0+ (0.0001,0) [0|6.5] "V"  PT
 SG_ brickVoltage289_BMS18 m97 : 23|16@0+ (0.0001,0) [0|6.5] "V"  PT
 SG_ brickVoltage290_BMS18 m97 : 39|16@0+ (0.0001,0) [0|6.5] "V"  PT
 SG_ brickVoltage291_BMS18 m97 : 55|16@0+ (0.0001,0) [0|6.5] "V"  PT
 SG_ brickVoltage292_BMS18 m98 : 23|16@0+ (0.0001,0) [0|6.5] "V"  PT
 SG_ brickVoltage293_BMS18 m98 : 39|16@0+ (0.0001,0) [0|6.5] "V"  PT
 SG_ brickVoltage294_BMS18 m98 : 55|16@0+ (0.0001,0) [0|6.5] "V"  PT
 SG_ brickVoltage295_BMS18 m99 : 23|16@0+ (0.0001,0) [0|6.5] "V"  PT
 SG_ brickVoltage296_BMS18 m99 : 39|16@0+ (0.0001,0) [0|6.5] "V"  PT
 SG_ brickVoltage297_BMS18 m99 : 55|16@0+ (0.0001,0) [0|6.5] "V"  PT
 SG_ brickVoltage298_BMS18 m100 : 23|16@0+ (0.0001,0) [0|6.5] "V"  PT
 SG_ brickVoltage299_BMS18 m100 : 39|16@0+ (0.0001,0) [0|6.5] "V"  PT
 SG_ brickVoltage300_BMS18 m100 : 55|16@0+ (0.0001,0) [0|6.5] "V"  PT
 SG_ moduleTemperature33_BMS18 m33 : 15|8@0+ (1,-40) [-40|200] "C"  PT
 SG_ moduleTemperature34_BMS18 m34 : 15|8@0+ (1,-40) [-40|200] "C"  PT
 SG_ moduleTemperature35_BMS18 m35 : 15|8@0+ (1,-40) [-40|200] "C"  PT
 SG_ moduleTemperature36_BMS18 m36 : 15|8@0+ (1,-40) [-40|200] "C"  PT
 SG_ moduleTemperature37_BMS18 m37 : 15|8@0+ (1,-40) [-40|200] "C"  PT
 SG_ moduleTemperature38_BMS18 m38 : 15|8@0+ (1,-40) [-40|200] "C"  PT
 SG_ moduleTemperature39_BMS18 m39 : 15|8@0+ (1,-40) [-40|200] "C"  PT
 SG_ moduleTemperature40_BMS18 m40 : 15|8@0+ (1,-40) [-40|200] "C"  PT
 SG_ moduleTemperature41_BMS18 m41 : 15|8@0+ (1,-40) [-40|200] "C"  PT
 SG_ moduleTemperature42_BMS18 m42 : 15|8@0+ (1,-40) [-40|200] "C"  PT
 SG_ moduleTemperature43_BMS18 m43 : 15|8@0+ (1,-40) [-40|200] "C"  PT
 SG_ moduleTemperature44_BMS18 m44 : 15|8@0+ (1,-40) [-40|200] "C"  PT
 SG_ moduleTemperature45_BMS18 m45 : 15|8@0+ (1,-40) [-40|200] "C"  PT
 SG_ moduleTemperature46_BMS18 m46 : 15|8@0+ (1,-40) [-40|200] "C"  PT
 SG_ moduleTemperature47_BMS18 m47 : 15|8@0+ (1,-40) [-40|200] "C"  PT
 SG_ moduleTemperature48_BMS18 m48 : 15|8@0+ (1,-40) [-40|200] "C"  PT
 SG_ moduleTemperature49_BMS18 m49 : 15|8@0+ (1,-40) [-40|200] "C"  PT
 SG_ moduleTemperature50_BMS18 m50 : 15|8@0+ (1,-40) [-40|200] "C"  PT
 SG_ moduleTemperature51_BMS18 m51 : 15|8@0+ (1,-40) [-40|200] "C"  PT
 SG_ moduleTemperature52_BMS18 m52 : 15|8@0+ (1,-40) [-40|200] "C"  PT
 SG_ moduleTemperature53_BMS18 m53 : 15|8@0+ (1,-40) [-40|200] "C"  PT
 SG_ moduleTemperature54_BMS18 m54 : 15|8@0+ (1,-40) [-40|200] "C"  PT
 SG_ moduleTemperature55_BMS18 m55 : 15|8@0+ (1,-40) [-40|200] "C"  PT
 SG_ moduleTemperature56_BMS18 m56 : 15|8@0+ (1,-40) [-40|200] "C"  PT
 SG_ moduleTemperature57_BMS18 m57 : 15|8@0+ (1,-40) [-40|200] "C"  PT
 SG_ moduleTemperature58_BMS18 m58 : 15|8@0+ (1,-40) [-40|200] "C"  PT
 SG_ moduleTemperature59_BMS18 m59 : 15|8@0+ (1,-40) [-40|200] "C"  PT
 SG_ moduleTemperature60_BMS18 m60 : 15|8@0+ (1,-40) [-40|200] "C"  PT
 SG_ moduleTemperature61_BMS18 m61 : 15|8@0+ (1,-40) [-40|200] "C"  PT
 SG_ moduleTemperature62_BMS18 m62 : 15|8@0+ (1,-40) [-40|200] "C"  PT
 SG_ moduleTemperature63_BMS18 m63 : 15|8@0+ (1,-40) [-40|200] "C"  PT
 SG_ moduleTemperature64_BMS18 m64 : 15|8@0+ (1,-40) [-40|200] "C"  PT
 SG_ moduleTemperature65_BMS18 m65 : 15|8@0+ (1,-40) [-40|200] "C"  PT
 SG_ moduleTemperature66_BMS18 m66 : 15|8@0+ (1,-40) [-40|200] "C"  PT
 SG_ moduleTemperature67_BMS18 m67 : 15|8@0+ (1,-40) [-40|200] "C"  PT
 SG_ moduleTemperature68_BMS18 m68 : 15|8@0+ (1,-40) [-40|200] "C"  PT
 SG_ moduleTemperature69_BMS18 m69 : 15|8@0+ (1,-40) [-40|200] "C"  PT
 SG_ moduleTemperature70_BMS18 m70 : 15|8@0+ (1,-40) [-40|200] "C"  PT
 SG_ moduleTemperature71_BMS18 m71 : 15|8@0+ (1,-40) [-40|200] "C"  PT
 SG_ moduleTemperature72_BMS18 m72 : 15|8@0+ (1,-40) [-40|200] "C"  PT
 SG_ moduleTemperature73_BMS18 m73 : 15|8@0+ (1,-40) [-40|200] "C"  PT
 SG_ moduleTemperature74_BMS18 m74 : 15|8@0+ (1,-40) [-40|200] "C"  PT
 SG_ moduleTemperature75_BMS18 m75 : 15|8@0+ (1,-40) [-40|200] "C"  PT
 SG_ moduleTemperature76_BMS18 m76 : 15|8@0+ (1,-40) [-40|200] "C"  PT
 SG_ moduleTemperature77_BMS18 m77 : 15|8@0+ (1,-40) [-40|200] "C"  PT
 SG_ moduleTemperature78_BMS18 m78 : 15|8@0+ (1,-40) [-40|200] "C"  PT
 SG_ moduleTemperature79_BMS18 m79 : 15|8@0+ (1,-40) [-40|200] "C"  PT
 SG_ moduleTemperature80_BMS18 m80 : 15|8@0+ (1,-40) [-40|200] "C"  PT
 SG_ moduleTemperature81_BMS18 m81 : 15|8@0+ (1,-40) [-40|200] "C"  PT
 SG_ moduleTemperature82_BMS18 m82 : 15|8@0+ (1,-40) [-40|200] "C"  PT
 SG_ moduleTemperature83_BMS18 m83 : 15|8@0+ (1,-40) [-40|200] "C"  PT
 SG_ moduleTemperature84_BMS18 m84 : 15|8@0+ (1,-40) [-40|200] "C"  PT
 SG_ moduleTemperature85_BMS18 m85 : 15|8@0+ (1,-40) [-40|200] "C"  PT
 SG_ moduleTemperature86_BMS18 m86 : 15|8@0+ (1,-40) [-40|200] "C"  PT
 SG_ moduleTemperature87_BMS18 m87 : 15|8@0+ (1,-40) [-40|200] "C"  PT
 SG_ moduleTemperature88_BMS18 m88 : 15|8@0+ (1,-40) [-40|200] "C"  PT
 SG_ moduleTemperature89_BMS18 m89 : 15|8@0+ (1,-40) [-40|200] "C"  PT
 SG_ moduleTemperature90_BMS18 m90 : 15|8@0+ (1,-40) [-40|200] "C"  PT
 SG_ moduleTemperature91_BMS18 m91 : 15|8@0+ (1,-40) [-40|200] "C"  PT
 SG_ moduleTemperature92_BMS18 m92 : 15|8@0+ (1,-40) [-40|200] "C"  PT
 SG_ moduleTemperature93_BMS18 m93 : 15|8@0+ (1,-40) [-40|200] "C"  PT
 SG_ moduleTemperature94_BMS18 m94 : 15|8@0+ (1,-40) [-40|200] "C"  PT
 SG_ moduleTemperature95_BMS18 m95 : 15|8@0+ (1,-40) [-40|200] "C"  PT
 SG_ moduleTemperature96_BMS18 m96 : 15|8@0+ (1,-40) [-40|200] "C"  PT
 SG_ moduleTemperature97_BMS18 m97 : 15|8@0+ (1,-40) [-40|200] "C"  PT
 SG_ moduleTemperature98_BMS18 m98 : 15|8@0+ (1,-40) [-40|200] "C"  PT
 SG_ moduleTemperature99_BMS18 m99 : 15|8@0+ (1,-40) [-40|200] "C"  PT
 SG_ moduleTemperature100_BMS18 m100 : 15|8@0+ (1,-40) [-40|200] "C"  PT
 SG_ moduleTemperature101_BMS18 m101 : 15|8@0+ (1,-40) [-40|200] "C"  PT
 SG_ moduleTemperature102_BMS18 m102 : 15|8@0+ (1,-40) [-40|200] "C"  PT
 SG_ moduleTemperature103_BMS18 m103 : 15|8@0+ (1,-40) [-40|200] "C"  PT
 SG_ moduleTemperature104_BMS18 m104 : 15|8@0+ (1,-40) [-40|200] "C"  PT
 SG_ moduleTemperature105_BMS18 m105 : 15|8@0+ (1,-40) [-40|200] "C"  PT
 SG_ moduleTemperature106_BMS18 m106 : 15|8@0+ (1,-40) [-40|200] "C"  PT
 SG_ moduleTemperature107_BMS18 m107 : 15|8@0+ (1,-40) [-40|200] "C"  PT
 SG_ moduleTemperature108_BMS18 m108 : 15|8@0+ (1,-40) [-40|200] "C"  PT
 SG_ moduleTemperature109_BMS18 m109 : 15|8@0+ (1,-40) [-40|200] "C"  PT
 SG_ moduleTemperature110_BMS18 m110 : 15|8@0+ (1,-40) [-40|200] "C"  PT
 SG_ moduleTemperature111_BMS18 m111 : 15|8@0+ (1,-40) [-40|200] "C"  PT
 SG_ moduleTemperature112_BMS18 m112 : 15|8@0+ (1,-40) [-40|200] "C"  PT
 SG_ moduleTemperature113_BMS18 m113 : 15|8@0+ (1,-40) [-40|200] "C"  PT
 SG_ moduleTemperature114_BMS18 m114 : 15|8@0+ (1,-40) [-40|200] "C"  PT
 SG_ moduleTemperature115_BMS18 m115 : 15|8@0+ (1,-40) [-40|200] "C"  PT
 SG_ moduleTemperature116_BMS18 m116 : 15|8@0+ (1,-40) [-40|200] "C"  PT
 SG_ moduleTemperature117_BMS18 m117 : 15|8@0+ (1,-40) [-40|200] "C"  PT
 SG_ moduleTemperature118_BMS18 m118 : 15|8@0+ (1,-40) [-40|200] "C"  PT
 SG_ moduleTemperature119_BMS18 m119 : 15|8@0+ (1,-40) [-40|200] "C"  PT
 SG_ moduleTemperature120_BMS18 m120 : 15|8@0+ (1,-40) [-40|200] "C"  PT
 SG_ moduleTemperature121_BMS18 m121 : 15|8@0+ (1,-40) [-40|200] "C"  PT
 SG_ moduleTemperature122_BMS18 m122 : 15|8@0+ (1,-40) [-40|200] "C"  PT
 SG_ moduleTemperature123_BMS18 m123 : 15|8@0+ (1,-40) [-40|200] "C"  PT
 SG_ moduleTemperature124_BMS18 m124 : 15|8@0+ (1,-40) [-40|200] "C"  PT
 SG_ moduleTemperature125_BMS18 m125 : 15|8@0+ (1,-40) [-40|200] "C"  PT
 SG_ moduleTemperature126_BMS18 m126 : 15|8@0+ (1,-40) [-40|200] "C"  PT
 SG_ moduleTemperature127_BMS18 m127 : 15|8@0+ (1,-40) [-40|200] "C"  PT
 SG_ moduleTemperature128_BMS18 m128 : 15|8@0+ (1,-40) [-40|200] "C"  PT
 SG_ moduleTemperature129_BMS18 m129 : 15|8@0+ (1,-40) [-40|200] "C"  PT
 SG_ moduleTemperature130_BMS18 m130 : 15|8@0+ (1,-40) [-40|200] "C"  PT
 SG_ moduleTemperature131_BMS18 m131 : 15|8@0+ (1,-40) [-40|200] "C"  PT
 SG_ moduleTemperature132_BMS18 m132 : 15|8@0+ (1,-40) [-40|200] "C"  PT
 SG_ moduleTemperature133_BMS18 m133 : 15|8@0+ (1,-40) [-40|200] "C"  PT
 SG_ moduleTemperature134_BMS18 m134 : 15|8@0+ (1,-40) [-40|200] "C"  PT
 SG_ moduleTemperature135_BMS18 m135 : 15|8@0+ (1,-40) [-40|200] "C"  PT
 SG_ moduleTemperature136_BMS18 m136 : 15|8@0+ (1,-40) [-40|200] "C"  PT
 SG_ moduleTemperature137_BMS18 m137 : 15|8@0+ (1,-40) [-40|200] "C"  PT
 SG_ moduleTemperature138_BMS18 m138 : 15|8@0+ (1,-40) [-40|200] "C"  PT
 SG_ moduleTemperature139_BMS18 m139 : 15|8@0+ (1,-40) [-40|200] "C"  PT
 SG_ moduleTemperature140_BMS18 m140 : 15|8@0+ (1,-40) [-40|200] "C"  PT
 SG_ moduleTemperature141_BMS18 m141 : 15|8@0+ (1,-40) [-40|200] "C"  PT
 SG_ moduleTemperature142_BMS18 m142 : 15|8@0+ (1,-40) [-40|200] "C"  PT
 SG_ moduleTemperature143_BMS18 m143 : 15|8@0+ (1,-40) [-40|200] "C"  PT
 SG_ moduleTemperature144_BMS18 m144 : 15|8@0+ (1,-40) [-40|200] "C"  PT
 SG_ moduleTemperature145_BMS18 m145 : 15|8@0+ (1,-40) [-40|200] "C"  PT
 SG_ moduleTemperature146_BMS18 m146 : 15|8@0+ (1,-40) [-40|200] "C"  PT
 SG_ moduleTemperature147_BMS18 m147 : 15|8@0+ (1,-40) [-40|200] "C"  PT
 SG_ moduleTemperature148_BMS18 m148 : 15|8@0+ (1,-40) [-40|200] "C"  PT
 SG_ moduleTemperature149_BMS18 m149 : 15|8@0+ (1,-40) [-40|200] "C"  PT
 SG_ moduleTemperature150_BMS18 m150 : 15|8@0+ (1,-40) [-40|200] "C"  PT
 SG_ moduleTemperature151_BMS18 m151 : 15|8@0+ (1,-40) [-40|200] "C"  PT
 SG_ moduleTemperature152_BMS18 m152 : 15|8@0+ (1,-40) [-40|200] "C"  PT
 SG_ moduleTemperature153_BMS18 m153 : 15|8@0+ (1,-40) [-40|200] "C"  PT
 SG_ moduleTemperature154_BMS18 m154 : 15|8@0+ (1,-40) [-40|200] "C"  PT
 SG_ moduleTemperature155_BMS18 m155 : 15|8@0+ (1,-40) [-40|200] "C"  PT
 SG_ moduleTemperature156_BMS18 m156 : 15|8@0+ (1,-40) [-40|200] "C"  PT
 SG_ moduleTemperature157_BMS18 m157 : 15|8@0+ (1,-40) [-40|200] "C"  PT
 SG_ moduleTemperature158_BMS18 m158 : 15|8@0+ (1,-40) [-40|200] "C"  PT
 SG_ moduleTemperature159_BMS18 m159 : 15|8@0+ (1,-40) [-40|200] "C"  PT
 SG_ moduleTemperature160_BMS18 m160 : 15|8@0+ (1,-40) [-40|200] "C"  PT
 SG_ moduleTemperature161_BMS18 m161 : 15|8@0+ (1,-40) [-40|200] "C"  PT
 SG_ moduleTemperature162_BMS18 m162 : 15|8@0+ (1,-40) [-40|200] "C"  PT
 SG_ moduleTemperature163_BMS18 m163 : 15|8@0+ (1,-40) [-40|200] "C"  PT
 SG_ moduleTemperature164_BMS18 m164 : 15|8@0+ (1,-40) [-40|200] "C"  PT
 SG_ moduleTemperature165_BMS18 m165 : 15|8@0+ (1,-40) [-40|200] "C"  PT
 SG_ moduleTemperature166_BMS18 m166 : 15|8@0+ (1,-40) [-40|200] "C"  PT
 SG_ moduleTemperature167_BMS18 m167 : 15|8@0+ (1,-40) [-40|200] "C"  PT
 SG_ moduleTemperature168_BMS18 m168 : 15|8@0+ (1,-40) [-40|200] "C"  PT
 SG_ moduleTemperature169_BMS18 m169 : 15|8@0+ (1,-40) [-40|200] "C"  PT
 SG_ moduleTemperature170_BMS18 m170 : 15|8@0+ (1,-40) [-40|200] "C"  PT
 SG_ moduleTemperature171_BMS18 m171 : 15|8@0+ (1,-40) [-40|200] "C"  PT
 SG_ moduleTemperature172_BMS18 m172 : 15|8@0+ (1,-40) [-40|200] "C"  PT
 SG_ moduleTemperature173_BMS18 m173 : 15|8@0+ (1,-40) [-40|200] "C"  PT
 SG_ moduleTemperature174_BMS18 m174 : 15|8@0+ (1,-40) [-40|200] "C"  PT
 SG_ moduleTemperature175_BMS18 m175 : 15|8@0+ (1,-40) [-40|200] "C"  PT
 SG_ moduleTemperature176_BMS18 m176 : 15|8@0+ (1,-40) [-40|200] "C"  PT
 SG_ moduleTemperature177_BMS18 m177 : 15|8@0+ (1,-40) [-40|200] "C"  PT
 SG_ moduleTemperature178_BMS18 m178 : 15|8@0+ (1,-40) [-40|200] "C"  PT
 SG_ moduleTemperature179_BMS18 m179 : 15|8@0+ (1,-40) [-40|200] "C"  PT
 SG_ moduleTemperature180_BMS18 m180 : 15|8@0+ (1,-40) [-40|200] "C"  PT
 SG_ moduleTemperature181_BMS18 m181 : 15|8@0+ (1,-40) [-40|200] "C"  PT
 SG_ moduleTemperature182_BMS18 m182 : 15|8@0+ (1,-40) [-40|200] "C"  PT
 SG_ moduleTemperature183_BMS18 m183 : 15|8@0+ (1,-40) [-40|200] "C"  PT
 SG_ moduleTemperature184_BMS18 m184 : 15|8@0+ (1,-40) [-40|200] "C"  PT
 SG_ moduleTemperature185_BMS18 m185 : 15|8@0+ (1,-40) [-40|200] "C"  PT
 SG_ moduleTemperature186_BMS18 m186 : 15|8@0+ (1,-40) [-40|200] "C"  PT
 SG_ moduleTemperature187_BMS18 m187 : 15|8@0+ (1,-40) [-40|200] "C"  PT
 SG_ moduleTemperature188_BMS18 m188 : 15|8@0+ (1,-40) [-40|200] "C"  PT
 SG_ moduleTemperature189_BMS18 m189 : 15|8@0+ (1,-40) [-40|200] "C"  PT
 SG_ moduleTemperature190_BMS18 m190 : 15|8@0+ (1,-40) [-40|200] "C"  PT
 SG_ moduleTemperature191_BMS18 m191 : 15|8@0+ (1,-40) [-40|200] "C"  PT
 SG_ moduleTemperature192_BMS18 m192 : 15|8@0+ (1,-40) [-40|200] "C"  PT

BO_ 916 BMS21_DebugEventMap10: 8 BMS21
 SG_ DEM319_HV_DISABLE_DURING_S_BMS21 : 55|2@0+ (1,0) [0|3] ""  PT
 SG_ DEM318_HV_ENABLE_IMPLAUSIB_BMS21 : 53|2@0+ (1,0) [0|3] ""  PT
 SG_ DEM317_STRING_SUSPECT_OPEN_BMS21 : 51|2@0+ (1,0) [0|3] ""  PT
 SG_ DEM316_UNEXPCTD_BMS_ON_CAN_BMS21 : 49|2@0+ (1,0) [0|3] ""  PT
 SG_ DEM315_HV_WITHSTAND_TESTS__BMS21 : 63|2@0+ (1,0) [0|3] ""  PT
 SG_ DEM314_OBC_PILOT_ERROR_BMS21 : 61|2@0+ (1,0) [0|3] ""  PT
 SG_ DEM313_OBC_PILOT_HIGH_BMS21 : 59|2@0+ (1,0) [0|3] ""  PT
 SG_ DEM312_OBC_PROXIMITY_ERROR_BMS21 : 57|2@0+ (1,0) [0|3] ""  PT
 SG_ DEM311_CTRS_END_OF_LIFE_WA_BMS21 : 39|2@0+ (1,0) [0|3] ""  PT
 SG_ DEM310_BMSMIA_STRNGMSTR_AL_BMS21 : 37|2@0+ (1,0) [0|3] ""  PT
 SG_ DEM309_VOLTAGE_BRICKOV_WAR_BMS21 : 35|2@0+ (1,0) [0|3] ""  PT
 SG_ DEM308_PRESSURE_FLT_BMS21 : 33|2@0+ (1,0) [0|3] ""  PT
 SG_ DEM307_PRESSURE_MIA_BMS21 : 47|2@0+ (1,0) [0|3] ""  PT
 SG_ DEM306_SW_VERSION_MISMATCH_BMS21 : 45|2@0+ (1,0) [0|3] ""  PT
 SG_ DEM305_MODULET_OVERTEMP_WA_BMS21 : 43|2@0+ (1,0) [0|3] ""  PT
 SG_ DEM304_PCHG_OPENCIRCUIT_IN_BMS21 : 41|2@0+ (1,0) [0|3] ""  PT
 SG_ DEM303_MODULET_UNDERTEMP_W_BMS21 : 23|2@0+ (1,0) [0|3] ""  PT
 SG_ DEM302_MODULET_UT_BMS21 : 21|2@0+ (1,0) [0|3] ""  PT
 SG_ DEM301_FUSI_LOCK_BMS21 : 19|2@0+ (1,0) [0|3] ""  PT
 SG_ DEM300_DEBUG_SM_DISABLED_BMS21 : 17|2@0+ (1,0) [0|3] ""  PT
 SG_ DEM299_5V_SENSOR_SUPPLY_OU_BMS21 : 31|2@0+ (1,0) [0|3] ""  PT
 SG_ DEM298_IMPL_DRIVE_REQUEST_BMS21 : 29|2@0+ (1,0) [0|0] ""  PT
 SG_ DEM297_PCHG2_OPENCIRCUIT_BMS21 : 27|2@0+ (1,0) [0|0] ""  PT
 SG_ DEM296_CTRSAUX_IMPLAUSIBLE_BMS21 : 25|2@0+ (1,0) [0|0] ""  PT
 SG_ DEM295_CTRSAUX_LINKV_UNSAF_BMS21 : 7|2@0+ (1,0) [0|0] ""  PT
 SG_ DEM294_CANRX_PT_EMERGENCY_BMS21 : 5|2@0+ (1,0) [0|0] ""  PT
 SG_ DEM293_SBC_LDT_IMPLAUSIBLE_BMS21 : 3|2@0+ (1,0) [0|0] ""  PT
 SG_ DEM292_NUM_EXPECTED_STRING_BMS21 : 1|2@0+ (1,0) [0|0] ""  PT
 SG_ DEM291_NUM_EXPECTED_STRING_BMS21 : 15|2@0+ (1,0) [0|0] ""  PT
 SG_ DEM290_CMB_ONBOARD_DEFECT_BMS21 : 13|2@0+ (1,0) [0|0] ""  PT
 SG_ DEM289_TEMP_STATE_LATCHED_BMS21 : 11|2@0+ (1,0) [0|0] ""  PT
 SG_ DEM288_CURR_STATE_LATCHED_BMS21 : 9|2@0+ (1,0) [0|0] ""  PT

BO_ 980 BMS21_DebugSlowMpex2: 8 BMS21
 SG_ balancingInDriveTimer_BMS21 m18 : 15|16@0+ (1,0) [0|65535] "s"  PT
 SG_ SOCRestPolarization_BMS21 m11 : 63|8@0+ (0.002,0) [0|0.51] "V"  PT
 SG_ CoolantSensorState_BMS21 m1 : 51|2@0+ (1,0) [0|1] ""  PT
 SG_ temperatureModelOffset_BMS21 m7 : 15|8@0+ (0.1,0) [0|25.5] "C"  PT
 SG_ SOHCMinBrickHighEst_BMS21 m4 : 15|8@0+ (0.3,50) [50|126.5] "PCT"  PT
 SG_ SOHCMaxBrickHighEst_BMS21 m6 : 15|8@0+ (0.3,50) [50|126.5] "PCT"  PT
 SG_ regenCurrOpLkyBktThrs1_BMS21 m17 : 63|8@0+ (0.5,0) [0|127.5] "PCT"  PT
 SG_ dischargeCurrOpLkyBktThrs1_BMS21 m10 : 15|8@0+ (0.5,0) [0|127.5] "PCT"  PT
 SG_ regenCurrentOpLoadValue_BMS21 m16 : 15|8@0+ (0.5,0) [0|127.5] "PCT"  PT
 SG_ dischargeCurrOpLoadValue_BMS21 m15 : 15|8@0+ (0.5,0) [0|127.5] "PCT"  PT
 SG_ minBrickVoltageLimit_BMS21 m16 : 55|16@0+ (0.0001,0) [0|6.5535] "V"  PT
 SG_ SOHSuitableOCVRecal_BMS21 m1 : 49|1@0+ (1,0) [0|1] ""  PT
 SG_ currentModule3Integral_BMS21 m17 : 47|16@0+ (100,-3200000) [-3200000|3353500] "As"  PT
 SG_ currentModule2Integral_BMS21 m17 : 31|16@0+ (100,-3200000) [-3200000|3353500] "As"  PT
 SG_ currentModule1Integral_BMS21 m17 : 15|16@0+ (100,-3200000) [-3200000|3353500] "As"  PT
 SG_ currentModuleMin_BMS21 m16 : 23|16@0+ (0.1,-3200) [-3200|3200] "A"  PT
 SG_ currentModuleMax_BMS21 m16 : 39|16@0+ (0.1,-3200) [-3200|3200] "A"  PT
 SG_ maxBrickVoltageSync_BMS21 m9 : 39|16@0+ (0.0001,0) [0|6.5] "V"  PT
 SG_ minBrickVoltageSync_BMS21 m9 : 55|16@0+ (0.0001,0) [0|6.5] "V"  PT
 SG_ SOHCMinBrickLowEst_BMS21 m8 : 15|8@0+ (0.3,50) [50|126.5] "PCT"  PT
 SG_ SOHCMaxBrickLowEst_BMS21 m9 : 15|8@0+ (0.3,50) [50|126.5] "PCT"  PT
 SG_ gradLimSOC_BMS21 m10 : 39|16@0+ (0.002,0) [0|131.07] "PCT"  PT
 SG_ SOCRecalSlowOp_BMS21 m14 : 55|16@0+ (0.0001,-2) [-2|4.5535] "V"  PT
 SG_ SOHCMinIndex_BMS21 m12 : 39|16@0+ (1,0) [0|65535] ""  PT
 SG_ SOHCMaxIndex_BMS21 m12 : 55|16@0+ (1,0) [0|65535] ""  PT
 SG_ SOHRMinRegen_BMS21 m11 : 39|8@0+ (1,50) [50|305] "PCT"  PT
 SG_ SOHRMinDchg_BMS21 m11 : 15|8@0+ (1,50) [50|305] "PCT"  PT
 SG_ SOHRMeanRegen_BMS21 m11 : 47|8@0+ (1,50) [50|305] "PCT"  PT
 SG_ SOHRMeanDchg_BMS21 m11 : 23|8@0+ (1,50) [50|305] "PCT"  PT
 SG_ SOHRMaxRegen_BMS21 m11 : 55|8@0+ (1,50) [50|305] "PCT"  PT
 SG_ SOHRMaxDchg_BMS21 m11 : 31|8@0+ (1,50) [50|305] "PCT"  PT
 SG_ SOHCMin_BMS21 m12 : 15|8@0+ (0.3,50) [50|126.5] "PCT"  PT
 SG_ SOHCMean_BMS21 m12 : 23|8@0+ (0.3,50) [50|126.5] "PCT"  PT
 SG_ SOHCMax_BMS21 m12 : 31|8@0+ (0.3,50) [50|126.5] "PCT"  PT
 SG_ ppRegenCurrLimitPredShort_BMS21 m6 : 23|8@0+ (2,0) [0|510] "A"  PT
 SG_ ppRegenCurrLimitPredLong_BMS21 m6 : 31|8@0+ (2,0) [0|510] "A"  PT
 SG_ ppDchgCurrLimitPredShort_BMS21 m13 : 55|8@0+ (2,-510) [-510|0] "A"  PT
 SG_ ppDchgCurrLimitPredLong_BMS21 m13 : 63|8@0+ (2,-510) [-510|0] "A"  PT
 SG_ ppInconsistentPol_BMS21 m1 : 48|1@0+ (1,0) [0|0] ""  PT
 SG_ ppPolarizationV_BMS21 m3 : 55|16@0+ (0.0001,-3) [-3|3.5535] "V"  PT
 SG_ SOCRecalMinOCVEst_BMS21 m13 : 39|16@0+ (0.0001,0) [0|6.5535] "V"  PT
 SG_ SOCRecalMaxOCVEst_BMS21 m14 : 39|16@0+ (0.0001,0) [0|6.5535] "V"  PT
 SG_ SOCRecalMinSOCUpp_BMS21 m13 : 31|8@0+ (0.5,0) [0|127.5] "PCT"  PT
 SG_ SOCRecalMinSOCLow_BMS21 m13 : 15|8@0+ (0.5,0) [0|127.5] "PCT"  PT
 SG_ SOCRecalMinSOC_BMS21 m13 : 23|8@0+ (0.5,0) [0|127.5] "PCT"  PT
 SG_ SOCRecalMaxSOCUpp_BMS21 m14 : 31|8@0+ (0.5,0) [0|127.5] "PCT"  PT
 SG_ SOCRecalMaxSOCLow_BMS21 m14 : 15|8@0+ (0.5,0) [0|127.5] "PCT"  PT
 SG_ SOCRecalMaxSOC_BMS21 m14 : 23|8@0+ (0.5,0) [0|127.5] "PCT"  PT
 SG_ ppNewtonRootInRangeRegen_BMS21 m5 : 12|1@0+ (1,0) [0|0] ""  PT
 SG_ ppNewtonRootInRangeDchg_BMS21 m5 : 8|1@0+ (1,0) [0|0] ""  PT
 SG_ ppNewtonStepsRegen_BMS21 m5 : 15|3@0+ (1,0) [0|1] ""  PT
 SG_ ppNewtonStepsDchg_BMS21 m5 : 11|3@0+ (1,0) [0|1] ""  PT
 SG_ ppNewtonRegenVRes_BMS21 m5 : 31|8@0+ (0.001,-0.1) [-0.1|0.155] "V"  PT
 SG_ ppNewtonDchgVRes_BMS21 m5 : 23|8@0+ (0.001,-0.1) [-0.1|0.155] "V"  PT
 SG_ ppMinModelAlphaTarget_BMS21 m3 : 15|8@0+ (0.02,0) [0|5.1] ""  PT
 SG_ ppMaxModelAlphaTarget_BMS21 m1 : 63|8@0+ (0.02,0) [0|5.1] ""  PT
 SG_ ppLearningTauRegen_BMS21 m2 : 55|16@0+ (0.2,0) [0|0] "s"  PT
 SG_ ppLearningCriterionDyn_BMS21 m2 : 15|8@0+ (0.005,0) [0|0] ""  PT
 SG_ ppLearningCriterionAbs_BMS21 m1 : 15|8@0+ (0.005,0) [0|0] ""  PT
 SG_ ppLearningCriterionJoin_BMS21 m0 : 15|8@0+ (0.005,0) [0|0] ""  PT
 SG_ ppMaxModelMeasV_BMS21 m7 : 23|16@0+ (0.0001,0) [0|6.5535] "V"  PT
 SG_ currentRedundant_BMS21 m15 : 23|16@0+ (0.1,-3200) [-3200|3200] "A"  PT
 SG_ currentModule3_BMS21 m10 : 55|16@0+ (0.1,-3200) [-3200|3200] "A"  PT
 SG_ currentModule2_BMS21 m10 : 23|16@0+ (0.1,-3200) [-3200|3200] "A"  PT
 SG_ currentModule1_BMS21 m9 : 23|16@0+ (0.1,-3200) [-3200|3200] "A"  PT
 SG_ ppMeanRegenIntRes_BMS21 m6 : 55|16@0+ (0.01,0) [0|655.35] "mOhm"  PT
 SG_ ppMeanDchgIntRes_BMS21 m6 : 39|16@0+ (0.01,0) [0|655.35] "mOhm"  PT
 SG_ ppMinModelVoltageIndex_BMS21 m5 : 39|16@0+ (1,0) [0|65535] ""  PT
 SG_ ppMinModelLowpassV_BMS21 m4 : 55|16@0+ (0.0001,0) [0|0] "V"  PT
 SG_ ppMaxModelVoltageIndex_BMS21 m5 : 55|16@0+ (1,0) [0|65535] ""  PT
 SG_ ppMaxModelLowpassV_BMS21 m7 : 55|16@0+ (0.0001,0) [0|0] "V"  PT
 SG_ ppLearningTauDischarge_BMS21 m0 : 55|16@0+ (0.2,0) [0|0] "s"  PT
 SG_ ppMaxRegenAlpha_BMS21 m15 : 39|16@0+ (0.0001,0) [0|6.5535] ""  PT
 SG_ ppMaxModelledV_BMS21 m7 : 39|16@0+ (0.0001,0) [0|6.5535] "V"  PT
 SG_ ppMinDchgAlpha_BMS21 m15 : 55|16@0+ (0.0001,0) [0|6.5535] ""  PT
 SG_ ppMinModelledV_BMS21 m4 : 39|16@0+ (0.0001,0) [0|6.5535] "V"  PT
 SG_ ppMinModelMeasV_BMS21 m4 : 23|16@0+ (0.0001,0) [0|6.5535] "V"  PT
 SG_ debugSlowMpex2_BMS21 M : 7|8@0+ (1,0) [0|0] ""  PT
 SG_ ppRegenCurrPredShort_BMS21 m2 : 23|16@0+ (0.02,0) [0|1310.7] "A"  PT
 SG_ ppDischgCurrPredLong_BMS21 m0 : 39|16@0+ (0.05,-3200) [-3200|0] "A"  PT
 SG_ ppDischgCurrPredShort_BMS21 m0 : 23|16@0+ (0.05,-3200) [-3200|0] "A"  PT
 SG_ ppRegenCurrPredLong_BMS21 m2 : 39|16@0+ (0.02,0) [0|1310.7] "A"  PT
 SG_ ppRegenVPredShort_BMS21 m3 : 23|16@0+ (0.02,0) [0|1310.7] "V"  PT
 SG_ ppDischgVPredShort_BMS21 m1 : 23|16@0+ (0.02,0) [0|1310.7] "V"  PT
 SG_ ppRegenVPredLong_BMS21 m3 : 39|16@0+ (0.02,0) [0|1310.7] "V"  PT
 SG_ ppDischgVPredLong_BMS21 m1 : 39|16@0+ (0.02,0) [0|1310.7] "V"  PT
 SG_ SOHDeltaSOCCoulomb_BMS21 m8 : 23|16@0+ (0.005,-150) [-150|177.675] "PCT"  PT
 SG_ SOHAbsDeltaSOCCoulomb_BMS21 m8 : 39|16@0+ (0.05,0) [0|3276.75] "PCT"  PT
 SG_ SOHLastOCVRecalMinSOC_BMS21 m8 : 55|8@0+ (0.393,0) [0|100.215] "PCT"  PT
 SG_ SOHbalancingTimeMinSOH_BMS21 m8 : 63|8@0+ (1,0) [0|255] "Min"  PT

BO_ 1812 BMS21_DebugFastMpex2: 8 BMS21
 SG_ chargerDCOutV_BMS21 m1 : 55|16@0+ (0.04,-1250) [-1250|1250] "V"  PT
 SG_ DIGIO_CHARGERCC_BMS21 m1 : 10|1@0+ (1,0) [0|0] ""  PT
 SG_ chargerProximity_BMS21 m1 : 23|8@0+ (0.02,0) [0|12] "V"  PT
 SG_ chargerPilot_BMS21 m1 : 31|8@0+ (0.05,0) [0|12.75] "V"  PT
 SG_ chargerCurrAvail_BMS21 m1 : 39|8@0+ (0.5,0) [0|127.5] "A"  PT
 SG_ chargerCtrOn_BMS21 m1 : 8|1@0+ (1,0) [0|0] ""  PT
 SG_ chargerOn_BMS21 m1 : 9|1@0+ (1,0) [0|0] ""  PT
 SG_ debugFastMpex2_BMS21 M : 7|8@0+ (1,0) [0|0] ""  PT
 SG_ posPackDbg_BMS21 m0 : 39|16@0+ (0.04,-1250) [-1250|1250] "V"  PT
 SG_ negPackDbg_BMS21 m0 : 55|16@0+ (0.04,-1250) [-1250|1250] "V"  PT
 SG_ packVoltageHVMeas_BMS21 m0 : 23|16@0+ (0.04,-1250) [-1250|1250] "V"  PT

BO_ 1876 BMS21_DebugSlowMpex1: 8 BMS21
 SG_ SOHRecentChange_BMS21 m43 : 15|8@0+ (0.1,-15) [-15|10.5] ""  PT
 SG_ SOHConvergenceIndicator_BMS21 m43 : 31|8@0+ (1,0) [0|255] ""  PT
 SG_ SOHConvergenceCounter_BMS21 m43 : 39|8@0+ (0.024,3) [0|6] ""  PT
 SG_ SOHMinFiltered_BMS21 m43 : 23|8@0+ (0.3,50) [50|126.5] "PCT"  PT
 SG_ prechargeCyMatchWaitTime_BMS21 m43 : 47|16@0+ (1,0) [0|65535] "ms"  PT
 SG_ medianModuleTempGrp2_BMS21 m13 : 63|8@0+ (1,-40) [-40|200] "C"  PT
 SG_ medianModuleTempGrp1_BMS21 m13 : 55|8@0+ (1,-40) [-40|200] "C"  PT
 SG_ coolantWarningtAlert_BMS21 m12 : 49|2@0+ (1,0) [0|3] ""  PT
 SG_ coolantFaultAlert_BMS21 m12 : 51|2@0+ (1,0) [0|3] ""  PT
 SG_ hvilShutdownStrategy_BMS21 m42 : 63|8@0+ (1,0) [0|255] ""  PT
 SG_ J1939_nmState m12 : 55|4@0+ (1,0) [0|0] ""  PT
 SG_ PrechargeXCapMin_BMS21 m42 : 47|16@0+ (0.01,0) [0|1] "mF"  PT
 SG_ LimpHomeTimeOut_BMS21 m42 : 15|32@0+ (1,0) [0|4294967295] "ms"  PT
 SG_ hvWithstandTests_BMS21 m40 : 15|8@0+ (1,0) [0|255] ""  PT
 SG_ aux3prechargeState_BMS21 m41 : 19|4@0+ (1,0) [0|0] ""  PT
 SG_ aux2prechargeState_BMS21 m41 : 31|4@0+ (1,0) [0|0] ""  PT
 SG_ aux1prechargeState_BMS21 m41 : 27|4@0+ (1,0) [0|0] ""  PT
 SG_ auxLinkVoltage_BMS21 m40 : 23|16@0+ (0.02,0) [0|1310.7] "V"  PT
 SG_ invalidModuleVoltageFlags_BMS21 m41 : 39|32@0+ (1,0) [0|0] ""  PT
 SG_ invalidModuleTempFlags_BMS21 m40 : 39|32@0+ (1,0) [0|0] ""  PT
 SG_ pumpSpeedExpected_BMS21 m30 : 15|8@0+ (0.4,0) [0|102] "%"  PT
 SG_ rangeRequestIgnoreVehicle m28 : 55|4@0+ (1,0) [0|65535] ""  PT
 SG_ rangeRequestEepromValue m28 : 63|4@0+ (1,0) [0|65535] ""  PT
 SG_ pressure2_BMS21 m35 : 31|8@0+ (0.4,0) [0|19] "psi"  PT
 SG_ calibration_version_BMS21 m37 : 63|8@0+ (1,0) [0|0] ""  PT
 SG_ currentLowTimer_BMS21 m39 : 55|16@0+ (1,0) [0|65535] "s"  PT
 SG_ auxCntrrOpenUnderLoadCntr_BMS21 m39 : 39|16@0+ (1,0) [0|0] ""  PT
 SG_ rabbitContactorState_BMS21 m34 : 31|8@0+ (1,0) [0|255] ""  PT
 SG_ analogIsenseSupplyCurr_BMS21 m37 : 55|8@0+ (0.04,0) [0|10] "A"  PT
 SG_ pumpSpeedReqCoolPrfmc_BMS21 m29 : 15|8@0+ (1,0) [0|0] "PCT"  PT
 SG_ microsarOs_IdleTask_OsCr0_BMS21 m39 : 23|8@0+ (1,0) [0|100] "PCT"  PT
 SG_ microsarOs_BswTask_BMS21 m39 : 15|8@0+ (1,0) [0|100] "PCT"  PT
 SG_ microsarOs_InitTask_BMS21 m39 : 31|8@0+ (1,0) [0|100] "PCT"  PT
 SG_ microsarOs_ApplTask_1Hz_BMS21 m38 : 63|8@0+ (1,0) [0|100] "PCT"  PT
 SG_ microsarOs_ApplTask_10Hz_BMS21 m38 : 55|8@0+ (1,0) [0|100] "PCT"  PT
 SG_ microsarOs_ApplTask_100Hz_BMS21 m38 : 47|8@0+ (1,0) [0|100] "PCT"  PT
 SG_ microsarOs_ApplLowTask_BMS21 m38 : 39|8@0+ (1,0) [0|100] "PCT"  PT
 SG_ microsarOs_ApplLateInit_BMS21 m38 : 31|8@0+ (1,0) [0|100] "PCT"  PT
 SG_ microsarOs_ApplHighTask_BMS21 m38 : 23|8@0+ (1,0) [0|100] "PCT"  PT
 SG_ microsarOs_ApplEarlyInit_BMS21 m38 : 15|8@0+ (1,0) [0|100] "PCT"  PT
 SG_ pumpRecoveryAttempts_BMS21 m31 : 15|8@0+ (1,0) [0|0] ""  PT
 SG_ appTaskBSWMaxDuration_BMS21 m37 : 47|8@0+ (0.5,0) [0|100] "PCT"  PT
 SG_ appTaskApplHighMaxDuration_BMS21 m37 : 15|16@0+ (0.5,0) [0|100] "PCT"  PT
 SG_ appTask1HzMaxDuration_BMS21 m36 : 63|8@0+ (0.5,0) [0|100] "PCT"  PT
 SG_ appTask100HzMaxDuration_BMS21 m36 : 47|8@0+ (0.5,0) [0|100] "PCT"  PT
 SG_ appTask10HzMaxDuration_BMS21 m36 : 55|8@0+ (0.5,0) [0|100] "PCT"  PT
 SG_ appTask100HzDuration_BMS21 m36 : 15|8@0+ (0.5,0) [0|100] "PCT"  PT
 SG_ appTask10HzDuration_BMS21 m36 : 23|8@0+ (0.5,0) [0|100] "PCT"  PT
 SG_ appTask1HzDuration_BMS21 m36 : 31|8@0+ (0.5,0) [0|100] "PCT"  PT
 SG_ appTaskBSWDuration_BMS21 m36 : 39|8@0+ (0.5,0) [0|100] "PCT"  PT
 SG_ appTaskApplHighDuration_BMS21 m37 : 31|16@0+ (0.5,0) [0|100] "PCT"  PT
 SG_ iumprMaxRatioDTCId_BMS21 m35 : 15|8@0+ (1,0) [0|0] ""  PT
 SG_ iumprMaxRatio_BMS21 m35 : 23|8@0+ (1,0) [0|0] ""  PT
 SG_ iumprMinRatioDTCId_BMS21 m33 : 63|8@0+ (1,0) [0|0] ""  PT
 SG_ iumprMinRatio_BMS21 m33 : 55|8@0+ (1,0) [0|0] ""  PT
 SG_ eepromWriteCyclesMax_BMS21 m11 : 55|16@0+ (64,0) [0|0] ""  PT
 SG_ eepromWriteCyclesUds_BMS21 m10 : 55|8@0+ (1,0) [0|0] ""  PT
 SG_ eepromWriteCyclesStat_BMS21 m10 : 63|8@0+ (1,0) [0|0] ""  PT
 SG_ eepromWriteCyclesSoh_BMS21 m11 : 47|8@0+ (1,0) [0|0] ""  PT
 SG_ fluidLvlCount_BMS21 m34 : 15|8@0+ (1,0) [0|255] ""  PT
 SG_ fluidLvlSensr2_BMS21 m34 : 19|2@0+ (1,0) [0|0] ""  PT
 SG_ fluidLvlSensr1_BMS21 m34 : 17|2@0+ (1,0) [0|0] ""  PT
 SG_ pumpSpeedReqVhcleSpeed_BMS21 m2 : 15|8@0+ (1,0) [0|0] "PCT"  PT
 SG_ appTaskBSWCpuUsage_BMS21 m18 : 15|8@0+ (0.5,0) [0|100] "PCT"  PT
 SG_ appTask200HzCpuUsage_BMS21 m17 : 15|8@0+ (0.5,0) [0|100] "PCT"  PT
 SG_ SWVersionBL_BMS21 m34 : 39|32@0+ (1,0) [0|4294967295] ""  PT
 SG_ SWVersionApp_BMS21 m35 : 39|32@0+ (1,0) [0|4294967295] ""  PT
 SG_ hvSNACounter_BMS21 m31 : 23|16@0+ (1,0) [0|0] ""  PT
 SG_ pyroState_BMS21 m28 : 59|4@0+ (1,0) [0|0] ""  PT
 SG_ ecuSerialNrChar15_BMS21 m33 : 47|8@0+ (1,0) [0|0] ""  PT
 SG_ ecuSerialNrChar14_BMS21 m33 : 39|8@0+ (1,0) [0|0] ""  PT
 SG_ ecuSerialNrChar13_BMS21 m33 : 31|8@0+ (1,0) [0|0] ""  PT
 SG_ ecuSerialNrChar12_BMS21 m33 : 23|8@0+ (1,0) [0|0] ""  PT
 SG_ ecuSerialNrChar11_BMS21 m32 : 63|8@0+ (1,0) [0|0] ""  PT
 SG_ ecuSerialNrChar10_BMS21 m32 : 55|8@0+ (1,0) [0|0] ""  PT
 SG_ ecuSerialNrChar09_BMS21 m32 : 47|8@0+ (1,0) [0|0] ""  PT
 SG_ ecuSerialNrChar08_BMS21 m32 : 39|8@0+ (1,0) [0|0] ""  PT
 SG_ ecuSerialNrChar07_BMS21 m32 : 31|8@0+ (1,0) [0|0] ""  PT
 SG_ ecuSerialNrChar06_BMS21 m32 : 23|8@0+ (1,0) [0|0] ""  PT
 SG_ ecuSerialNrChar05_BMS21 m32 : 15|8@0+ (1,0) [0|0] ""  PT
 SG_ analogGPIO1Current_BMS21 m22 : 39|8@0+ (0.015,0) [0|3.825] "A"  PT
 SG_ analogGPIO1Volt_BMS21 m22 : 55|8@0+ (0.1,0) [0|25] "V"  PT
 SG_ analogGPIO2Current_BMS21 m22 : 47|8@0+ (0.015,0) [0|3.825] "A"  PT
 SG_ analogGPIO2Volt_BMS21 m22 : 63|8@0+ (0.1,0) [0|25] "V"  PT
 SG_ pumpSpeedReqLoadValue_BMS21 m22 : 15|8@0+ (1,0) [0|0] "PCT"  PT
 SG_ ssaRTYear_BMS21 m31 : 55|16@0+ (1,0) [0|0] "yyyy"  PT
 SG_ ssaRTMonth_BMS21 m31 : 47|8@0+ (1,0) [0|0] "mm"  PT
 SG_ ssaRTDay_BMS21 m31 : 39|8@0+ (1,0) [0|0] "dd"  PT
 SG_ ssaTimeMRealTimeOffset_BMS21 m30 : 23|48@0+ (1,0) [0|0] ""  PT
 SG_ ssaTimeMTickCount_BMS21 m29 : 23|48@0+ (1,0) [0|0] ""  PT
 SG_ appTask50HzStackUsage_BMS21 m24 : 15|8@0+ (0.5,0) [0|100] "PCT"  PT
 SG_ OBDMILRequested_BMS21 m28 : 49|2@0+ (1,0) [0|3] ""  PT
 SG_ OBDConfirmedDTCsCount_BMS21 m28 : 15|8@0+ (1,0) [0|255] ""  PT
 SG_ OBDFirstConfirmedDTC_BMS21 m28 : 31|8@0+ (1,0) [0|255] ""  PT
 SG_ OBDFirstConfDTCWarmCyc_BMS21 m28 : 47|6@0+ (1,0) [0|63] ""  PT
 SG_ OBDPermanentDTCCount_BMS21 m28 : 23|8@0+ (1,0) [0|255] ""  PT
 SG_ OBDFirstPermanentDTC_BMS21 m28 : 39|8@0+ (1,0) [0|255] ""  PT
 SG_ OBDFirstPermDTCDriveCyc_BMS21 m28 : 41|2@0+ (1,0) [0|3] ""  PT
 SG_ nmStartupReason_BMS21 m16 : 15|4@0+ (1,0) [0|0] ""  PT
 SG_ SOCdynamicRecal_BMS21 m10 : 19|1@0+ (1,0) [0|1] ""  PT
 SG_ SOCuserSOCInit_BMS21 m10 : 18|1@0+ (1,0) [0|1] ""  PT
 SG_ contactorType_BMS21 m25 : 11|4@0+ (1,0) [0|0] ""  PT
 SG_ activeIsoTestDuration_BMS21 m13 : 15|8@0+ (200,0) [0|51000] "ms"  PT
 SG_ balancingState_BMS21 m16 : 11|4@0+ (1,0) [0|0] ""  PT
 SG_ storCondSysNwOk_BMS21 m27 : 25|1@0+ (1,0) [0|0] ""  PT
 SG_ storCondSysPwrOk_BMS21 m27 : 26|1@0+ (1,0) [0|0] ""  PT
 SG_ storCondECUOk_BMS21 m27 : 24|1@0+ (1,0) [0|0] ""  PT
 SG_ chronoStackWrCnt_BMS21 m27 : 39|32@0+ (1,0) [0|0] ""  PT
 SG_ wakeReason_BMS21 m10 : 15|4@0+ (1,0) [0|0] ""  PT
 SG_ cntrUnderLoadOpenCntr7_BMS21 m26 : 63|8@0+ (1,0) [0|0] ""  PT
 SG_ cntrUnderLoadOpenCntr6_BMS21 m26 : 55|8@0+ (1,0) [0|0] ""  PT
 SG_ cntrUnderLoadOpenCntr5_BMS21 m26 : 47|8@0+ (1,0) [0|0] ""  PT
 SG_ cntrUnderLoadOpenCntr4_BMS21 m26 : 39|8@0+ (1,0) [0|0] ""  PT
 SG_ cntrUnderLoadOpenCntr3_BMS21 m26 : 31|8@0+ (1,0) [0|0] ""  PT
 SG_ cntrUnderLoadOpenCntr2_BMS21 m26 : 23|8@0+ (1,0) [0|0] ""  PT
 SG_ cntrUnderLoadOpenCntr1_BMS21 m26 : 15|8@0+ (1,0) [0|0] ""  PT
 SG_ coolantOutletTemperature_BMS21 m27 : 23|8@0+ (1,-40) [-40|215] "C"  PT
 SG_ coolantInletTemperature_BMS21 m27 : 15|8@0+ (1,-40) [-40|215] "C"  PT
 SG_ prchgResHeatModel_BMS21 m3 : 55|16@0+ (0.1,0) [0|0] "Ws"  PT
 SG_ variantCodingCount_BMS21 m7 : 15|8@0+ (1,0) [0|0] ""  PT
 SG_ SWVersionCusApp_BMS21 m7 : 39|32@0+ (1,0) [0|0] ""  PT
 SG_ contactorOpenRequest_BMS21 m25 : 15|4@0+ (1,0) [0|0] ""  PT
 SG_ maxBrickVoltageChargeLimit_BMS21 m25 : 23|16@0+ (0.0001,0) [0|6.5] "V"  PT
 SG_ desiccantTimer_BMS21 m25 : 39|32@0+ (1,0) [0|0] "s"  PT
 SG_ batSwitchOpenReason_BMS21 m4 : 55|16@0+ (1,0) [0|0] ""  PT
 SG_ balancingTime_BMS21 m24 : 55|16@0+ (1,0) [0|65535] ""  PT
 SG_ bmsIsESSMaster_BMS21 m6 : 14|1@0+ (1,0) [0|0] ""  PT
 SG_ ecuSerialNrChar01_BMS21 m12 : 23|8@0+ (1,0) [0|0] ""  PT
 SG_ ecuSerialNrChar02_BMS21 m12 : 31|8@0+ (1,0) [0|0] ""  PT
 SG_ ecuSerialNrChar03_BMS21 m12 : 39|8@0+ (1,0) [0|0] ""  PT
 SG_ ecuSerialNrChar04_BMS21 m12 : 47|8@0+ (1,0) [0|0] ""  PT
 SG_ ecuSerialNrChar16_BMS21 m13 : 23|8@0+ (1,0) [0|0] ""  PT
 SG_ ecuSerialNrChar17_BMS21 m13 : 31|8@0+ (1,0) [0|0] ""  PT
 SG_ ecuSerialNrChar18_BMS21 m13 : 39|8@0+ (1,0) [0|0] ""  PT
 SG_ ecuSerialNrChar19_BMS21 m13 : 47|8@0+ (1,0) [0|0] ""  PT
 SG_ maxModuleTemperature_BMS21 m5 : 63|8@0+ (1,-40) [-40|200] "C"  PT
 SG_ meanModuleTemperature_BMS21 m8 : 15|8@0+ (1,-40) [-40|200] "C"  PT
 SG_ minModuleTemperature_BMS21 m5 : 55|8@0+ (1,-40) [-40|200] "C"  PT
 SG_ currentEventsShrt_BMS21 m6 : 15|1@0+ (1,0) [0|0] ""  PT
 SG_ nmOperationalMode_BMS21 m1 : 13|2@0+ (1,0) [0|0] ""  PT
 SG_ nmNetworkMode_BMS21 m1 : 15|2@0+ (1,0) [0|0] ""  PT
 SG_ nmNetworkState_BMS21 m1 : 11|1@0+ (1,0) [0|0] ""  PT
 SG_ ecuState_BMS21 m1 : 10|3@0+ (1,0) [0|7] ""  PT
 SG_ SPIRxTxDiag_BMS21 m10 : 11|4@0+ (2,0) [0|30] ""  PT
 SG_ minSOC_BMS21 m24 : 23|16@0+ (0.01,0) [0|100] "PCT"  PT
 SG_ maxSOC_BMS21 m24 : 39|16@0+ (0.01,0) [0|100] "PCT"  PT
 SG_ appTaskMaxCpuUsage_BMS21 m23 : 63|8@0+ (0.5,0) [0|100] "PCT"  PT
 SG_ appTaskCpuUsage_BMS21 m23 : 55|8@0+ (0.5,0) [0|100] "PCT"  PT
 SG_ appTask50HzCpuUsage_BMS21 m23 : 47|8@0+ (0.5,0) [0|100] "PCT"  PT
 SG_ appTask10HzStackUsage_BMS21 m23 : 39|8@0+ (0.5,0) [0|100] "PCT"  PT
 SG_ appTask100HzCpuUsage_BMS21 m23 : 31|8@0+ (0.5,0) [0|100] "PCT"  PT
 SG_ appTask10HzCpuUsage_BMS21 m23 : 23|8@0+ (0.5,0) [0|100] "PCT"  PT
 SG_ appTask1HzCpuUsage_BMS21 m23 : 15|8@0+ (0.5,0) [0|100] "PCT"  PT
 SG_ pumpSpeedReq_BMS21 m12 : 15|8@0+ (1,0) [0|0] "PCT"  PT
 SG_ numberOfStrings_BMS21 m4 : 15|5@0+ (1,0) [0|0] ""  PT
 SG_ hvComponentOpLimit_BMS21 m22 : 23|16@0+ (0.05,0) [0|3276.75] "A"  PT
 SG_ regenCurrPredBrickVOffset_BMS21 m5 : 15|8@0+ (0.5,0) [0|127.5] "A"  PT
 SG_ dischgCurrPredBrickVOffset_BMS21 m3 : 15|8@0+ (0.5,0) [0|127.5] "A"  PT
 SG_ PCANBusOffState_BMS21 m6 : 11|2@0+ (1,0) [0|0] ""  PT
 SG_ SCANBusOffState_BMS21 m6 : 13|2@0+ (1,0) [0|0] ""  PT
 SG_ PTCANBusOffState_BMS21 m6 : 9|2@0+ (1,0) [0|0] ""  PT
 SG_ eepromWriteCyclesSoc_BMS21 m11 : 39|8@0+ (1,0) [0|0] ""  PT
 SG_ eepromWriteCyclesDiag_BMS21 m11 : 31|8@0+ (1,0) [0|0] ""  PT
 SG_ eepromWriteCyclesChrono_BMS21 m10 : 39|8@0+ (1,0) [0|0] ""  PT
 SG_ eepromWriteCyclesCust_BMS21 m10 : 47|8@0+ (1,0) [0|0] ""  PT
 SG_ customerModelVsYear_BMS21 m14 : 23|8@0+ (1,0) [0|0] ""  PT
 SG_ customerModelVsWeek_BMS21 m14 : 31|8@0+ (1,0) [0|0] ""  PT
 SG_ customerModelVsCellType_BMS21 m14 : 15|1@0+ (1,0) [0|0] ""  PT
 SG_ customerModelVsCellGen_BMS21 m14 : 14|7@0+ (1,0) [0|0] ""  PT
 SG_ SWVersion_BMS21 m14 : 39|32@0+ (1,0) [0|4294967295] ""  PT
 SG_ balancingRequest288_to_295_BMS21 m21 : 63|8@0+ (1,0) [0|0] ""  PT
 SG_ balancingRequest296_to_303_BMS21 m21 : 55|8@0+ (1,0) [0|0] ""  PT
 SG_ balancingRequest304_to_311_BMS21 m21 : 47|8@0+ (1,0) [0|0] ""  PT
 SG_ balancingRequest312_to_319_BMS21 m21 : 39|8@0+ (1,0) [0|0] ""  PT
 SG_ balancingRequest320_to_327_BMS21 m21 : 31|8@0+ (1,0) [0|0] ""  PT
 SG_ balancingRequest328_to_335_BMS21 m21 : 23|8@0+ (1,0) [0|0] ""  PT
 SG_ balancingRequest240_to_247_BMS21 m20 : 63|8@0+ (1,0) [0|0] ""  PT
 SG_ balancingRequest248_to_255_BMS21 m20 : 55|8@0+ (1,0) [0|0] ""  PT
 SG_ balancingRequest256_to_263_BMS21 m20 : 47|8@0+ (1,0) [0|0] ""  PT
 SG_ balancingRequest264_to_271_BMS21 m20 : 39|8@0+ (1,0) [0|0] ""  PT
 SG_ balancingRequest272_to_279_BMS21 m20 : 31|8@0+ (1,0) [0|0] ""  PT
 SG_ balancingRequest280_to_287_BMS21 m20 : 23|8@0+ (1,0) [0|0] ""  PT
 SG_ balancingRequest192_to_199_BMS21 m19 : 63|8@0+ (1,0) [0|0] ""  PT
 SG_ balancingRequest200_to_207_BMS21 m19 : 55|8@0+ (1,0) [0|0] ""  PT
 SG_ balancingRequest208_to_215_BMS21 m19 : 47|8@0+ (1,0) [0|0] ""  PT
 SG_ balancingRequest216_to_223_BMS21 m19 : 39|8@0+ (1,0) [0|0] ""  PT
 SG_ balancingRequest224_to_231_BMS21 m19 : 31|8@0+ (1,0) [0|0] ""  PT
 SG_ balancingRequest232_to_239_BMS21 m19 : 23|8@0+ (1,0) [0|0] ""  PT
 SG_ balancingRequest144_to_151_BMS21 m18 : 63|8@0+ (1,0) [0|0] ""  PT
 SG_ balancingRequest152_to_159_BMS21 m18 : 55|8@0+ (1,0) [0|0] ""  PT
 SG_ balancingRequest160_to_167_BMS21 m18 : 47|8@0+ (1,0) [0|0] ""  PT
 SG_ balancingRequest168_to_175_BMS21 m18 : 39|8@0+ (1,0) [0|0] ""  PT
 SG_ balancingRequest176_to_183_BMS21 m18 : 31|8@0+ (1,0) [0|0] ""  PT
 SG_ balancingRequest184_to_191_BMS21 m18 : 23|8@0+ (1,0) [0|0] ""  PT
 SG_ balancingRequest096_to_103_BMS21 m17 : 63|8@0+ (1,0) [0|0] ""  PT
 SG_ balancingRequest104_to_111_BMS21 m17 : 55|8@0+ (1,0) [0|0] ""  PT
 SG_ balancingRequest112_to_119_BMS21 m17 : 47|8@0+ (1,0) [0|0] ""  PT
 SG_ balancingRequest120_to_127_BMS21 m17 : 39|8@0+ (1,0) [0|0] ""  PT
 SG_ balancingRequest128_to_135_BMS21 m17 : 31|8@0+ (1,0) [0|0] ""  PT
 SG_ balancingRequest136_to_143_BMS21 m17 : 23|8@0+ (1,0) [0|0] ""  PT
 SG_ balancingRequest048_to_055_BMS21 m16 : 63|8@0+ (1,0) [0|0] ""  PT
 SG_ balancingRequest056_to_063_BMS21 m16 : 55|8@0+ (1,0) [0|0] ""  PT
 SG_ balancingRequest064_to_071_BMS21 m16 : 47|8@0+ (1,0) [0|0] ""  PT
 SG_ balancingRequest072_to_079_BMS21 m16 : 39|8@0+ (1,0) [0|0] ""  PT
 SG_ balancingRequest080_to_087_BMS21 m16 : 31|8@0+ (1,0) [0|0] ""  PT
 SG_ balancingRequest088_to_095_BMS21 m16 : 23|8@0+ (1,0) [0|0] ""  PT
 SG_ balancingRequest000_to_007_BMS21 m15 : 63|8@0+ (1,0) [0|0] ""  PT
 SG_ balancingRequest008_to_015_BMS21 m15 : 55|8@0+ (1,0) [0|0] ""  PT
 SG_ balancingRequest016_to_023_BMS21 m15 : 47|8@0+ (1,0) [0|0] ""  PT
 SG_ balancingRequest024_to_031_BMS21 m15 : 39|8@0+ (1,0) [0|0] ""  PT
 SG_ balancingRequest032_to_039_BMS21 m15 : 31|8@0+ (1,0) [0|0] ""  PT
 SG_ balancingRequest040_to_047_BMS21 m15 : 23|8@0+ (1,0) [0|0] ""  PT
 SG_ balancingVoltageTarget_BMS21 m15 : 15|8@0+ (0.02,0) [0|5.1] ""  PT
 SG_ numberOfPacksPerString_BMS21 m4 : 10|3@0+ (1,0) [0|0] ""  PT
 SG_ analogAddr5_BMS21 m1 : 23|8@0+ (0.05,0) [0|12] "V"  PT
 SG_ analogAddr0_BMS21 m1 : 63|8@0+ (0.05,0) [0|12] "V"  PT
 SG_ analogAddr4_BMS21 m1 : 31|8@0+ (0.05,0) [0|12] "V"  PT
 SG_ analogAddr3_BMS21 m1 : 39|8@0+ (0.05,0) [0|12] "V"  PT
 SG_ analogAddr2_BMS21 m1 : 47|8@0+ (0.05,0) [0|12] "V"  PT
 SG_ analogAddr1_BMS21 m1 : 55|8@0+ (0.05,0) [0|12] "V"  PT
 SG_ debugSlowMpex1_BMS21 M : 7|8@0+ (1,0) [0|0] ""  PT
 SG_ analog3V3DSupply_BMS21 m9 : 15|8@0+ (0.015,0) [0|0] "V"  PT
 SG_ pressure_BMS21 m9 : 63|8@0+ (0.4,0) [0|19] "psi"  PT
 SG_ analog3P3VA_BMS21 m9 : 55|8@0+ (0.015,0) [0|3.825] "V"  PT
 SG_ analog5VA_BMS21 m9 : 31|8@0+ (0.025,0) [0|6] "V"  PT
 SG_ analog5VD_BMS21 m9 : 23|8@0+ (0.025,0) [0|6] "V"  PT
 SG_ analog5VSensorSupply_BMS21 m9 : 47|8@0+ (0.025,0) [0|6.375] "V"  PT
 SG_ analog6V5_BMS21 m9 : 39|8@0+ (0.0075,5) [5|6.9125] "V"  PT
 SG_ isolationResistanceIntern_BMS21 m8 : 55|16@0+ (2,0) [0|130000] "kOhm"  PT
 SG_ isolationResistanceExtern_BMS21 m8 : 39|16@0+ (2,0) [0|130000] "kOhm"  PT
 SG_ linkVoltage_BMS21 m8 : 23|16@0+ (0.02,0) [0|1310.7] "V"  PT
 SG_ eepromWriteCyclesBasics_BMS21 m11 : 23|8@0+ (1,0) [0|0] ""  PT
 SG_ eepromBlockIndex_BMS21 m11 : 15|8@0+ (1,0) [0|0] ""  PT
 SG_ CAN1MIATimerISR_BMS21 m7 : 23|8@0+ (1,0) [0|255] ""  PT
 SG_ CAN2MIATimerISR_BMS21 m7 : 31|8@0+ (1,0) [0|255] ""  PT
 SG_ regenCurrentOpLimit_BMS21 m5 : 39|16@0+ (0.05,0) [0|3200] "A"  PT
 SG_ regenCurrentErrorLimit_BMS21 m5 : 23|16@0+ (0.05,0) [0|3200] "A"  PT
 SG_ lifetime_BMS21 m6 : 39|32@0+ (1,0) [0|0] "s"  PT
 SG_ eepromReadTime_BMS21 m0 : 15|8@0+ (10,0) [0|2550] "ms"  PT
 SG_ chargerCurrentOpLimit_BMS21 m4 : 39|16@0+ (0.05,0) [0|3200] "A"  PT
 SG_ dischargeCurrentOpLimit_BMS21 m3 : 39|16@0+ (0.05,-3200) [-3200|0] "A"  PT
 SG_ chargerCurrentErrorLimit_BMS21 m4 : 23|16@0+ (0.05,0) [0|3200] "A"  PT
 SG_ dischargeCurrentErrorLimit_BMS21 m3 : 23|16@0+ (0.05,-3200) [-3200|0] "A"  PT
 SG_ pumpSpeedReqMaxT_BMS21 m2 : 23|8@0+ (1,0) [0|0] "PCT"  PT
 SG_ pumpSpeedReqDeltaT_BMS21 m2 : 31|8@0+ (1,0) [0|0] "PCT"  PT
 SG_ energyThroughput_BMS21 m2 : 39|32@0+ (0.001,0) [0|4294967.295] "kWh"  PT
 SG_ packVoltageCMB_BMS21 m6 : 23|16@0+ (0.02,0) [0|1200] "V"  PT
 SG_ ctrOffTimeLast_BMS21 m0 : 23|16@0+ (1,0) [0|0] "s"  PT
 SG_ ctrOffTime_BMS21 m0 : 39|16@0+ (1,0) [0|0] "s"  PT
 SG_ sleepTime_BMS21 m0 : 55|16@0+ (1,0) [0|0] "s"  PT
 SG_ SPIRxTxTimeAllPckts_BMS21 m10 : 31|8@0+ (2,0) [0|500] "ms"  PT
 SG_ isolationTestState_BMS21 m10 : 17|2@0+ (1,0) [0|0] ""  PT
 SG_ SOCvoltageInit_BMS21 m10 : 21|1@0+ (1,0) [0|1] ""  PT
 SG_ SOCocvInit_BMS21 m10 : 23|1@0+ (1,0) [0|1] ""  PT
 SG_ SOCeepromInit_BMS21 m10 : 22|1@0+ (1,0) [0|1] ""  PT
 SG_ SOCdefaultInit_BMS21 m10 : 20|1@0+ (1,0) [0|1] ""  PT

BO_ 1748 BMS21_DebugFastMpex1: 8 BMS21
 SG_ SPIRxTxHeaderMux3Status_BMS21 m1 : 23|1@0+ (1,0) [0|1] ""  PT
 SG_ SPIRxTxHeaderMux2Status_BMS21 m1 : 22|1@0+ (1,0) [0|1] ""  PT
 SG_ SPIRxTxHeaderMux1Status_BMS21 m1 : 21|1@0+ (1,0) [0|1] ""  PT
 SG_ SPIRxTxHeaderMux0Status_BMS21 m1 : 20|1@0+ (1,0) [0|1] ""  PT
 SG_ activeIsoTestPsbl_BMS21 m0 : 27|1@0+ (1,0) [0|0] ""  PT
 SG_ activeIsoState_BMS21 m3 : 15|8@0+ (1,0) [0|0] ""  PT
 SG_ activeIsoNegLink_BMS21 m3 : 39|16@0+ (0.04,-1250) [-1250|1371.4] "V"  PT
 SG_ activeIsoPosLink_BMS21 m3 : 23|16@0+ (0.04,-1250) [-1250|1371.4] "V"  PT
 SG_ activeIsoTestStateTimer_BMS21 m2 : 15|8@0+ (200,0) [0|51000] "ms"  PT
 SG_ activeIsoPosBuffer_BMS21 m2 : 23|16@0+ (0.04,-1250) [-1250|1371.4] "V"  PT
 SG_ activeIsoNegBuffer_BMS21 m2 : 39|16@0+ (0.04,-1250) [-1250|1371.4] "V"  PT
 SG_ activeIsoResRaw_BMS21 m2 : 55|16@0+ (2,0) [0|130000] "kOhm"  PT
 SG_ activeIsoResFilter_BMS21 m3 : 55|16@0+ (2,0) [0|130000] "kOhm"  PT
 SG_ contactorStateAux_BMS21 m1 : 34|3@0+ (1,0) [0|0] ""  PT
 SG_ batSwitchOpenReqEssMstr_BMS21 m0 : 35|2@0+ (1,0) [0|0] ""  PT
 SG_ packShutdownTarget_BMS21 m1 : 12|2@0+ (1,0) [0|0] ""  PT
 SG_ weldedState_BMS21 m1 : 39|2@0+ (1,0) [0|0] ""  PT
 SG_ DIGIO_GPIO2_ON_BMS21 m1 : 19|1@0+ (1,0) [0|0] ""  PT
 SG_ DIGIO_GPIO1_ON_BMS21 m1 : 18|1@0+ (1,0) [0|0] ""  PT
 SG_ DIGIO_12VCURR_SENSE_ON_BMS21 m1 : 37|1@0+ (1,0) [0|0] ""  PT
 SG_ DIGIO_PSUP_SAFETY_OK_BMS21 m1 : 17|1@0+ (1,0) [0|0] ""  PT
 SG_ contactorStateRq_BMS21 m1 : 36|2@0+ (1,0) [0|0] ""  PT
 SG_ contactorPwrOkToPrechg_BMS21 m1 : 16|1@0+ (1,0) [0|0] ""  PT
 SG_ strMstrStrPrechgState_BMS21 m1 : 58|3@0+ (1,0) [0|0] ""  PT
 SG_ packShutdwnTmrQual_BMS21 m1 : 27|1@0+ (1,0) [0|0] ""  PT
 SG_ packStateRequest_BMS21 m1 : 15|3@0+ (1,0) [0|0] ""  PT
 SG_ packState_BMS21 m1 : 31|4@0+ (1,0) [0|0] ""  PT
 SG_ SPIRxTxTimer_BMS21 m1 : 47|8@0+ (2,0) [0|500] "ms"  PT
 SG_ moduleTMinMaxMeanQual_BMS21 m1 : 26|1@0+ (1,0) [0|0] ""  PT
 SG_ currentQual_BMS21 m1 : 25|1@0+ (1,0) [0|0] ""  PT
 SG_ brickVMinMaxMeanQual_BMS21 m1 : 24|1@0+ (1,0) [0|0] ""  PT
 SG_ negCtr1OnReqASW_BMS21 m1 : 8|1@0+ (1,0) [0|0] ""  PT
 SG_ prechgCtr1OnReqASW_BMS21 m1 : 9|1@0+ (1,0) [0|0] ""  PT
 SG_ posCtr1OnReqASW_BMS21 m1 : 10|1@0+ (1,0) [0|0] ""  PT
 SG_ DIGIO_CNTR_HISIDE_ON_MC_BMS21 m0 : 38|1@0+ (1,0) [0|0] ""  PT
 SG_ DIGIO_CNTR_HISIDE_ON_CHCKD_BMS21 m0 : 37|1@0+ (1,0) [0|0] ""  PT
 SG_ DIGIO_CNTR_CLOSE_OK_CHCKD_BMS21 m0 : 36|1@0+ (1,0) [0|0] ""  PT
 SG_ debugFastMpex1_BMS21 M : 7|8@0+ (1,0) [0|0] ""  PT
 SG_ stateContactorControl_BMS21 m0 : 41|1@0+ (1,0) [0|0] ""  PT
 SG_ stateVoltage_BMS21 m0 : 43|1@0+ (1,0) [0|0] ""  PT
 SG_ stateTemperature_BMS21 m0 : 44|1@0+ (1,0) [0|0] ""  PT
 SG_ stateSelfTest_BMS21 m0 : 45|1@0+ (1,0) [0|0] ""  PT
 SG_ stateHVIL_BMS21 m0 : 46|1@0+ (1,0) [0|0] ""  PT
 SG_ stateCurrent_BMS21 m0 : 47|1@0+ (1,0) [0|0] ""  PT
 SG_ stateCrash_BMS21 m0 : 42|1@0+ (1,0) [0|0] ""  PT
 SG_ stateContactors_BMS21 m0 : 40|1@0+ (1,0) [0|0] ""  PT
 SG_ stateCANRx_BMS21 m0 : 39|1@0+ (1,0) [0|0] ""  PT
 SG_ itemState_BMS21 m0 : 33|2@0+ (1,0) [0|0] ""  PT
 SG_ negLink_BMS21 m0 : 23|8@0+ (10,-1200) [-1200|1350] "V"  PT
 SG_ posLink_BMS21 m0 : 15|8@0+ (10,-1200) [-1200|1350] "V"  PT
 SG_ negPack_BMS21 m0 : 63|8@0+ (10,-1200) [-1200|1350] "V"  PT
 SG_ posPack_BMS21 m0 : 55|8@0+ (10,-1200) [-1200|1350] "V"  PT
 SG_ prechargeState_BMS21 m0 : 31|4@0+ (1,0) [0|0] ""  PT
 SG_ contactorState_BMS21 m0 : 26|3@0+ (1,0) [0|0] ""  PT
 SG_ diagStandbyImmShutdown_BMS21 m1 : 61|1@0+ (1,0) [0|1] ""  PT
 SG_ diagAllOffRequired_BMS21 m1 : 60|1@0+ (1,0) [0|1] ""  PT
 SG_ diagDriveTransitionNotOK_BMS21 m1 : 55|1@0+ (1,0) [0|1] ""  PT
 SG_ diagDriveImmShutdown_BMS21 m1 : 54|1@0+ (1,0) [0|1] ""  PT
 SG_ diagDriveDelShutdown2_BMS21 m1 : 52|1@0+ (1,0) [0|1] ""  PT
 SG_ diagDriveDelShutdown1_BMS21 m1 : 53|1@0+ (1,0) [0|1] ""  PT
 SG_ diagUnused_BMS21 m1 : 59|1@0+ (1,0) [0|1] ""  PT
 SG_ diagChargeTransitionNotOK_BMS21 m1 : 51|1@0+ (1,0) [0|1] ""  PT
 SG_ diagChargeImmShutdown_BMS21 m1 : 50|1@0+ (1,0) [0|1] ""  PT
 SG_ diagAccDelShutdown1_BMS21 m1 : 62|1@0+ (1,0) [0|1] ""  PT
 SG_ diagChargeDelShutdown1_BMS21 m1 : 49|1@0+ (1,0) [0|1] ""  PT
 SG_ diagAccTransitionNotOK_BMS21 m1 : 48|1@0+ (1,0) [0|1] ""  PT
 SG_ diagAccImmShutdown_BMS21 m1 : 63|1@0+ (1,0) [0|1] ""  PT

BA_DEF_ SG_  "GenSigSendType" ENUM  "Cyclic","OnWrite","OnWriteWithRepetition","OnChange","OnChangeWithRepetition","IfActive","IfActiveWithRepetition","NoSigSendType";
BA_DEF_ BO_  "GenMsgCycleTime" INT 0 0;
BA_DEF_ BO_  "GenMsgSendType" ENUM  "Cyclic","not_used","not_used","not_used","not_used","Cyclic","not_used","IfActive","NoMsgSendType";
BA_DEF_DEF_  "GenSigSendType" "Cyclic";
BA_DEF_DEF_  "GenMsgCycleTime" 0;
BA_DEF_DEF_  "GenMsgSendType" "NoMsgSendType";
BA_ "GenMsgCycleTime" BO_ 1617 100;
BA_ "GenMsgCycleTime" BO_ 1681 10;
BA_ "GenMsgCycleTime" BO_ 1937 100;
BA_ "GenMsgCycleTime" BO_ 2001 100;
BA_ "GenMsgCycleTime" BO_ 980 1000;
BA_ "GenMsgCycleTime" BO_ 1812 100;
BA_ "GenMsgCycleTime" BO_ 1876 1000;
BA_ "GenMsgCycleTime" BO_ 1748 100;
VAL_ 1617 selfTestStartupFault_SC18 6 "SELFTEST_PBIST_OTHER_RAM_FAULT" 5 "SELFTEST_PBIST_CPU_RAM_FAULT" 4 "SELFTEST_PBIST_ROM_FAULT" 3 "SELFTEST_PBIST_STC_ROM_FAULT" 2 "SELFTEST_STC_FAULT" 1 "SELFTEST_CPU_FAULT" 0 "SELFTEST_STARTUP_OK" ;
VAL_ 1617 sbcARTimerStatus_SC18 15 "SNA" 6 "SBC_AR_COMPLETE" 5 "SBC_AR_INTERRUPTED" 4 "SBC_AR_READ_SUCCESS" 3 "SBC_AR_STOPPED" 2 "SBC_AR_RUNTOSTOP" 0 "SBC_AR_INIT" 1 "SBC_AR_RUNNING" ;
VAL_ 1617 sbcARTimerValue_SC18 255 "SNA" ;
VAL_ 1617 cmbVAIndex_SC18 255 "CMB_NONE" ;
VAL_ 1617 minVACMB_SC18 65535 "SNA" ;
VAL_ 1617 maxVACMB_SC18 65535 "SNA" ;
VAL_ 1617 pumpInternalFaultError_SC18 1 "ERROR" 0 "NO_ERROR" ;
VAL_ 1617 pumpShortCircuitError_SC18 1 "ERROR" 0 "NO_ERROR" ;
VAL_ 1617 pumpElectricError_SC18 1 "ERROR" 0 "NO_ERROR" 3 "SNA" ;
VAL_ 1617 pumpPostRunMode_SC18 7 "SNA" 4 "SPEED_4" 3 "SPEED_3" 2 "SPEED_2" 1 "SPEED_1" 0 "NO_POST_RUN" ;
VAL_ 1617 pumpRsError_SC18 1 "ERROR" 0 "NO_ERROR" ;
VAL_ 1617 pumpWakeUpStatus_SC18 2 "NDEF2" 1 "ACTIVE_WUP" 0 "NO_WUP" 3 "SNA" ;
VAL_ 1617 pumpRpmMonStat_SC18 1 "NO_MON" 0 "MON_ACTIVE" 3 "SNA" ;
VAL_ 1617 pumpPwmInStat_SC18 1 "HIGH" 0 "LOW" 3 "SNA" ;
VAL_ 1617 pumpDiagTriggered_SC18 1 "TRUE" 0 "FALSE" ;
VAL_ 1617 pumpHwFault_SC18 1 "ERROR" 0 "NO_ERROR" ;
VAL_ 1617 pumpPumpState_SC18 6 "ERROR" 5 "HARDWARE_ERROR" 1 "RUN" 0 "IDLE" 7 "SNA" ;
VAL_ 1617 pumpBlockError_SC18 0 "NO_ERROR" 1 "ERROR" 3 "SNA" ;
VAL_ 1617 pumpLinError_SC18 1 "ERROR" 0 "NO_ERROR" ;
VAL_ 1617 pumpDryRun_SC18 1 "ERROR" 0 "NO_ERROR" 3 "SNA" ;
VAL_ 1617 pumpOverCurrent_SC18 1 "ERROR" 0 "NO_ERROR" 3 "SNA" ;
VAL_ 1617 pumpVoltageDeratingError_SC18 1 "ERROR" 0 "NO_ERROR" ;
VAL_ 1617 pumpSupVoltageError_SC18 1 "ERROR" 0 "NO_ERROR" 3 "SNA" ;
VAL_ 1617 pumpUnderVoltage_SC18 1 "ERROR" 0 "NO_ERROR" ;
VAL_ 1617 pumpOverVoltage_SC18 1 "ERROR" 0 "NO_ERROR" ;
VAL_ 1617 pumpTempProtect_SC18 1 "ERROR" 0 "NO_ERROR" ;
VAL_ 1617 pumpOverTempDeratingErr_SC18 1 "ERROR" 0 "NO_ERROR" ;
VAL_ 1617 pumpOverTemperature_SC18 1 "ERROR" 0 "NO_ERROR" 3 "SNA" ;
VAL_ 1617 pressure2_SC18 255 "SNA" ;
VAL_ 1617 cmbSM29ScoutTempIndex_SC18 255 "SNA" ;
VAL_ 1617 cmbSM19ScoutPDO_SC18 65535 "SNA" ;
VAL_ 1617 isolationResInternRelaxed_SC18 65535 "SNA" ;
VAL_ 1617 appTask500HzMaxAvg_SC18 255 "SNA" ;
VAL_ 1617 safetyHangLastLinkReg_SC18 -1 "SNA" ;
VAL_ 1617 safetyHangPresentLinkReg_SC18 -1 "SNA" ;
VAL_ 1617 safetyHangDataFaultStatus_SC18 -1 "SNA" ;
VAL_ 1617 safetyHangDataFaultAddr_SC18 -1 "SNA" ;
VAL_ 1617 safetyHangLastARMMode_SC18 255 "MODE_UNKNOWN" 6 "MODE_SYS" 5 "MODE_UND" 4 "MODE_ABT" 3 "MODE_SVC" 2 "MODE_IRQ" 1 "MODE_FIQ" 0 "MODE_USER" ;
VAL_ 1617 safetyHangPresARMMode_SC18 255 "MODE_UNKNOWN" 6 "MODE_SYS" 5 "MODE_UND" 4 "MODE_ABT" 3 "MODE_SVC" 2 "MODE_IRQ" 1 "MODE_FIQ" 0 "MODE_USER" ;
VAL_ 1617 safetyHangESMGrp3Reg_SC18 -1 "SNA" ;
VAL_ 1617 safetyHangInstrFaultStatus_SC18 -1 "SNA" ;
VAL_ 1617 safetyHangInstrFaultAddr_SC18 -1 "SNA" ;
VAL_ 1617 pressure_SC18 255 "SNA" ;
VAL_ 1617 cmbMaxSM33Diff_SC18 255 "SNA" ;
VAL_ 1617 cmbMinSM29Diff_SC18 255 "SNA" ;
VAL_ 1617 cmbMinSM4Diff_SC18 65535 "SNA" ;
VAL_ 1617 cmbMaxSM4Diff_SC18 65535 "SNA" ;
VAL_ 1617 cmbMinSM27Diff_SC18 65535 "SNA" ;
VAL_ 1617 cmbMaxSM27Diff_SC18 65535 "SNA" ;
VAL_ 1617 adcDriverFail_SC18 12 "ADCDRIVER_SBCSUPPLY_FF" 11 "ADCDRIVER_MUX960_FF" 10 "ADCDRIVER_MUX910_FF" 9 "ADCDRIVER_UNDEF" 8 "ADCDRIVER_ADCVAR" 7 "ADCDRIVER_SLEEP_FF" 6 "ADCDRIVER_PYRO_FF" 5 "ADCDRIVER_MUX710_FF" 4 "ADCDRIVER_MUX440_FF" 3 "ADCDRIVER_MUX302A_FF" 2 "ADCDRIVER_MUX301B_FF" 1 "ADCDRIVER_MUX301A_FF" 0 "ADCDRIVER_NO_ISSUE" ;
VAL_ 1617 mainUcHvilState_SC18 2 "CANTX_HVIL_CLOSE" 3 "CANTX_HVIL_SNA" 1 "CANTX_HVIL_OPEN" 0 "CANTX_HVIL_NOT_AVAIL" ;
VAL_ 1617 mainUcIntIsoErr_SC18 3 "ISOLATION_SNA" 2 "ISOLATION_ERR_OFF" 1 "ISOLATION_ERROR" 0 "ISOLATION_OK" ;
VAL_ 1617 mainUcExtIsoErr_SC18 3 "ISOLATION_SNA" 2 "ISOLATION_ERR_OFF" 1 "ISOLATION_ERROR" 0 "ISOLATION_OK" ;
VAL_ 1617 safetyUcThermalStatus_SC18 3 "THERMALEVENT_SNA" 2 "THERMALEVENT_WARN_2" 1 "THERMALEVENT_WARN_1" 0 "THERMALEVENT_NO_WARN" ;
VAL_ 1617 mainUcThermalStatus_SC18 3 "THERMALEVENT_SNA" 2 "THERMALEVENT_WARN_2" 1 "THERMALEVENT_WARN_1" 0 "THERMALEVENT_NO_WARN" ;
VAL_ 1617 selfTestDataFaultStatus_SC18 -1 "SNA" ;
VAL_ 1617 selfTestInstrFaultAddr_SC18 -1 "SNA" ;
VAL_ 1617 selfTestDataFaultAddr_SC18 -1 "SNA" ;
VAL_ 1617 selfTestInstrFaultStatus_SC18 -1 "SNA" ;
VAL_ 1617 internalIsolationError_SC18 3 "ISOLATION_SNA" 2 "ISOLATION_ERR_OFF" 1 "ISOLATION_ERROR" 0 "ISOLATION_OK" ;
VAL_ 1617 externalIsolationError_SC18 3 "ISOLATION_SNA" 2 "ISOLATION_ERR_OFF" 1 "ISOLATION_ERROR" 0 "ISOLATION_OK" ;
VAL_ 1617 isolationTestState_SC18 3 "ISOLATION_TEST_POSNEG" 2 "ISOLATION_TEST_NEG" 1 "ISOLATION_TEST_POS" 0 "ISOLATION_OFF" ;
VAL_ 1617 isolationResistanceIntern_SC18 65535 "SNA" ;
VAL_ 1617 isolationResistanceExtern_SC18 65535 "SNA" ;
VAL_ 1617 maxAdolV13Diff_SC18 65535 "SNA" ;
VAL_ 1617 pumpType_SC18 0 "PUMP_NONE" 1 "PUMP_MAL" 2 "PUMP_BOSCH" 3 "PUMP_JOMA" 4 "PUMP_MAHLE" 255 "SNA" ;
VAL_ 1617 pumpPhaseCurrent_SC18 255 "SNA" ;
VAL_ 1617 hvWithstandTestQual_SC18 1 "QUAL_ERROR" 0 "QUAL_VALID" ;
VAL_ 1617 currentModuleMax_SC18 65535 "SNA" ;
VAL_ 1617 currentModuleMin_SC18 65535 "SNA" ;
VAL_ 1617 maxCMBDieTemp_SC18 255 "SNA" ;
VAL_ 1617 minCMBDieTemp_SC18 255 "SNA" ;
VAL_ 1617 appTaskSpiRxTx_SC18 255 "SNA" ;
VAL_ 1617 variantCodingCounts_SC18 255 "SNA" ;
VAL_ 1617 cmbMaxUpdateTime_SC18 255 "SNA" ;
VAL_ 1617 pumpSetSpeed_SC18 255 "SNA" ;
VAL_ 1617 hvilResistance_SC18 255 "SNA" ;
VAL_ 1617 cmbAvgUpdateTime_SC18 255 "SNA" ;
VAL_ 1617 pumpTemperature_SC18 255 "SNA" ;
VAL_ 1617 pumpSpeed_SC18 255 "SNA" ;
VAL_ 1617 pumpVoltage_SC18 255 "SNA" ;
VAL_ 1617 pumpCurrent_SC18 255 "SNA" ;
VAL_ 1617 posLink3_SC18 65535 "SNA" ;
VAL_ 1617 negLink3_SC18 65535 "SNA" ;
VAL_ 1617 posLink2_SC18 65535 "SNA" ;
VAL_ 1617 negLink2_SC18 65535 "SNA" ;
VAL_ 1617 cmbNrOfSamples_SC18 65535 "SNA" ;
VAL_ 1617 cmbTaskTime_SC18 65535 "SNA" ;
VAL_ 1617 appTask500HzMax_SC18 255 "SNA" ;
VAL_ 1617 analogHallSense_SC18 65535 "SNA" ;
VAL_ 1617 cmbMaxDiagStepPeriodicity_SC18 255 "SNA" ;
VAL_ 1617 minBrickVoltageLimit_SC18 65535 "SNA" ;
VAL_ 1617 appTask100Hz_SC18 255 "SNA" ;
VAL_ 1617 appTask10Hz_SC18 255 "SNA" ;
VAL_ 1617 appTaskAnalog_SC18 255 "SNA" ;
VAL_ 1617 appTaskADC_SC18 255 "SNA" ;
VAL_ 1617 appTask500HzAvg_SC18 255 "SNA" ;
VAL_ 1617 appTaskSBC_SC18 255 "SNA" ;
VAL_ 1617 appTaskCMBDriver_SC18 255 "SNA" ;
VAL_ 1617 safetyInitTime_SC18 255 "SNA" ;
VAL_ 1617 debugSlowMpex_SC18 45 "S45" 44 "S44" 43 "S43" 42 "S42" 41 "S41" 0 "S00" 1 "S01" 2 "S02" 3 "S03" 4 "S04" 5 "S05" 6 "S06" 7 "S07" 8 "S08" 9 "S09" 10 "S10" 11 "S11" 12 "S12" 13 "S13" 14 "S14" 15 "S15" 16 "S16" 17 "S17" 18 "S18" 19 "S19" 20 "S20" 21 "S21" 22 "S22" 23 "S23" 24 "S24" 25 "S25" 26 "S26" 27 "S27" 28 "S28" 29 "S29" 30 "S30" 31 "S31" 32 "S32" 33 "S33" 34 "S34" 35 "S35" 36 "S36" 37 "S37" 38 "S38" 39 "S39" 40 "S40" ;
VAL_ 1617 mux440Gnd_SC18 255 "SNA" ;
VAL_ 1617 analogHallGain_SC18 65535 "SNA" ;
VAL_ 1617 analogHallOffset_SC18 255 "SNA" ;
VAL_ 1617 negPackPrime_SC18 65535 "SNA" ;
VAL_ 1617 posPackPrime_SC18 65535 "SNA" ;
VAL_ 1617 packVoltage_SC18 65535 "SNA" ;
VAL_ 1617 sleepTime_SC18 65535 "SNA" ;
VAL_ 1617 analogNegHVOffset_SC18 255 "SNA" ;
VAL_ 1617 analogPosHVOffset_SC18 255 "SNA" ;
VAL_ 1617 analogNegHVGain_SC18 65535 "SNA" ;
VAL_ 1617 analogPosHVGain_SC18 65535 "SNA" ;
VAL_ 1617 mux910Gnd_SC18 255 "SNA" ;
VAL_ 1617 mux960Gnd_SC18 255 "SNA" ;
VAL_ 1617 analogAddr5_SC18 65535 "SNA" ;
VAL_ 1617 analogAddr4_SC18 65535 "SNA" ;
VAL_ 1617 analogAddr3_SC18 65535 "SNA" ;
VAL_ 1617 analogAddr2_SC18 65535 "SNA" ;
VAL_ 1617 analogAddr1_SC18 65535 "SNA" ;
VAL_ 1617 analogAddr0_SC18 65535 "SNA" ;
VAL_ 1617 sbcVREF2P5_SC18 255 "SNA" ;
VAL_ 1617 mux910N3VRef_SC18 65535 "SNA" ;
VAL_ 1617 mux910P2P5VRef_SC18 65535 "SNA" ;
VAL_ 1617 analogHvilCurrentPWM_SC18 255 "SNA" ;
VAL_ 1617 analogSBCSupply_SC18 255 "SNA" ;
VAL_ 1617 analogHvilCurrent_SC18 255 "SNA" ;
VAL_ 1617 analogPressureSense_SC18 255 "SNA" ;
VAL_ 1617 analog5VSensorSupply_SC18 255 "SNA" ;
VAL_ 1617 analogPrechgRel2CoilMinus_SC18 255 "SNA" ;
VAL_ 1617 analogPrechgRel1CoilMinus_SC18 255 "SNA" ;
VAL_ 1617 analogNegCntr3CoilMinus_SC18 255 "SNA" ;
VAL_ 1617 analogNegCntr2CoilMinus_SC18 255 "SNA" ;
VAL_ 1617 analogNegCntr1CoilMinus_SC18 255 "SNA" ;
VAL_ 1617 analogPosCntr3CoilMinus_SC18 255 "SNA" ;
VAL_ 1617 analogPosCntr2CoilMinus_SC18 255 "SNA" ;
VAL_ 1617 analogPosCntr1CoilMinus_SC18 255 "SNA" ;
VAL_ 1617 minModuleTemperature_SC18 255 "SNA" ;
VAL_ 1617 maxModuleTemperature_SC18 255 "SNA" ;
VAL_ 1617 analogHvilReturn_SC18 255 "SNA" ;
VAL_ 1617 analog5VDSupply_SC18 255 "SNA" ;
VAL_ 1617 analogHvilOut_SC18 255 "SNA" ;
VAL_ 1617 analogCurrentSensor12V_SC18 255 "SNA" ;
VAL_ 1617 maxVREF2_SC18 65535 "SNA" ;
VAL_ 1617 minVREF2_SC18 65535 "SNA" ;
VAL_ 1617 hallCurrentOffset_SC18 65535 "SNA" ;
VAL_ 1617 sumOfCurrentsFiltered_SC18 65535 "SNA" ;
VAL_ 1617 hallCurrentAveraged_SC18 65535 "SNA" ;
VAL_ 1617 analogHallSupply_SC18 65535 "SNA" ;
VAL_ 1617 contactorControlPos1_SC18 4 "CTRCTRL_CTRFAIL" 3 "CTRCTRL_CTRON" 2 "CTRCTRL_CTRCHECK" 1 "CTRCTRL_ADDITIONAL_CTRCHECK" 0 "CTRCTRL_CTROFF" ;
VAL_ 1617 contactorControlNeg1_SC18 4 "CTRCTRL_CTRFAIL" 3 "CTRCTRL_CTRON" 2 "CTRCTRL_CTRCHECK" 1 "CTRCTRL_ADDITIONAL_CTRCHECK" 0 "CTRCTRL_CTROFF" ;
VAL_ 1617 contactorControlPre1_SC18 4 "CTRCTRL_CTRFAIL" 3 "CTRCTRL_CTRON" 2 "CTRCTRL_CTRCHECK" 1 "CTRCTRL_ADDITIONAL_CTRCHECK" 0 "CTRCTRL_CTROFF" ;
VAL_ 1617 contactorControlPos2_SC18 4 "CTRCTRL_CTRFAIL" 3 "CTRCTRL_CTRON" 2 "CTRCTRL_CTRCHECK" 1 "CTRCTRL_ADDITIONAL_CTRCHECK" 0 "CTRCTRL_CTROFF" ;
VAL_ 1617 contactorControlNeg2_SC18 4 "CTRCTRL_CTRFAIL" 3 "CTRCTRL_CTRON" 2 "CTRCTRL_CTRCHECK" 1 "CTRCTRL_ADDITIONAL_CTRCHECK" 0 "CTRCTRL_CTROFF" ;
VAL_ 1617 contactorControlPre2_SC18 4 "CTRCTRL_CTRFAIL" 3 "CTRCTRL_CTRON" 2 "CTRCTRL_CTRCHECK" 1 "CTRCTRL_ADDITIONAL_CTRCHECK" 0 "CTRCTRL_CTROFF" ;
VAL_ 1617 contactorControlPos3_SC18 4 "CTRCTRL_CTRFAIL" 3 "CTRCTRL_CTRON" 2 "CTRCTRL_CTRCHECK" 1 "CTRCTRL_ADDITIONAL_CTRCHECK" 0 "CTRCTRL_CTROFF" ;
VAL_ 1617 contactorControlNeg3_SC18 4 "CTRCTRL_CTRFAIL" 3 "CTRCTRL_CTRON" 2 "CTRCTRL_CTRCHECK" 1 "CTRCTRL_ADDITIONAL_CTRCHECK" 0 "CTRCTRL_CTROFF" ;
VAL_ 1681 selfTestFaultCntrCtrl_SC18 4 "CTRCTRL_SELFTEST_NONE" 3 "CTRCTRL_SELFTEST_4" 2 "CTRCTRL_SELFTEST_3" 1 "CTRCTRL_SELFTEST_2" 0 "CTRCTRL_SELFTEST_1" ;
VAL_ 1681 cmbASICFault_SC18 20 "CMBDRIVER_ASIC_UNEXPECTED_MODULE" 19 "CMBDRIVER_ASIC_PEC_DIAGN_READ" 18 "CMBDRIVER_ASIC_PEC_DIAGN_DATA" 17 "CMBDRIVER_ASIC_PEC_DIAGN_CMD" 16 "CMBDRIVER_ASIC_REDUNDANT_FILTER" 15 "CMBDRIVER_ASIC_REDUNDANT_ADC" 14 "CMB_ASIC_CLOCK_LF" 13 "CMB_ASIC_CHARGE_PUMP_LF" 12 "CMB_ASIC_MUX_CHECK_LF" 11 "CMB_ASIC_INTERNAL_SUP_LF" 10 "CMB_ASIC_MUX_COMP_FAIL" 9 "CMB_ASIC_CHARGE_PUMP_FAIL" 8 "CMB_ASIC_OPEN_WIRE_CURR_FAIL" 255 "CMB_ASIC_FAULT_NONE" 7 "CMB_ASIC_VREF3_FAIL" 6 "CMB_ASIC_VREF2_FAIL" 5 "CMB_ASIC_ITEMP_FAIL" 4 "CMB_ASIC_VD_FAIL" 3 "CMB_ASIC_VA_FAIL" 2 "CMB_ASIC_TESTMODE" 1 "CMB_ASIC_CLOCK_FAIL" 0 "CMB_ASIC_MUX_FAIL" ;
VAL_ 1681 mainUcExtIsoResistance_SC18 65535 "SNA" ;
VAL_ 1681 BMS_C38_AR2MsgFault_SC18 3 "MSG_MISSING" 2 "MSG_SEQ_CNT_FAULT" 1 "MSG_CRC_FAULT" 0 "MSG_VALID" ;
VAL_ 1681 stateCoolant_SC18 1 "SAFESTATE_UNSAFE" 0 "SAFESTATE_SAFE" ;
VAL_ 1681 stateThermalEvent_SC18 1 "SAFESTATE_UNSAFE" 0 "SAFESTATE_SAFE" ;
VAL_ 1681 stateCANTx_SC18 1 "SAFESTATE_UNSAFE" 0 "SAFESTATE_SAFE" ;
VAL_ 1681 mainUcCntrCtrlReq_SC18 3 "SAFETYCAN_CNTR_CTRL_SNA" 1 "SAFETYCAN_CNTR_CTRL_CLS" 0 "SAFETYCAN_CNTR_CTRL_OPEN" ;
VAL_ 1681 mainUcCntrWeldState_SC18 7 "SAFETYCAN_WELD_HV_ALL_ERR" 6 "SAFETYCAN_WELD_HV_PLUS_MINUS_ERR" 15 "SAFETYCAN_WELD_SNA" 5 "SAFETYCAN_WELD_PRE_HV_MINUS_ERR" 4 "SAFETYCAN_WELD_HV_MINUS_ERR" 3 "SAFETYCAN_WELD_PRE_HV_PLUS_ERR" 2 "SAFETYCAN_WELD_HV_PLUS_ERR" 1 "SAFETYCAN_WELD_PRE_ERR" 0 "SAFETYCAN_WELD_NO_ERR" ;
VAL_ 1681 safetyUcCntrState_SC18 2 "SAFETYCAN_CNTR_CLS" 3 "SAFETYCAN_CNTR_SNA" 1 "SAFETYCAN_CNTR_PRECHRG" 0 "SAFETYCAN_CNTR_OPEN" ;
VAL_ 1681 mainUcCntrState_SC18 2 "SAFETYCAN_CNTR_CLS" 3 "SAFETYCAN_CNTR_SNA" 1 "SAFETYCAN_CNTR_PRECHRG" 0 "SAFETYCAN_CNTR_OPEN" ;
VAL_ 1681 safetyCANMsg4Fault_SC18 6 "SAFETYCAN_E2E_CRC" 15 "SAFETYCAN_SNA" 5 "SAFETYCAN_SPI_FAIL" 4 "SAFETYCAN_MSG_MISSING" 3 "SAFETYCAN_MSG_CNT_MISMATCH" 2 "SAFETYCAN_ALIVE_CNT" 1 "SAFETYCAN_SPI_CRC" 0 "SAFETYCAN_GOOD" ;
VAL_ 1681 safetyCANMsg3Fault_SC18 6 "SAFETYCAN_E2E_CRC" 15 "SAFETYCAN_SNA" 5 "SAFETYCAN_SPI_FAIL" 4 "SAFETYCAN_MSG_MISSING" 3 "SAFETYCAN_MSG_CNT_MISMATCH" 2 "SAFETYCAN_ALIVE_CNT" 1 "SAFETYCAN_SPI_CRC" 0 "SAFETYCAN_GOOD" ;
VAL_ 1681 safetyCANMsg2Fault_SC18 6 "SAFETYCAN_E2E_CRC" 15 "SAFETYCAN_SNA" 5 "SAFETYCAN_SPI_FAIL" 4 "SAFETYCAN_MSG_MISSING" 3 "SAFETYCAN_MSG_CNT_MISMATCH" 2 "SAFETYCAN_ALIVE_CNT" 1 "SAFETYCAN_SPI_CRC" 0 "SAFETYCAN_GOOD" ;
VAL_ 1681 safetyCANMsg1Fault_SC18 6 "SAFETYCAN_E2E_CRC" 15 "SAFETYCAN_SNA" 5 "SAFETYCAN_SPI_FAIL" 4 "SAFETYCAN_MSG_MISSING" 3 "SAFETYCAN_MSG_CNT_MISMATCH" 2 "SAFETYCAN_ALIVE_CNT" 1 "SAFETYCAN_SPI_CRC" 0 "SAFETYCAN_GOOD" ;
VAL_ 1681 contactorCntrSelfTest_SC18 9 "CTRCTRL_CHKLOSIDE_OPEN_CIRC" 8 "CTRCTRL_FAILED" 7 "CTRCTRL_PASSED" 6 "CTRCTRL_CHKHISIDE_STUCK_OPEN" 5 "CTRCTRL_CHK_CLOSE_OK_CIRCUIT" 4 "CTRCTRL_CHKLOSIDE_CTRL_OK" 3 "CTRCTRL_CHKLOSIDE_STUCK_CLOSED" 2 "CTRCTRL_CHKHISIDE_STUCK_CLOSED" 1 "CTRCTRL_PENDING" 0 "CTRCTRL_INIT" ;
VAL_ 1681 maxBrickVoltage_SC18 65535 "SNA" ;
VAL_ 1681 minBrickVoltage_SC18 65535 "SNA" ;
VAL_ 1681 cmbLastUpdateTime_SC18 255 "SNA" ;
VAL_ 1681 weldCheckState_SC18 4 "WELDCHECK_IDLE" 3 "WELDCHECK" 2 "WELDCHECK_ISO_2" 1 "WELDCHECK_ISO_1" 0 "WELDCHECK_INIT" ;
VAL_ 1681 debugFastMpex_SC18 0 "F00" 1 "F01" 2 "F02" 3 "F03" 4 "F04" 5 "F05" 6 "F06" 7 "F07" 8 "F08" 9 "F09" 10 "F10" 11 "F11" 12 "F12" 13 "F13" 14 "F14" 15 "F15" ;
VAL_ 1681 SPIRxTxTimeAllPckts_SC18 255 "SNA" ;
VAL_ 1681 stateContactorControl_SC18 1 "SAFESTATE_UNSAFE" 0 "SAFESTATE_SAFE" ;
VAL_ 1681 analogCntrPwrPlus_SC18 255 "SNA" ;
VAL_ 1681 weldedState_SC18 2 "CTR_WELD_SNA" 0 "CTR_NOTWELDED" 1 "CTR_ATLEASTONE_WELDED" ;
VAL_ 1681 stateVoltage_SC18 1 "SAFESTATE_UNSAFE" 0 "SAFESTATE_SAFE" ;
VAL_ 1681 stateTemperature_SC18 1 "SAFESTATE_UNSAFE" 0 "SAFESTATE_SAFE" ;
VAL_ 1681 stateSelfTest_SC18 1 "SAFESTATE_UNSAFE" 0 "SAFESTATE_SAFE" ;
VAL_ 1681 stateHVIL_SC18 1 "SAFESTATE_UNSAFE" 0 "SAFESTATE_SAFE" ;
VAL_ 1681 stateCurrent_SC18 1 "SAFESTATE_UNSAFE" 0 "SAFESTATE_SAFE" ;
VAL_ 1681 stateCrash2_SC18 1 "SAFESTATE_UNSAFE" 0 "SAFESTATE_SAFE" ;
VAL_ 1681 stateCrash1_SC18 1 "SAFESTATE_UNSAFE" 0 "SAFESTATE_SAFE" ;
VAL_ 1681 stateContactors_SC18 1 "SAFESTATE_UNSAFE" 0 "SAFESTATE_SAFE" ;
VAL_ 1681 stateCANRx_SC18 1 "SAFESTATE_UNSAFE" 0 "SAFESTATE_SAFE" ;
VAL_ 1681 itemState_SC18 15 "ITEM_INVALID" 2 "ITEM_EMERGENCY" 1 "ITEM_OFF" 0 "ITEM_ON" ;
VAL_ 1681 posPack_SC18 65535 "SNA" ;
VAL_ 1681 posLink_SC18 65535 "SNA" ;
VAL_ 1681 negPack_SC18 65535 "SNA" ;
VAL_ 1681 negLink_SC18 65535 "SNA" ;
VAL_ 1681 hallCurrent_SC18 4095 "SNA" ;
VAL_ 1681 analogCntrPwrPlusISense_SC18 255 "SNA" ;
VAL_ 1681 analogCntrPwrPlusSwitched_SC18 255 "SNA" ;
VAL_ 1937 cmbCoolantTemp08_BMS18 255 "SNA" ;
VAL_ 1937 cmbCoolantTemp07_BMS18 255 "SNA" ;
VAL_ 1937 cmbCoolantTemp06_BMS18 255 "SNA" ;
VAL_ 1937 cmbCoolantTemp05_BMS18 255 "SNA" ;
VAL_ 1937 cmbCoolantTemp04_BMS18 255 "SNA" ;
VAL_ 1937 cmbCoolantTemp03_BMS18 255 "SNA" ;
VAL_ 1937 cmbCoolantTemp02_BMS18 255 "SNA" ;
VAL_ 1937 cmbCoolantTemp01_BMS18 255 "SNA" ;
VAL_ 1937 cmbOnboardPressure32_BMS18 65535 "SNA" ;
VAL_ 1937 cmbOnboardPressure31_BMS18 65535 "SNA" ;
VAL_ 1937 cmbOnboardPressure30_BMS18 65535 "SNA" ;
VAL_ 1937 cmbOnboardPressure29_BMS18 65535 "SNA" ;
VAL_ 1937 cmbOnboardPressure28_BMS18 65535 "SNA" ;
VAL_ 1937 cmbOnboardPressure27_BMS18 65535 "SNA" ;
VAL_ 1937 cmbOnboardPressure26_BMS18 65535 "SNA" ;
VAL_ 1937 cmbOnboardPressure25_BMS18 65535 "SNA" ;
VAL_ 1937 cmbOnboardPressure24_BMS18 65535 "SNA" ;
VAL_ 1937 cmbOnboardPressure23_BMS18 65535 "SNA" ;
VAL_ 1937 cmbOnboardPressure22_BMS18 65535 "SNA" ;
VAL_ 1937 cmbOnboardPressure21_BMS18 65535 "SNA" ;
VAL_ 1937 cmbOnboardPressure20_BMS18 65535 "SNA" ;
VAL_ 1937 cmbOnboardPressure19_BMS18 65535 "SNA" ;
VAL_ 1937 cmbOnboardPressure18_BMS18 65535 "SNA" ;
VAL_ 1937 cmbOnboardPressure17_BMS18 65535 "SNA" ;
VAL_ 1937 cmbOnboardPressure16_BMS18 65535 "SNA" ;
VAL_ 1937 cmbOnboardPressure15_BMS18 65535 "SNA" ;
VAL_ 1937 cmbOnboardPressure14_BMS18 65535 "SNA" ;
VAL_ 1937 cmbOnboardPressure13_BMS18 65535 "SNA" ;
VAL_ 1937 cmbOnboardPressure12_BMS18 65535 "SNA" ;
VAL_ 1937 cmbOnboardPressure11_BMS18 65535 "SNA" ;
VAL_ 1937 cmbOnboardPressure10_BMS18 65535 "SNA" ;
VAL_ 1937 cmbOnboardPressure09_BMS18 65535 "SNA" ;
VAL_ 1937 cmbOnboardPressure08_BMS18 65535 "SNA" ;
VAL_ 1937 cmbOnboardPressure07_BMS18 65535 "SNA" ;
VAL_ 1937 cmbOnboardPressure06_BMS18 65535 "SNA" ;
VAL_ 1937 cmbOnboardPressure05_BMS18 65535 "SNA" ;
VAL_ 1937 cmbOnboardPressure04_BMS18 65535 "SNA" ;
VAL_ 1937 cmbOnboardPressure03_BMS18 65535 "SNA" ;
VAL_ 1937 cmbOnboardPressure02_BMS18 65535 "SNA" ;
VAL_ 1937 cmbOnboardPressure01_BMS18 65535 "SNA" ;
VAL_ 1937 onboardMultiplexor_BMS18 32 "O32" 31 "O31" 30 "O30" 29 "O29" 28 "O28" 27 "O27" 26 "O26" 25 "O25" 24 "O24" 23 "O23" 22 "O22" 21 "O21" 20 "O20" 19 "O19" 18 "O18" 17 "O17" 16 "O16" 15 "O15" 14 "O14" 13 "O13" 0 "O00" 1 "O01" 2 "O02" 3 "O03" 4 "O04" 5 "O05" 6 "O06" 7 "O07" 8 "O08" 9 "O09" 10 "O10" 11 "O11" 12 "O12" ;
VAL_ 1937 minCmbOnboardTemperature_BMS18 255 "SNA" ;
VAL_ 1937 minCmbOnboardHumidity_BMS18 255 "SNA" ;
VAL_ 1937 maxCmbOnboardTemperature_BMS18 255 "SNA" ;
VAL_ 1937 maxCmbOnboardHumidity_BMS18 255 "SNA" ;
VAL_ 1937 bmsOnboardTemperature_BMS18 255 "SNA" ;
VAL_ 1937 bmsOnboardHumidity_BMS18 255 "SNA" ;
VAL_ 1937 cmbOnboardTemperature01_BMS18 255 "SNA" ;
VAL_ 1937 cmbOnboardHumidity01_BMS18 255 "SNA" ;
VAL_ 1937 moduleHeaterCurrent01_BMS18 255 "SNA" ;
VAL_ 1937 cmbOnboardTemperature02_BMS18 255 "SNA" ;
VAL_ 1937 cmbOnboardHumidity02_BMS18 255 "SNA" ;
VAL_ 1937 moduleHeaterCurrent02_BMS18 255 "SNA" ;
VAL_ 1937 cmbOnboardTemperature03_BMS18 255 "SNA" ;
VAL_ 1937 cmbOnboardHumidity03_BMS18 255 "SNA" ;
VAL_ 1937 moduleHeaterCurrent03_BMS18 255 "SNA" ;
VAL_ 1937 cmbOnboardTemperature04_BMS18 255 "SNA" ;
VAL_ 1937 cmbOnboardHumidity04_BMS18 255 "SNA" ;
VAL_ 1937 moduleHeaterCurrent04_BMS18 255 "SNA" ;
VAL_ 1937 cmbOnboardTemperature05_BMS18 255 "SNA" ;
VAL_ 1937 cmbOnboardHumidity05_BMS18 255 "SNA" ;
VAL_ 1937 moduleHeaterCurrent05_BMS18 255 "SNA" ;
VAL_ 1937 cmbOnboardTemperature06_BMS18 255 "SNA" ;
VAL_ 1937 cmbOnboardHumidity06_BMS18 255 "SNA" ;
VAL_ 1937 moduleHeaterCurrent06_BMS18 255 "SNA" ;
VAL_ 1937 cmbOnboardTemperature07_BMS18 255 "SNA" ;
VAL_ 1937 cmbOnboardHumidity07_BMS18 255 "SNA" ;
VAL_ 1937 moduleHeaterCurrent07_BMS18 255 "SNA" ;
VAL_ 1937 cmbOnboardTemperature08_BMS18 255 "SNA" ;
VAL_ 1937 cmbOnboardHumidity08_BMS18 255 "SNA" ;
VAL_ 1937 moduleHeaterCurrent08_BMS18 255 "SNA" ;
VAL_ 1937 cmbOnboardTemperature09_BMS18 255 "SNA" ;
VAL_ 1937 cmbOnboardHumidity09_BMS18 255 "SNA" ;
VAL_ 1937 moduleHeaterCurrent09_BMS18 255 "SNA" ;
VAL_ 1937 cmbOnboardTemperature10_BMS18 255 "SNA" ;
VAL_ 1937 cmbOnboardHumidity10_BMS18 255 "SNA" ;
VAL_ 1937 moduleHeaterCurrent10_BMS18 255 "SNA" ;
VAL_ 1937 cmbOnboardTemperature11_BMS18 255 "SNA" ;
VAL_ 1937 cmbOnboardHumidity11_BMS18 255 "SNA" ;
VAL_ 1937 moduleHeaterCurrent11_BMS18 255 "SNA" ;
VAL_ 1937 cmbOnboardTemperature12_BMS18 255 "SNA" ;
VAL_ 1937 cmbOnboardHumidity12_BMS18 255 "SNA" ;
VAL_ 1937 moduleHeaterCurrent12_BMS18 255 "SNA" ;
VAL_ 1937 cmbOnboardTemperature13_BMS18 255 "SNA" ;
VAL_ 1937 cmbOnboardHumidity13_BMS18 255 "SNA" ;
VAL_ 1937 moduleHeaterCurrent13_BMS18 255 "SNA" ;
VAL_ 1937 cmbOnboardTemperature14_BMS18 255 "SNA" ;
VAL_ 1937 cmbOnboardHumidity14_BMS18 255 "SNA" ;
VAL_ 1937 moduleHeaterCurrent14_BMS18 255 "SNA" ;
VAL_ 1937 cmbOnboardTemperature15_BMS18 255 "SNA" ;
VAL_ 1937 cmbOnboardHumidity15_BMS18 255 "SNA" ;
VAL_ 1937 moduleHeaterCurrent15_BMS18 255 "SNA" ;
VAL_ 1937 cmbOnboardTemperature16_BMS18 255 "SNA" ;
VAL_ 1937 cmbOnboardHumidity16_BMS18 255 "SNA" ;
VAL_ 1937 moduleHeaterCurrent16_BMS18 255 "SNA" ;
VAL_ 1937 cmbOnboardTemperature17_BMS18 255 "SNA" ;
VAL_ 1937 cmbOnboardHumidity17_BMS18 255 "SNA" ;
VAL_ 1937 moduleHeaterCurrent17_BMS18 255 "SNA" ;
VAL_ 1937 cmbOnboardTemperature18_BMS18 255 "SNA" ;
VAL_ 1937 cmbOnboardHumidity18_BMS18 255 "SNA" ;
VAL_ 1937 moduleHeaterCurrent18_BMS18 255 "SNA" ;
VAL_ 1937 cmbOnboardTemperature19_BMS18 255 "SNA" ;
VAL_ 1937 cmbOnboardHumidity19_BMS18 255 "SNA" ;
VAL_ 1937 moduleHeaterCurrent19_BMS18 255 "SNA" ;
VAL_ 1937 cmbOnboardTemperature20_BMS18 255 "SNA" ;
VAL_ 1937 cmbOnboardHumidity20_BMS18 255 "SNA" ;
VAL_ 1937 moduleHeaterCurrent20_BMS18 255 "SNA" ;
VAL_ 1937 cmbOnboardTemperature21_BMS18 255 "SNA" ;
VAL_ 1937 cmbOnboardHumidity21_BMS18 255 "SNA" ;
VAL_ 1937 moduleHeaterCurrent21_BMS18 255 "SNA" ;
VAL_ 1937 cmbOnboardTemperature22_BMS18 255 "SNA" ;
VAL_ 1937 cmbOnboardHumidity22_BMS18 255 "SNA" ;
VAL_ 1937 moduleHeaterCurrent22_BMS18 255 "SNA" ;
VAL_ 1937 cmbOnboardTemperature23_BMS18 255 "SNA" ;
VAL_ 1937 cmbOnboardHumidity23_BMS18 255 "SNA" ;
VAL_ 1937 moduleHeaterCurrent23_BMS18 255 "SNA" ;
VAL_ 1937 cmbOnboardTemperature24_BMS18 255 "SNA" ;
VAL_ 1937 cmbOnboardHumidity24_BMS18 255 "SNA" ;
VAL_ 1937 moduleHeaterCurrent24_BMS18 255 "SNA" ;
VAL_ 1937 cmbOnboardTemperature25_BMS18 255 "SNA" ;
VAL_ 1937 cmbOnboardHumidity25_BMS18 255 "SNA" ;
VAL_ 1937 moduleHeaterCurrent25_BMS18 255 "SNA" ;
VAL_ 1937 cmbOnboardTemperature26_BMS18 255 "SNA" ;
VAL_ 1937 cmbOnboardHumidity26_BMS18 255 "SNA" ;
VAL_ 1937 moduleHeaterCurrent26_BMS18 255 "SNA" ;
VAL_ 1937 cmbOnboardTemperature27_BMS18 255 "SNA" ;
VAL_ 1937 cmbOnboardHumidity27_BMS18 255 "SNA" ;
VAL_ 1937 moduleHeaterCurrent27_BMS18 255 "SNA" ;
VAL_ 1937 cmbOnboardTemperature28_BMS18 255 "SNA" ;
VAL_ 1937 cmbOnboardHumidity28_BMS18 255 "SNA" ;
VAL_ 1937 moduleHeaterCurrent28_BMS18 255 "SNA" ;
VAL_ 1937 cmbOnboardTemperature29_BMS18 255 "SNA" ;
VAL_ 1937 cmbOnboardHumidity29_BMS18 255 "SNA" ;
VAL_ 1937 moduleHeaterCurrent29_BMS18 255 "SNA" ;
VAL_ 1937 cmbOnboardTemperature30_BMS18 255 "SNA" ;
VAL_ 1937 cmbOnboardHumidity30_BMS18 255 "SNA" ;
VAL_ 1937 moduleHeaterCurrent30_BMS18 255 "SNA" ;
VAL_ 1937 cmbOnboardTemperature31_BMS18 255 "SNA" ;
VAL_ 1937 cmbOnboardHumidity31_BMS18 255 "SNA" ;
VAL_ 1937 moduleHeaterCurrent31_BMS18 255 "SNA" ;
VAL_ 1937 cmbOnboardTemperature32_BMS18 255 "SNA" ;
VAL_ 1937 cmbOnboardHumidity32_BMS18 255 "SNA" ;
VAL_ 1937 moduleHeaterCurrent32_BMS18 255 "SNA" ;
VAL_ 2001 cmbMultiplexor_BMS18 0 "C000" 1 "C001" 2 "C002" 3 "C003" 4 "C004" 5 "C005" 6 "C006" 7 "C007" 8 "C008" 9 "C009" 10 "C010" 11 "C011" 12 "C012" 13 "C013" 14 "C014" 15 "C015" 16 "C016" 17 "C017" 18 "C018" 19 "C019" 20 "C020" 21 "C021" 22 "C022" 23 "C023" 24 "C024" 25 "C025" 26 "C026" 27 "C027" 28 "C028" 29 "C029" 30 "C030" 31 "C031" 32 "C032" 33 "C033" 34 "C034" 35 "C035" 36 "C036" 37 "C037" 38 "C038" 39 "C039" 40 "C040" 41 "C041" 42 "C042" 43 "C043" 44 "C044" 45 "C045" 46 "C046" 47 "C047" 48 "C048" 49 "C049" 50 "C050" 51 "C051" 52 "C052" 53 "C053" 54 "C054" 55 "C055" 56 "C056" 57 "C057" 58 "C058" 59 "C059" 60 "C060" 61 "C061" 62 "C062" 63 "C063" 64 "C064" 65 "C065" 66 "C066" 67 "C067" 68 "C068" 69 "C069" 70 "C070" 71 "C071" 72 "C072" 73 "C073" 74 "C074" 75 "C075" 76 "C076" 77 "C077" 78 "C078" 79 "C079" 80 "C080" 81 "C081" 82 "C082" 83 "C083" 84 "C084" 85 "C085" 86 "C086" 87 "C087" 88 "C088" 89 "C089" 90 "C090" 91 "C091" 92 "C092" 93 "C093" 94 "C094" 95 "C095" 96 "C096" 97 "C097" 98 "C098" 99 "C099" 100 "C100" 101 "C101" 102 "C102" 103 "C103" 104 "C104" 105 "C105" 106 "C106" 107 "C107" 108 "C108" 109 "C109" 110 "C110" 111 "C111" 112 "C112" 113 "C113" 114 "C114" 115 "C115" 116 "C116" 117 "C117" 118 "C118" 119 "C119" 120 "C120" 121 "C121" 122 "C122" 123 "C123" 124 "C124" 125 "C125" 126 "C126" 127 "C127" 128 "C128" 129 "C129" 130 "C130" 131 "C131" 132 "C132" 133 "C133" 134 "C134" 135 "C135" 136 "C136" 137 "C137" 138 "C138" 139 "C139" 140 "C140" 141 "C141" 142 "C142" 143 "C143" 144 "C144" 145 "C145" 146 "C146" 147 "C147" 148 "C148" 149 "C149" 150 "C150" 151 "C151" 152 "C152" 153 "C153" 154 "C154" 155 "C155" 156 "C156" 157 "C157" 158 "C158" 159 "C159" 160 "C160" 161 "C161" 162 "C162" 163 "C163" 164 "C164" 165 "C165" 166 "C166" 167 "C167" 168 "C168" 169 "C169" 170 "C170" 171 "C171" 172 "C172" 173 "C173" 174 "C174" 175 "C175" 176 "C176" 177 "C177" 178 "C178" 179 "C179" 180 "C180" 181 "C181" 182 "C182" 183 "C183" 184 "C184" 185 "C185" 186 "C186" 187 "C187" 188 "C188" 189 "C189" 190 "C190" 191 "C191" 192 "C192" ;
VAL_ 2001 moduleTemperature01_BMS18 255 "SNA" ;
VAL_ 2001 brickVoltage001_BMS18 65535 "SNA" ;
VAL_ 2001 brickVoltage002_BMS18 65535 "SNA" ;
VAL_ 2001 brickVoltage003_BMS18 65535 "SNA" ;
VAL_ 2001 moduleTemperature02_BMS18 255 "SNA" ;
VAL_ 2001 brickVoltage004_BMS18 65535 "SNA" ;
VAL_ 2001 brickVoltage005_BMS18 65535 "SNA" ;
VAL_ 2001 brickVoltage006_BMS18 65535 "SNA" ;
VAL_ 2001 moduleTemperature03_BMS18 255 "SNA" ;
VAL_ 2001 brickVoltage007_BMS18 65535 "SNA" ;
VAL_ 2001 brickVoltage008_BMS18 65535 "SNA" ;
VAL_ 2001 brickVoltage009_BMS18 65535 "SNA" ;
VAL_ 2001 moduleTemperature04_BMS18 255 "SNA" ;
VAL_ 2001 brickVoltage010_BMS18 65535 "SNA" ;
VAL_ 2001 brickVoltage011_BMS18 65535 "SNA" ;
VAL_ 2001 brickVoltage012_BMS18 65535 "SNA" ;
VAL_ 2001 moduleTemperature05_BMS18 255 "SNA" ;
VAL_ 2001 brickVoltage013_BMS18 65535 "SNA" ;
VAL_ 2001 brickVoltage014_BMS18 65535 "SNA" ;
VAL_ 2001 brickVoltage015_BMS18 65535 "SNA" ;
VAL_ 2001 moduleTemperature06_BMS18 255 "SNA" ;
VAL_ 2001 brickVoltage016_BMS18 65535 "SNA" ;
VAL_ 2001 brickVoltage017_BMS18 65535 "SNA" ;
VAL_ 2001 brickVoltage018_BMS18 65535 "SNA" ;
VAL_ 2001 moduleTemperature07_BMS18 255 "SNA" ;
VAL_ 2001 brickVoltage019_BMS18 65535 "SNA" ;
VAL_ 2001 brickVoltage020_BMS18 65535 "SNA" ;
VAL_ 2001 brickVoltage021_BMS18 65535 "SNA" ;
VAL_ 2001 moduleTemperature08_BMS18 255 "SNA" ;
VAL_ 2001 brickVoltage022_BMS18 65535 "SNA" ;
VAL_ 2001 brickVoltage023_BMS18 65535 "SNA" ;
VAL_ 2001 brickVoltage024_BMS18 65535 "SNA" ;
VAL_ 2001 moduleTemperature09_BMS18 255 "SNA" ;
VAL_ 2001 brickVoltage025_BMS18 65535 "SNA" ;
VAL_ 2001 brickVoltage026_BMS18 65535 "SNA" ;
VAL_ 2001 brickVoltage027_BMS18 65535 "SNA" ;
VAL_ 2001 moduleTemperature10_BMS18 255 "SNA" ;
VAL_ 2001 brickVoltage028_BMS18 65535 "SNA" ;
VAL_ 2001 brickVoltage029_BMS18 65535 "SNA" ;
VAL_ 2001 brickVoltage030_BMS18 65535 "SNA" ;
VAL_ 2001 moduleTemperature11_BMS18 255 "SNA" ;
VAL_ 2001 brickVoltage031_BMS18 65535 "SNA" ;
VAL_ 2001 brickVoltage032_BMS18 65535 "SNA" ;
VAL_ 2001 brickVoltage033_BMS18 65535 "SNA" ;
VAL_ 2001 moduleTemperature12_BMS18 255 "SNA" ;
VAL_ 2001 brickVoltage034_BMS18 65535 "SNA" ;
VAL_ 2001 brickVoltage035_BMS18 65535 "SNA" ;
VAL_ 2001 brickVoltage036_BMS18 65535 "SNA" ;
VAL_ 2001 moduleTemperature13_BMS18 255 "SNA" ;
VAL_ 2001 brickVoltage037_BMS18 65535 "SNA" ;
VAL_ 2001 brickVoltage038_BMS18 65535 "SNA" ;
VAL_ 2001 brickVoltage039_BMS18 65535 "SNA" ;
VAL_ 2001 moduleTemperature14_BMS18 255 "SNA" ;
VAL_ 2001 brickVoltage040_BMS18 65535 "SNA" ;
VAL_ 2001 brickVoltage041_BMS18 65535 "SNA" ;
VAL_ 2001 brickVoltage042_BMS18 65535 "SNA" ;
VAL_ 2001 moduleTemperature15_BMS18 255 "SNA" ;
VAL_ 2001 brickVoltage043_BMS18 65535 "SNA" ;
VAL_ 2001 brickVoltage044_BMS18 65535 "SNA" ;
VAL_ 2001 brickVoltage045_BMS18 65535 "SNA" ;
VAL_ 2001 moduleTemperature16_BMS18 255 "SNA" ;
VAL_ 2001 brickVoltage046_BMS18 65535 "SNA" ;
VAL_ 2001 brickVoltage047_BMS18 65535 "SNA" ;
VAL_ 2001 brickVoltage048_BMS18 65535 "SNA" ;
VAL_ 2001 moduleTemperature17_BMS18 255 "SNA" ;
VAL_ 2001 brickVoltage049_BMS18 65535 "SNA" ;
VAL_ 2001 brickVoltage050_BMS18 65535 "SNA" ;
VAL_ 2001 brickVoltage051_BMS18 65535 "SNA" ;
VAL_ 2001 moduleTemperature18_BMS18 255 "SNA" ;
VAL_ 2001 brickVoltage052_BMS18 65535 "SNA" ;
VAL_ 2001 brickVoltage053_BMS18 65535 "SNA" ;
VAL_ 2001 brickVoltage054_BMS18 65535 "SNA" ;
VAL_ 2001 moduleTemperature19_BMS18 255 "SNA" ;
VAL_ 2001 brickVoltage055_BMS18 65535 "SNA" ;
VAL_ 2001 brickVoltage056_BMS18 65535 "SNA" ;
VAL_ 2001 brickVoltage057_BMS18 65535 "SNA" ;
VAL_ 2001 moduleTemperature20_BMS18 255 "SNA" ;
VAL_ 2001 brickVoltage058_BMS18 65535 "SNA" ;
VAL_ 2001 brickVoltage059_BMS18 65535 "SNA" ;
VAL_ 2001 brickVoltage060_BMS18 65535 "SNA" ;
VAL_ 2001 moduleTemperature21_BMS18 255 "SNA" ;
VAL_ 2001 brickVoltage061_BMS18 65535 "SNA" ;
VAL_ 2001 brickVoltage062_BMS18 65535 "SNA" ;
VAL_ 2001 brickVoltage063_BMS18 65535 "SNA" ;
VAL_ 2001 moduleTemperature22_BMS18 255 "SNA" ;
VAL_ 2001 brickVoltage064_BMS18 65535 "SNA" ;
VAL_ 2001 brickVoltage065_BMS18 65535 "SNA" ;
VAL_ 2001 brickVoltage066_BMS18 65535 "SNA" ;
VAL_ 2001 moduleTemperature23_BMS18 255 "SNA" ;
VAL_ 2001 brickVoltage067_BMS18 65535 "SNA" ;
VAL_ 2001 brickVoltage068_BMS18 65535 "SNA" ;
VAL_ 2001 brickVoltage069_BMS18 65535 "SNA" ;
VAL_ 2001 moduleTemperature24_BMS18 255 "SNA" ;
VAL_ 2001 brickVoltage070_BMS18 65535 "SNA" ;
VAL_ 2001 brickVoltage071_BMS18 65535 "SNA" ;
VAL_ 2001 brickVoltage072_BMS18 65535 "SNA" ;
VAL_ 2001 moduleTemperature25_BMS18 255 "SNA" ;
VAL_ 2001 brickVoltage073_BMS18 65535 "SNA" ;
VAL_ 2001 brickVoltage074_BMS18 65535 "SNA" ;
VAL_ 2001 brickVoltage075_BMS18 65535 "SNA" ;
VAL_ 2001 moduleTemperature26_BMS18 255 "SNA" ;
VAL_ 2001 brickVoltage076_BMS18 65535 "SNA" ;
VAL_ 2001 brickVoltage077_BMS18 65535 "SNA" ;
VAL_ 2001 brickVoltage078_BMS18 65535 "SNA" ;
VAL_ 2001 moduleTemperature27_BMS18 255 "SNA" ;
VAL_ 2001 brickVoltage079_BMS18 65535 "SNA" ;
VAL_ 2001 brickVoltage080_BMS18 65535 "SNA" ;
VAL_ 2001 brickVoltage081_BMS18 65535 "SNA" ;
VAL_ 2001 moduleTemperature28_BMS18 255 "SNA" ;
VAL_ 2001 brickVoltage082_BMS18 65535 "SNA" ;
VAL_ 2001 brickVoltage083_BMS18 65535 "SNA" ;
VAL_ 2001 brickVoltage084_BMS18 65535 "SNA" ;
VAL_ 2001 moduleTemperature29_BMS18 255 "SNA" ;
VAL_ 2001 brickVoltage085_BMS18 65535 "SNA" ;
VAL_ 2001 brickVoltage086_BMS18 65535 "SNA" ;
VAL_ 2001 brickVoltage087_BMS18 65535 "SNA" ;
VAL_ 2001 moduleTemperature30_BMS18 255 "SNA" ;
VAL_ 2001 brickVoltage088_BMS18 65535 "SNA" ;
VAL_ 2001 brickVoltage089_BMS18 65535 "SNA" ;
VAL_ 2001 brickVoltage090_BMS18 65535 "SNA" ;
VAL_ 2001 moduleTemperature31_BMS18 255 "SNA" ;
VAL_ 2001 brickVoltage091_BMS18 65535 "SNA" ;
VAL_ 2001 brickVoltage092_BMS18 65535 "SNA" ;
VAL_ 2001 brickVoltage093_BMS18 65535 "SNA" ;
VAL_ 2001 moduleTemperature32_BMS18 255 "SNA" ;
VAL_ 2001 brickVoltage094_BMS18 65535 "SNA" ;
VAL_ 2001 brickVoltage095_BMS18 65535 "SNA" ;
VAL_ 2001 brickVoltage096_BMS18 65535 "SNA" ;
VAL_ 2001 brickVoltage097_BMS18 65535 "SNA" ;
VAL_ 2001 brickVoltage098_BMS18 65535 "SNA" ;
VAL_ 2001 brickVoltage099_BMS18 65535 "SNA" ;
VAL_ 2001 brickVoltage100_BMS18 65535 "SNA" ;
VAL_ 2001 brickVoltage101_BMS18 65535 "SNA" ;
VAL_ 2001 brickVoltage102_BMS18 65535 "SNA" ;
VAL_ 2001 brickVoltage103_BMS18 65535 "SNA" ;
VAL_ 2001 brickVoltage104_BMS18 65535 "SNA" ;
VAL_ 2001 brickVoltage105_BMS18 65535 "SNA" ;
VAL_ 2001 brickVoltage106_BMS18 65535 "SNA" ;
VAL_ 2001 brickVoltage107_BMS18 65535 "SNA" ;
VAL_ 2001 brickVoltage108_BMS18 65535 "SNA" ;
VAL_ 2001 brickVoltage109_BMS18 65535 "SNA" ;
VAL_ 2001 brickVoltage110_BMS18 65535 "SNA" ;
VAL_ 2001 brickVoltage111_BMS18 65535 "SNA" ;
VAL_ 2001 brickVoltage112_BMS18 65535 "SNA" ;
VAL_ 2001 brickVoltage113_BMS18 65535 "SNA" ;
VAL_ 2001 brickVoltage114_BMS18 65535 "SNA" ;
VAL_ 2001 brickVoltage115_BMS18 65535 "SNA" ;
VAL_ 2001 brickVoltage116_BMS18 65535 "SNA" ;
VAL_ 2001 brickVoltage117_BMS18 65535 "SNA" ;
VAL_ 2001 brickVoltage118_BMS18 65535 "SNA" ;
VAL_ 2001 brickVoltage119_BMS18 65535 "SNA" ;
VAL_ 2001 brickVoltage120_BMS18 65535 "SNA" ;
VAL_ 2001 brickVoltage121_BMS18 65535 "SNA" ;
VAL_ 2001 brickVoltage122_BMS18 65535 "SNA" ;
VAL_ 2001 brickVoltage123_BMS18 65535 "SNA" ;
VAL_ 2001 brickVoltage124_BMS18 65535 "SNA" ;
VAL_ 2001 brickVoltage125_BMS18 65535 "SNA" ;
VAL_ 2001 brickVoltage126_BMS18 65535 "SNA" ;
VAL_ 2001 brickVoltage127_BMS18 65535 "SNA" ;
VAL_ 2001 brickVoltage128_BMS18 65535 "SNA" ;
VAL_ 2001 brickVoltage129_BMS18 65535 "SNA" ;
VAL_ 2001 brickVoltage130_BMS18 65535 "SNA" ;
VAL_ 2001 brickVoltage131_BMS18 65535 "SNA" ;
VAL_ 2001 brickVoltage132_BMS18 65535 "SNA" ;
VAL_ 2001 brickVoltage133_BMS18 65535 "SNA" ;
VAL_ 2001 brickVoltage134_BMS18 65535 "SNA" ;
VAL_ 2001 brickVoltage135_BMS18 65535 "SNA" ;
VAL_ 2001 brickVoltage136_BMS18 65535 "SNA" ;
VAL_ 2001 brickVoltage137_BMS18 65535 "SNA" ;
VAL_ 2001 brickVoltage138_BMS18 65535 "SNA" ;
VAL_ 2001 brickVoltage139_BMS18 65535 "SNA" ;
VAL_ 2001 brickVoltage140_BMS18 65535 "SNA" ;
VAL_ 2001 brickVoltage141_BMS18 65535 "SNA" ;
VAL_ 2001 brickVoltage142_BMS18 65535 "SNA" ;
VAL_ 2001 brickVoltage143_BMS18 65535 "SNA" ;
VAL_ 2001 brickVoltage144_BMS18 65535 "SNA" ;
VAL_ 2001 brickVoltage145_BMS18 65535 "SNA" ;
VAL_ 2001 brickVoltage146_BMS18 65535 "SNA" ;
VAL_ 2001 brickVoltage147_BMS18 65535 "SNA" ;
VAL_ 2001 brickVoltage148_BMS18 65535 "SNA" ;
VAL_ 2001 brickVoltage149_BMS18 65535 "SNA" ;
VAL_ 2001 brickVoltage150_BMS18 65535 "SNA" ;
VAL_ 2001 brickVoltage151_BMS18 65535 "SNA" ;
VAL_ 2001 brickVoltage152_BMS18 65535 "SNA" ;
VAL_ 2001 brickVoltage153_BMS18 65535 "SNA" ;
VAL_ 2001 brickVoltage154_BMS18 65535 "SNA" ;
VAL_ 2001 brickVoltage155_BMS18 65535 "SNA" ;
VAL_ 2001 brickVoltage156_BMS18 65535 "SNA" ;
VAL_ 2001 brickVoltage157_BMS18 65535 "SNA" ;
VAL_ 2001 brickVoltage158_BMS18 65535 "SNA" ;
VAL_ 2001 brickVoltage159_BMS18 65535 "SNA" ;
VAL_ 2001 brickVoltage160_BMS18 65535 "SNA" ;
VAL_ 2001 brickVoltage161_BMS18 65535 "SNA" ;
VAL_ 2001 brickVoltage162_BMS18 65535 "SNA" ;
VAL_ 2001 brickVoltage163_BMS18 65535 "SNA" ;
VAL_ 2001 brickVoltage164_BMS18 65535 "SNA" ;
VAL_ 2001 brickVoltage165_BMS18 65535 "SNA" ;
VAL_ 2001 brickVoltage166_BMS18 65535 "SNA" ;
VAL_ 2001 brickVoltage167_BMS18 65535 "SNA" ;
VAL_ 2001 brickVoltage168_BMS18 65535 "SNA" ;
VAL_ 2001 brickVoltage169_BMS18 65535 "SNA" ;
VAL_ 2001 brickVoltage170_BMS18 65535 "SNA" ;
VAL_ 2001 brickVoltage171_BMS18 65535 "SNA" ;
VAL_ 2001 brickVoltage172_BMS18 65535 "SNA" ;
VAL_ 2001 brickVoltage173_BMS18 65535 "SNA" ;
VAL_ 2001 brickVoltage174_BMS18 65535 "SNA" ;
VAL_ 2001 brickVoltage175_BMS18 65535 "SNA" ;
VAL_ 2001 brickVoltage176_BMS18 65535 "SNA" ;
VAL_ 2001 brickVoltage177_BMS18 65535 "SNA" ;
VAL_ 2001 brickVoltage178_BMS18 65535 "SNA" ;
VAL_ 2001 brickVoltage179_BMS18 65535 "SNA" ;
VAL_ 2001 brickVoltage180_BMS18 65535 "SNA" ;
VAL_ 2001 brickVoltage181_BMS18 65535 "SNA" ;
VAL_ 2001 brickVoltage182_BMS18 65535 "SNA" ;
VAL_ 2001 brickVoltage183_BMS18 65535 "SNA" ;
VAL_ 2001 brickVoltage184_BMS18 65535 "SNA" ;
VAL_ 2001 brickVoltage185_BMS18 65535 "SNA" ;
VAL_ 2001 brickVoltage186_BMS18 65535 "SNA" ;
VAL_ 2001 brickVoltage187_BMS18 65535 "SNA" ;
VAL_ 2001 brickVoltage188_BMS18 65535 "SNA" ;
VAL_ 2001 brickVoltage189_BMS18 65535 "SNA" ;
VAL_ 2001 brickVoltage190_BMS18 65535 "SNA" ;
VAL_ 2001 brickVoltage191_BMS18 65535 "SNA" ;
VAL_ 2001 brickVoltage192_BMS18 65535 "SNA" ;
VAL_ 2001 brickVoltage193_BMS18 65535 "SNA" ;
VAL_ 2001 brickVoltage194_BMS18 65535 "SNA" ;
VAL_ 2001 brickVoltage195_BMS18 65535 "SNA" ;
VAL_ 2001 brickVoltage196_BMS18 65535 "SNA" ;
VAL_ 2001 brickVoltage197_BMS18 65535 "SNA" ;
VAL_ 2001 brickVoltage198_BMS18 65535 "SNA" ;
VAL_ 2001 brickVoltage199_BMS18 65535 "SNA" ;
VAL_ 2001 brickVoltage200_BMS18 65535 "SNA" ;
VAL_ 2001 brickVoltage201_BMS18 65535 "SNA" ;
VAL_ 2001 brickVoltage202_BMS18 65535 "SNA" ;
VAL_ 2001 brickVoltage203_BMS18 65535 "SNA" ;
VAL_ 2001 brickVoltage204_BMS18 65535 "SNA" ;
VAL_ 2001 brickVoltage205_BMS18 65535 "SNA" ;
VAL_ 2001 brickVoltage206_BMS18 65535 "SNA" ;
VAL_ 2001 brickVoltage207_BMS18 65535 "SNA" ;
VAL_ 2001 brickVoltage208_BMS18 65535 "SNA" ;
VAL_ 2001 brickVoltage209_BMS18 65535 "SNA" ;
VAL_ 2001 brickVoltage210_BMS18 65535 "SNA" ;
VAL_ 2001 brickVoltage211_BMS18 65535 "SNA" ;
VAL_ 2001 brickVoltage212_BMS18 65535 "SNA" ;
VAL_ 2001 brickVoltage213_BMS18 65535 "SNA" ;
VAL_ 2001 brickVoltage214_BMS18 65535 "SNA" ;
VAL_ 2001 brickVoltage215_BMS18 65535 "SNA" ;
VAL_ 2001 brickVoltage216_BMS18 65535 "SNA" ;
VAL_ 2001 brickVoltage217_BMS18 65535 "SNA" ;
VAL_ 2001 brickVoltage218_BMS18 65535 "SNA" ;
VAL_ 2001 brickVoltage219_BMS18 65535 "SNA" ;
VAL_ 2001 brickVoltage220_BMS18 65535 "SNA" ;
VAL_ 2001 brickVoltage221_BMS18 65535 "SNA" ;
VAL_ 2001 brickVoltage222_BMS18 65535 "SNA" ;
VAL_ 2001 brickVoltage223_BMS18 65535 "SNA" ;
VAL_ 2001 brickVoltage224_BMS18 65535 "SNA" ;
VAL_ 2001 brickVoltage225_BMS18 65535 "SNA" ;
VAL_ 2001 brickVoltage226_BMS18 65535 "SNA" ;
VAL_ 2001 brickVoltage227_BMS18 65535 "SNA" ;
VAL_ 2001 brickVoltage228_BMS18 65535 "SNA" ;
VAL_ 2001 brickVoltage229_BMS18 65535 "SNA" ;
VAL_ 2001 brickVoltage230_BMS18 65535 "SNA" ;
VAL_ 2001 brickVoltage231_BMS18 65535 "SNA" ;
VAL_ 2001 brickVoltage232_BMS18 65535 "SNA" ;
VAL_ 2001 brickVoltage233_BMS18 65535 "SNA" ;
VAL_ 2001 brickVoltage234_BMS18 65535 "SNA" ;
VAL_ 2001 brickVoltage235_BMS18 65535 "SNA" ;
VAL_ 2001 brickVoltage236_BMS18 65535 "SNA" ;
VAL_ 2001 brickVoltage237_BMS18 65535 "SNA" ;
VAL_ 2001 brickVoltage238_BMS18 65535 "SNA" ;
VAL_ 2001 brickVoltage239_BMS18 65535 "SNA" ;
VAL_ 2001 brickVoltage240_BMS18 65535 "SNA" ;
VAL_ 2001 brickVoltage241_BMS18 65535 "SNA" ;
VAL_ 2001 brickVoltage242_BMS18 65535 "SNA" ;
VAL_ 2001 brickVoltage243_BMS18 65535 "SNA" ;
VAL_ 2001 brickVoltage244_BMS18 65535 "SNA" ;
VAL_ 2001 brickVoltage245_BMS18 65535 "SNA" ;
VAL_ 2001 brickVoltage246_BMS18 65535 "SNA" ;
VAL_ 2001 brickVoltage247_BMS18 65535 "SNA" ;
VAL_ 2001 brickVoltage248_BMS18 65535 "SNA" ;
VAL_ 2001 brickVoltage249_BMS18 65535 "SNA" ;
VAL_ 2001 brickVoltage250_BMS18 65535 "SNA" ;
VAL_ 2001 brickVoltage251_BMS18 65535 "SNA" ;
VAL_ 2001 brickVoltage252_BMS18 65535 "SNA" ;
VAL_ 2001 brickVoltage253_BMS18 65535 "SNA" ;
VAL_ 2001 brickVoltage254_BMS18 65535 "SNA" ;
VAL_ 2001 brickVoltage255_BMS18 65535 "SNA" ;
VAL_ 2001 brickVoltage256_BMS18 65535 "SNA" ;
VAL_ 2001 brickVoltage257_BMS18 65535 "SNA" ;
VAL_ 2001 brickVoltage258_BMS18 65535 "SNA" ;
VAL_ 2001 brickVoltage259_BMS18 65535 "SNA" ;
VAL_ 2001 brickVoltage260_BMS18 65535 "SNA" ;
VAL_ 2001 brickVoltage261_BMS18 65535 "SNA" ;
VAL_ 2001 brickVoltage262_BMS18 65535 "SNA" ;
VAL_ 2001 brickVoltage263_BMS18 65535 "SNA" ;
VAL_ 2001 brickVoltage264_BMS18 65535 "SNA" ;
VAL_ 2001 brickVoltage265_BMS18 65535 "SNA" ;
VAL_ 2001 brickVoltage266_BMS18 65535 "SNA" ;
VAL_ 2001 brickVoltage267_BMS18 65535 "SNA" ;
VAL_ 2001 brickVoltage268_BMS18 65535 "SNA" ;
VAL_ 2001 brickVoltage269_BMS18 65535 "SNA" ;
VAL_ 2001 brickVoltage270_BMS18 65535 "SNA" ;
VAL_ 2001 brickVoltage271_BMS18 65535 "SNA" ;
VAL_ 2001 brickVoltage272_BMS18 65535 "SNA" ;
VAL_ 2001 brickVoltage273_BMS18 65535 "SNA" ;
VAL_ 2001 brickVoltage274_BMS18 65535 "SNA" ;
VAL_ 2001 brickVoltage275_BMS18 65535 "SNA" ;
VAL_ 2001 brickVoltage276_BMS18 65535 "SNA" ;
VAL_ 2001 brickVoltage277_BMS18 65535 "SNA" ;
VAL_ 2001 brickVoltage278_BMS18 65535 "SNA" ;
VAL_ 2001 brickVoltage279_BMS18 65535 "SNA" ;
VAL_ 2001 brickVoltage280_BMS18 65535 "SNA" ;
VAL_ 2001 brickVoltage281_BMS18 65535 "SNA" ;
VAL_ 2001 brickVoltage282_BMS18 65535 "SNA" ;
VAL_ 2001 brickVoltage283_BMS18 65535 "SNA" ;
VAL_ 2001 brickVoltage284_BMS18 65535 "SNA" ;
VAL_ 2001 brickVoltage285_BMS18 65535 "SNA" ;
VAL_ 2001 brickVoltage286_BMS18 65535 "SNA" ;
VAL_ 2001 brickVoltage287_BMS18 65535 "SNA" ;
VAL_ 2001 brickVoltage288_BMS18 65535 "SNA" ;
VAL_ 2001 brickVoltage289_BMS18 65535 "SNA" ;
VAL_ 2001 brickVoltage290_BMS18 65535 "SNA" ;
VAL_ 2001 brickVoltage291_BMS18 65535 "SNA" ;
VAL_ 2001 brickVoltage292_BMS18 65535 "SNA" ;
VAL_ 2001 brickVoltage293_BMS18 65535 "SNA" ;
VAL_ 2001 brickVoltage294_BMS18 65535 "SNA" ;
VAL_ 2001 brickVoltage295_BMS18 65535 "SNA" ;
VAL_ 2001 brickVoltage296_BMS18 65535 "SNA" ;
VAL_ 2001 brickVoltage297_BMS18 65535 "SNA" ;
VAL_ 2001 brickVoltage298_BMS18 65535 "SNA" ;
VAL_ 2001 brickVoltage299_BMS18 65535 "SNA" ;
VAL_ 2001 brickVoltage300_BMS18 65535 "SNA" ;
VAL_ 2001 moduleTemperature33_BMS18 255 "SNA" ;
VAL_ 2001 moduleTemperature34_BMS18 255 "SNA" ;
VAL_ 2001 moduleTemperature35_BMS18 255 "SNA" ;
VAL_ 2001 moduleTemperature36_BMS18 255 "SNA" ;
VAL_ 2001 moduleTemperature37_BMS18 255 "SNA" ;
VAL_ 2001 moduleTemperature38_BMS18 255 "SNA" ;
VAL_ 2001 moduleTemperature39_BMS18 255 "SNA" ;
VAL_ 2001 moduleTemperature40_BMS18 255 "SNA" ;
VAL_ 2001 moduleTemperature41_BMS18 255 "SNA" ;
VAL_ 2001 moduleTemperature42_BMS18 255 "SNA" ;
VAL_ 2001 moduleTemperature43_BMS18 255 "SNA" ;
VAL_ 2001 moduleTemperature44_BMS18 255 "SNA" ;
VAL_ 2001 moduleTemperature45_BMS18 255 "SNA" ;
VAL_ 2001 moduleTemperature46_BMS18 255 "SNA" ;
VAL_ 2001 moduleTemperature47_BMS18 255 "SNA" ;
VAL_ 2001 moduleTemperature48_BMS18 255 "SNA" ;
VAL_ 2001 moduleTemperature49_BMS18 255 "SNA" ;
VAL_ 2001 moduleTemperature50_BMS18 255 "SNA" ;
VAL_ 2001 moduleTemperature51_BMS18 255 "SNA" ;
VAL_ 2001 moduleTemperature52_BMS18 255 "SNA" ;
VAL_ 2001 moduleTemperature53_BMS18 255 "SNA" ;
VAL_ 2001 moduleTemperature54_BMS18 255 "SNA" ;
VAL_ 2001 moduleTemperature55_BMS18 255 "SNA" ;
VAL_ 2001 moduleTemperature56_BMS18 255 "SNA" ;
VAL_ 2001 moduleTemperature57_BMS18 255 "SNA" ;
VAL_ 2001 moduleTemperature58_BMS18 255 "SNA" ;
VAL_ 2001 moduleTemperature59_BMS18 255 "SNA" ;
VAL_ 2001 moduleTemperature60_BMS18 255 "SNA" ;
VAL_ 2001 moduleTemperature61_BMS18 255 "SNA" ;
VAL_ 2001 moduleTemperature62_BMS18 255 "SNA" ;
VAL_ 2001 moduleTemperature63_BMS18 255 "SNA" ;
VAL_ 2001 moduleTemperature64_BMS18 255 "SNA" ;
VAL_ 2001 moduleTemperature65_BMS18 255 "SNA" ;
VAL_ 2001 moduleTemperature66_BMS18 255 "SNA" ;
VAL_ 2001 moduleTemperature67_BMS18 255 "SNA" ;
VAL_ 2001 moduleTemperature68_BMS18 255 "SNA" ;
VAL_ 2001 moduleTemperature69_BMS18 255 "SNA" ;
VAL_ 2001 moduleTemperature70_BMS18 255 "SNA" ;
VAL_ 2001 moduleTemperature71_BMS18 255 "SNA" ;
VAL_ 2001 moduleTemperature72_BMS18 255 "SNA" ;
VAL_ 2001 moduleTemperature73_BMS18 255 "SNA" ;
VAL_ 2001 moduleTemperature74_BMS18 255 "SNA" ;
VAL_ 2001 moduleTemperature75_BMS18 255 "SNA" ;
VAL_ 2001 moduleTemperature76_BMS18 255 "SNA" ;
VAL_ 2001 moduleTemperature77_BMS18 255 "SNA" ;
VAL_ 2001 moduleTemperature78_BMS18 255 "SNA" ;
VAL_ 2001 moduleTemperature79_BMS18 255 "SNA" ;
VAL_ 2001 moduleTemperature80_BMS18 255 "SNA" ;
VAL_ 2001 moduleTemperature81_BMS18 255 "SNA" ;
VAL_ 2001 moduleTemperature82_BMS18 255 "SNA" ;
VAL_ 2001 moduleTemperature83_BMS18 255 "SNA" ;
VAL_ 2001 moduleTemperature84_BMS18 255 "SNA" ;
VAL_ 2001 moduleTemperature85_BMS18 255 "SNA" ;
VAL_ 2001 moduleTemperature86_BMS18 255 "SNA" ;
VAL_ 2001 moduleTemperature87_BMS18 255 "SNA" ;
VAL_ 2001 moduleTemperature88_BMS18 255 "SNA" ;
VAL_ 2001 moduleTemperature89_BMS18 255 "SNA" ;
VAL_ 2001 moduleTemperature90_BMS18 255 "SNA" ;
VAL_ 2001 moduleTemperature91_BMS18 255 "SNA" ;
VAL_ 2001 moduleTemperature92_BMS18 255 "SNA" ;
VAL_ 2001 moduleTemperature93_BMS18 255 "SNA" ;
VAL_ 2001 moduleTemperature94_BMS18 255 "SNA" ;
VAL_ 2001 moduleTemperature95_BMS18 255 "SNA" ;
VAL_ 2001 moduleTemperature96_BMS18 255 "SNA" ;
VAL_ 2001 moduleTemperature97_BMS18 255 "SNA" ;
VAL_ 2001 moduleTemperature98_BMS18 255 "SNA" ;
VAL_ 2001 moduleTemperature99_BMS18 255 "SNA" ;
VAL_ 2001 moduleTemperature100_BMS18 255 "SNA" ;
VAL_ 916 DEM319_HV_DISABLE_DURING_S_BMS21 3 "DEM_INVALID" 2 "DEM_FAILED" 1 "DEM_PASSED" 0 "DEM_NOTTESTED" ;
VAL_ 916 DEM318_HV_ENABLE_IMPLAUSIB_BMS21 3 "DEM_INVALID" 2 "DEM_FAILED" 1 "DEM_PASSED" 0 "DEM_NOTTESTED" ;
VAL_ 916 DEM317_STRING_SUSPECT_OPEN_BMS21 3 "DEM_INVALID" 2 "DEM_FAILED" 1 "DEM_PASSED" 0 "DEM_NOTTESTED" ;
VAL_ 916 DEM316_UNEXPCTD_BMS_ON_CAN_BMS21 3 "DEM_INVALID" 2 "DEM_FAILED" 1 "DEM_PASSED" 0 "DEM_NOTTESTED" ;
VAL_ 916 DEM315_HV_WITHSTAND_TESTS__BMS21 3 "DEM_INVALID" 2 "DEM_FAILED" 1 "DEM_PASSED" 0 "DEM_NOTTESTED" ;
VAL_ 916 DEM314_OBC_PILOT_ERROR_BMS21 3 "DEM_INVALID" 2 "DEM_FAILED" 1 "DEM_PASSED" 0 "DEM_NOTTESTED" ;
VAL_ 916 DEM313_OBC_PILOT_HIGH_BMS21 3 "DEM_INVALID" 2 "DEM_FAILED" 1 "DEM_PASSED" 0 "DEM_NOTTESTED" ;
VAL_ 916 DEM312_OBC_PROXIMITY_ERROR_BMS21 3 "DEM_INVALID" 2 "DEM_FAILED" 1 "DEM_PASSED" 0 "DEM_NOTTESTED" ;
VAL_ 916 DEM311_CTRS_END_OF_LIFE_WA_BMS21 3 "DEM_INVALID" 2 "DEM_FAILED" 1 "DEM_PASSED" 0 "DEM_NOTTESTED" ;
VAL_ 916 DEM310_BMSMIA_STRNGMSTR_AL_BMS21 3 "DEM_INVALID" 2 "DEM_FAILED" 1 "DEM_PASSED" 0 "DEM_NOTTESTED" ;
VAL_ 916 DEM309_VOLTAGE_BRICKOV_WAR_BMS21 3 "DEM_INVALID" 2 "DEM_FAILED" 1 "DEM_PASSED" 0 "DEM_NOTTESTED" ;
VAL_ 916 DEM308_PRESSURE_FLT_BMS21 3 "DEM_INVALID" 2 "DEM_FAILED" 1 "DEM_PASSED" 0 "DEM_NOTTESTED" ;
VAL_ 916 DEM307_PRESSURE_MIA_BMS21 3 "DEM_INVALID" 2 "DEM_FAILED" 1 "DEM_PASSED" 0 "DEM_NOTTESTED" ;
VAL_ 916 DEM306_SW_VERSION_MISMATCH_BMS21 3 "DEM_INVALID" 2 "DEM_FAILED" 1 "DEM_PASSED" 0 "DEM_NOTTESTED" ;
VAL_ 916 DEM305_MODULET_OVERTEMP_WA_BMS21 3 "DEM_INVALID" 2 "DEM_FAILED" 1 "DEM_PASSED" 0 "DEM_NOTTESTED" ;
VAL_ 916 DEM304_PCHG_OPENCIRCUIT_IN_BMS21 3 "DEM_INVALID" 2 "DEM_FAILED" 1 "DEM_PASSED" 0 "DEM_NOTTESTED" ;
VAL_ 916 DEM303_MODULET_UNDERTEMP_W_BMS21 3 "DEM_INVALID" 2 "DEM_FAILED" 1 "DEM_PASSED" 0 "DEM_NOTTESTED" ;
VAL_ 916 DEM302_MODULET_UT_BMS21 3 "DEM_INVALID" 2 "DEM_FAILED" 1 "DEM_PASSED" 0 "DEM_NOTTESTED" ;
VAL_ 916 DEM301_FUSI_LOCK_BMS21 3 "DEM_INVALID" 2 "DEM_FAILED" 1 "DEM_PASSED" 0 "DEM_NOTTESTED" ;
VAL_ 916 DEM300_DEBUG_SM_DISABLED_BMS21 3 "DEM_INVALID" 2 "DEM_FAILED" 1 "DEM_PASSED" 0 "DEM_NOTTESTED" ;
VAL_ 916 DEM299_5V_SENSOR_SUPPLY_OU_BMS21 3 "DEM_INVALID" 2 "DEM_FAILED" 1 "DEM_PASSED" 0 "DEM_NOTTESTED" ;
VAL_ 916 DEM298_IMPL_DRIVE_REQUEST_BMS21 3 "DEM_INVALID" 2 "DEM_FAILED" 1 "DEM_PASSED" 0 "DEM_NOTTESTED" ;
VAL_ 916 DEM297_PCHG2_OPENCIRCUIT_BMS21 3 "DEM_INVALID" 2 "DEM_FAILED" 1 "DEM_PASSED" 0 "DEM_NOTTESTED" ;
VAL_ 916 DEM296_CTRSAUX_IMPLAUSIBLE_BMS21 3 "DEM_INVALID" 2 "DEM_FAILED" 1 "DEM_PASSED" 0 "DEM_NOTTESTED" ;
VAL_ 916 DEM295_CTRSAUX_LINKV_UNSAF_BMS21 3 "DEM_INVALID" 2 "DEM_FAILED" 1 "DEM_PASSED" 0 "DEM_NOTTESTED" ;
VAL_ 916 DEM294_CANRX_PT_EMERGENCY_BMS21 3 "DEM_INVALID" 2 "DEM_FAILED" 1 "DEM_PASSED" 0 "DEM_NOTTESTED" ;
VAL_ 916 DEM293_SBC_LDT_IMPLAUSIBLE_BMS21 3 "DEM_INVALID" 2 "DEM_FAILED" 1 "DEM_PASSED" 0 "DEM_NOTTESTED" ;
VAL_ 916 DEM292_NUM_EXPECTED_STRING_BMS21 3 "DEM_INVALID" 2 "DEM_FAILED" 1 "DEM_PASSED" 0 "DEM_NOTTESTED" ;
VAL_ 916 DEM291_NUM_EXPECTED_STRING_BMS21 3 "DEM_INVALID" 2 "DEM_FAILED" 1 "DEM_PASSED" 0 "DEM_NOTTESTED" ;
VAL_ 916 DEM290_CMB_ONBOARD_DEFECT_BMS21 3 "DEM_INVALID" 2 "DEM_FAILED" 1 "DEM_PASSED" 0 "DEM_NOTTESTED" ;
VAL_ 916 DEM289_TEMP_STATE_LATCHED_BMS21 3 "DEM_INVALID" 2 "DEM_FAILED" 1 "DEM_PASSED" 0 "DEM_NOTTESTED" ;
VAL_ 916 DEM288_CURR_STATE_LATCHED_BMS21 3 "DEM_INVALID" 2 "DEM_FAILED" 1 "DEM_PASSED" 0 "DEM_NOTTESTED" ;
VAL_ 980 balancingInDriveTimer_BMS21 65535 "SNA" ;
VAL_ 980 SOCRestPolarization_BMS21 255 "SNA" ;
VAL_ 980 CoolantSensorState_BMS21 3 "OIL_OK" 2 "SENSOR_FAILURE" 1 "WATER_DETECTED" 0 "SENSOR_CAN_MIA" ;
VAL_ 980 temperatureModelOffset_BMS21 255 "SNA" ;
VAL_ 980 SOHCMinBrickHighEst_BMS21 255 "SNA" ;
VAL_ 980 SOHCMaxBrickHighEst_BMS21 255 "SNA" ;
VAL_ 980 regenCurrOpLkyBktThrs1_BMS21 255 "SNA" ;
VAL_ 980 dischargeCurrOpLkyBktThrs1_BMS21 255 "SNA" ;
VAL_ 980 regenCurrentOpLoadValue_BMS21 255 "SNA" ;
VAL_ 980 dischargeCurrOpLoadValue_BMS21 255 "SNA" ;
VAL_ 980 minBrickVoltageLimit_BMS21 65535 "SNA" ;
VAL_ 980 currentModule3Integral_BMS21 65535 "SNA" ;
VAL_ 980 currentModule2Integral_BMS21 65535 "SNA" ;
VAL_ 980 currentModule1Integral_BMS21 65535 "SNA" ;
VAL_ 980 currentModuleMin_BMS21 65535 "SNA" ;
VAL_ 980 currentModuleMax_BMS21 65535 "SNA" ;
VAL_ 980 maxBrickVoltageSync_BMS21 65535 "SNA" ;
VAL_ 980 minBrickVoltageSync_BMS21 65535 "SNA" ;
VAL_ 980 SOHCMinBrickLowEst_BMS21 255 "SNA" ;
VAL_ 980 SOHCMaxBrickLowEst_BMS21 255 "SNA" ;
VAL_ 980 gradLimSOC_BMS21 65535 "SNA" ;
VAL_ 980 SOCRecalSlowOp_BMS21 255 "SNA" ;
VAL_ 980 SOHCMinIndex_BMS21 65535 "SNA" ;
VAL_ 980 SOHCMaxIndex_BMS21 65535 "SNA" ;
VAL_ 980 SOHRMinRegen_BMS21 255 "SNA" ;
VAL_ 980 SOHRMinDchg_BMS21 255 "SNA" ;
VAL_ 980 SOHRMeanRegen_BMS21 255 "SNA" ;
VAL_ 980 SOHRMeanDchg_BMS21 255 "SNA" ;
VAL_ 980 SOHRMaxRegen_BMS21 255 "SNA" ;
VAL_ 980 SOHRMaxDchg_BMS21 255 "SNA" ;
VAL_ 980 SOHCMin_BMS21 255 "SNA" ;
VAL_ 980 SOHCMean_BMS21 255 "SNA" ;
VAL_ 980 SOHCMax_BMS21 255 "SNA" ;
VAL_ 980 ppRegenCurrLimitPredShort_BMS21 255 "SNA" ;
VAL_ 980 ppRegenCurrLimitPredLong_BMS21 255 "SNA" ;
VAL_ 980 ppDchgCurrLimitPredShort_BMS21 255 "SNA" ;
VAL_ 980 ppDchgCurrLimitPredLong_BMS21 255 "SNA" ;
VAL_ 980 ppPolarizationV_BMS21 65535 "SNA" ;
VAL_ 980 SOCRecalMinOCVEst_BMS21 65535 "SNA" ;
VAL_ 980 SOCRecalMaxOCVEst_BMS21 65535 "SNA" ;
VAL_ 980 SOCRecalMinSOCUpp_BMS21 255 "SNA" ;
VAL_ 980 SOCRecalMinSOCLow_BMS21 255 "SNA" ;
VAL_ 980 SOCRecalMinSOC_BMS21 255 "SNA" ;
VAL_ 980 SOCRecalMaxSOCUpp_BMS21 255 "SNA" ;
VAL_ 980 SOCRecalMaxSOCLow_BMS21 255 "SNA" ;
VAL_ 980 SOCRecalMaxSOC_BMS21 255 "SNA" ;
VAL_ 980 ppNewtonStepsRegen_BMS21 7 "SNA" ;
VAL_ 980 ppNewtonStepsDchg_BMS21 7 "SNA" ;
VAL_ 980 ppNewtonRegenVRes_BMS21 255 "SNA" ;
VAL_ 980 ppNewtonDchgVRes_BMS21 255 "SNA" ;
VAL_ 980 ppMinModelAlphaTarget_BMS21 255 "SNA" ;
VAL_ 980 ppMaxModelAlphaTarget_BMS21 255 "SNA" ;
VAL_ 980 ppLearningTauRegen_BMS21 65535 "SNA" ;
VAL_ 980 ppLearningCriterionDyn_BMS21 255 "SNA" ;
VAL_ 980 ppLearningCriterionAbs_BMS21 255 "SNA" ;
VAL_ 980 ppLearningCriterionJoin_BMS21 255 "SNA" ;
VAL_ 980 currentRedundant_BMS21 65535 "SNA" ;
VAL_ 980 currentModule3_BMS21 65535 "SNA" ;
VAL_ 980 currentModule2_BMS21 65535 "SNA" ;
VAL_ 980 currentModule1_BMS21 65535 "SNA" ;
VAL_ 980 ppMeanDchgIntRes_BMS21 65535 "SNA" ;
VAL_ 980 ppMinModelLowpassV_BMS21 65535 "SNA" ;
VAL_ 980 ppMaxModelVoltageIndex_BMS21 65535 "SNA" ;
VAL_ 980 ppMaxModelLowpassV_BMS21 65535 "SNA" ;
VAL_ 980 ppLearningTauDischarge_BMS21 65535 "SNA" ;
VAL_ 980 ppMaxRegenAlpha_BMS21 255 "SNA" ;
VAL_ 980 ppMaxModelledV_BMS21 65535 "SNA" ;
VAL_ 980 ppMinDchgAlpha_BMS21 255 "SNA" ;
VAL_ 980 ppMinModelledV_BMS21 65535 "SNA" ;
VAL_ 980 debugSlowMpex2_BMS21 0 "S00" 1 "S01" 2 "S02" 3 "S03" 4 "S04" 5 "S05" 6 "S06" 7 "S07" 8 "S08" 9 "S09" 10 "S10" 11 "S11" 12 "S12" 13 "S13" 14 "S14" 15 "S15" 16 "S16" 17 "S17" 18 "S18" 19 "S19" 20 "S20" 21 "S21" 22 "S22" 23 "S23" 24 "S24" 25 "S25" ;
VAL_ 980 ppRegenCurrPredShort_BMS21 65535 "SNA" ;
VAL_ 980 ppDischgCurrPredLong_BMS21 65535 "SNA" ;
VAL_ 980 ppDischgCurrPredShort_BMS21 65535 "SNA" ;
VAL_ 980 ppRegenCurrPredLong_BMS21 65535 "SNA" ;
VAL_ 980 ppRegenVPredShort_BMS21 65535 "SNA" ;
VAL_ 980 ppDischgVPredShort_BMS21 65535 "SNA" ;
VAL_ 980 ppRegenVPredLong_BMS21 65535 "SNA" ;
VAL_ 980 ppDischgVPredLong_BMS21 65535 "SNA" ;
VAL_ 980 SOHDeltaSOCCoulomb_BMS21 65535 "SNA" ;
VAL_ 980 SOHAbsDeltaSOCCoulomb_BMS21 65535 "SNA" ;
VAL_ 980 SOHLastOCVRecalMinSOC_BMS21 255 "SNA" ;
VAL_ 980 SOHbalancingTimeMinSOH_BMS21 255 "SNA" ;
VAL_ 1812 chargerDCOutV_BMS21 65535 "SNA" ;
VAL_ 1812 chargerProximity_BMS21 255 "SNA" ;
VAL_ 1812 chargerPilot_BMS21 255 "SNA" ;
VAL_ 1812 chargerCurrAvail_BMS21 255 "SNA" ;
VAL_ 1812 chargerCtrOn_BMS21 1 "TRUE" 0 "FALSE" ;
VAL_ 1812 chargerOn_BMS21 1 "TRUE" 0 "FALSE" ;
VAL_ 1812 debugFastMpex2_BMS21 0 "F00" 1 "F01" 2 "F02" 3 "F03" 4 "F04" 5 "F05" 6 "F06" 7 "F07" 8 "F08" 9 "F09" 10 "F10" 11 "F11" 12 "F12" 13 "F13" 14 "F14" 15 "F15" ;
VAL_ 1812 posPackDbg_BMS21 65535 "SNA" ;
VAL_ 1812 negPackDbg_BMS21 65535 "SNA" ;
VAL_ 1812 packVoltageHVMeas_BMS21 65535 "SNA" ;
VAL_ 1876 SOHRecentChange_BMS21 255 "SNA" ;
VAL_ 1876 SOHConvergenceIndicator_BMS21 255 "SNA" ;
VAL_ 1876 SOHConvergenceCounter_BMS21 255 "SNA" ;
VAL_ 1876 SOHMinFiltered_BMS21 255 "SNA" ;
VAL_ 1876 medianModuleTempGrp2_BMS21 255 "SNA" ;
VAL_ 1876 medianModuleTempGrp1_BMS21 255 "SNA" ;
VAL_ 1876 coolantWarningtAlert_BMS21 3 "SNA" 2 "COOLANT_FLOOD_WARNING" 0 "COOLANT_NOWARNING" 1 "COOLANT_MOISTURE_WARNING" ;
VAL_ 1876 coolantFaultAlert_BMS21 3 "SNA" 2 "COOLANT_FLOOD_FAULT" 0 "COOLANT_NOFAULT" 1 "COOLANT_MOISTURE_FAULT" ;
VAL_ 1876 hvilShutdownStrategy_BMS21 4 "Strategy_4" 3 "Strategy_3" 2 "Strategy_2" 1 "Strategy_1" 0 "Strategy_0" ;
VAL_ 1876 J1939_nmState 3 "J1939_NM_INACTIVE" 2 "J1939_NM_ACTIVE" 1 "J1939_NM_STARTUP" 0 "J1939_NM_INIT" ;
VAL_ 1876 PrechargeXCapMin_BMS21 65535 "SNA" ;
VAL_ 1876 LimpHomeTimeOut_BMS21 65535 "SNA" ;
VAL_ 1876 hvWithstandTests_BMS21 255 "SNA" ;
VAL_ 1876 aux3prechargeState_BMS21 15 "CTR_PRCHG_NEG_OPEN" 13 "CTR_PRCHG_POS_WELD_CHECK" 12 "CTR_PRCHG_PRE_COND_CHECK" 11 "CTR_PRCHG_NEG2_WELD_CHECK" 10 "CTR_PRCHG_CLOSEMID" 9 "CTR_PRCHG_CLOSEAUX" 8 "CTR_PRCHG_FAILED" 7 "CTR_PRCHG_COMPLETE" 6 "CTR_PRCHG_CLOSE_POS" 5 "CTR_PRCHG_MONITOR_VOLTAGE" 4 "CTR_PRCHG_CLOSE_NEG" 3 "CTR_PRCHG_NEG_WELD_CHECK" 2 "CTR_PRCHG_CLOSE_RELAY" 1 "CTR_PRCHG_WELD_CHECK" 0 "CTR_PRCHG_OFF" ;
VAL_ 1876 aux2prechargeState_BMS21 15 "CTR_PRCHG_NEG_OPEN" 13 "CTR_PRCHG_POS_WELD_CHECK" 12 "CTR_PRCHG_PRE_COND_CHECK" 11 "CTR_PRCHG_NEG2_WELD_CHECK" 10 "CTR_PRCHG_CLOSEMID" 9 "CTR_PRCHG_CLOSEAUX" 8 "CTR_PRCHG_FAILED" 7 "CTR_PRCHG_COMPLETE" 6 "CTR_PRCHG_CLOSE_POS" 5 "CTR_PRCHG_MONITOR_VOLTAGE" 4 "CTR_PRCHG_CLOSE_NEG" 3 "CTR_PRCHG_NEG_WELD_CHECK" 2 "CTR_PRCHG_CLOSE_RELAY" 1 "CTR_PRCHG_WELD_CHECK" 0 "CTR_PRCHG_OFF" ;
VAL_ 1876 aux1prechargeState_BMS21 15 "CTR_PRCHG_NEG_OPEN" 13 "CTR_PRCHG_POS_WELD_CHECK" 12 "CTR_PRCHG_PRE_COND_CHECK" 11 "CTR_PRCHG_NEG2_WELD_CHECK" 10 "CTR_PRCHG_CLOSEMID" 9 "CTR_PRCHG_CLOSEAUX" 8 "CTR_PRCHG_FAILED" 7 "CTR_PRCHG_COMPLETE" 6 "CTR_PRCHG_CLOSE_POS" 5 "CTR_PRCHG_MONITOR_VOLTAGE" 4 "CTR_PRCHG_CLOSE_NEG" 3 "CTR_PRCHG_NEG_WELD_CHECK" 2 "CTR_PRCHG_CLOSE_RELAY" 1 "CTR_PRCHG_WELD_CHECK" 0 "CTR_PRCHG_OFF" ;
VAL_ 1876 auxLinkVoltage_BMS21 65535 "SNA" ;
VAL_ 1876 rangeRequestIgnoreVehicle 255 "NO_COMMAND" 1 "IGNORE" 0 "DO_NOT_IGNORE" ;
VAL_ 1876 rangeRequestEepromValue 255 "NO_COMMAND" 15 "RANGE_INVALID" 14 "RANGE_MAXIMUM" 13 "RANGE_MODESOH8" 12 "RANGE_MODESOH7" 11 "RANGE_MODESOH6" 10 "RANGE_MODESOH5" 9 "RANGE_MODESOH4" 8 "RANGE_MODESOH3" 7 "RANGE_MODESOH2" 6 "RANGE_MODESOH1" 5 "RANGE_MODE407" 4 "RANGE_MODE405" 3 "RANGE_MODE4175" 2 "RANGE_MODE415" 1 "RANGE_LIMITED" 0 "RANGE_SHIPPING" ;
VAL_ 1876 pressure2_BMS21 255 "SNA" ;
VAL_ 1876 calibration_version_BMS21 255 "SNA" ;
VAL_ 1876 currentLowTimer_BMS21 65535 "SNA" ;
VAL_ 1876 auxCntrrOpenUnderLoadCntr_BMS21 65535 "SNA" ;
VAL_ 1876 rabbitContactorState_BMS21 5 "FAILURE" 4 "CLOSE" 3 "EXT_ISO_TEST" 2 "AUX_CLOSE" 1 "INT_ISO_TEST" 0 "OPEN" ;
VAL_ 1876 analogIsenseSupplyCurr_BMS21 255 "SNA" ;
VAL_ 1876 pumpSpeedReqCoolPrfmc_BMS21 255 "SNA" ;
VAL_ 1876 microsarOs_IdleTask_OsCr0_BMS21 255 "SNA" ;
VAL_ 1876 microsarOs_BswTask_BMS21 255 "SNA" ;
VAL_ 1876 microsarOs_InitTask_BMS21 255 "SNA" ;
VAL_ 1876 microsarOs_ApplTask_1Hz_BMS21 255 "SNA" ;
VAL_ 1876 microsarOs_ApplTask_10Hz_BMS21 255 "SNA" ;
VAL_ 1876 microsarOs_ApplTask_100Hz_BMS21 255 "SNA" ;
VAL_ 1876 microsarOs_ApplLowTask_BMS21 255 "SNA" ;
VAL_ 1876 microsarOs_ApplLateInit_BMS21 255 "SNA" ;
VAL_ 1876 microsarOs_ApplHighTask_BMS21 255 "SNA" ;
VAL_ 1876 microsarOs_ApplEarlyInit_BMS21 255 "SNA" ;
VAL_ 1876 appTaskBSWMaxDuration_BMS21 255 "SNA" ;
VAL_ 1876 appTaskApplHighMaxDuration_BMS21 255 "SNA" ;
VAL_ 1876 appTask1HzMaxDuration_BMS21 255 "SNA" ;
VAL_ 1876 appTask100HzMaxDuration_BMS21 255 "SNA" ;
VAL_ 1876 appTask10HzMaxDuration_BMS21 255 "SNA" ;
VAL_ 1876 appTask100HzDuration_BMS21 255 "SNA" ;
VAL_ 1876 appTask10HzDuration_BMS21 255 "SNA" ;
VAL_ 1876 appTask1HzDuration_BMS21 255 "SNA" ;
VAL_ 1876 appTaskBSWDuration_BMS21 255 "SNA" ;
VAL_ 1876 appTaskApplHighDuration_BMS21 255 "SNA" ;
VAL_ 1876 iumprMaxRatioDTCId_BMS21 0 "SNA" ;
VAL_ 1876 iumprMaxRatio_BMS21 0 "SNA" ;
VAL_ 1876 iumprMinRatioDTCId_BMS21 0 "SNA" ;
VAL_ 1876 iumprMinRatio_BMS21 0 "SNA" ;
VAL_ 1876 fluidLvlCount_BMS21 255 "SNA" ;
VAL_ 1876 fluidLvlSensr2_BMS21 3 "FLUIDLEVEL_ERROR" 2 "FLUIDLEVEL_OIL" 1 "FLUIDLEVEL_AIR" 0 "FLUIDLEVEL_SNA" ;
VAL_ 1876 fluidLvlSensr1_BMS21 3 "FLUIDLEVEL_ERROR" 2 "FLUIDLEVEL_OIL" 1 "FLUIDLEVEL_AIR" 0 "FLUIDLEVEL_SNA" ;
VAL_ 1876 pumpSpeedReqVhcleSpeed_BMS21 255 "SNA" ;
VAL_ 1876 appTaskBSWCpuUsage_BMS21 255 "SNA" ;
VAL_ 1876 appTask200HzCpuUsage_BMS21 255 "SNA" ;
VAL_ 1876 pyroState_BMS21 7 "PYRO_FIRE" 6 "PYRO_DIAG_PASS" 5 "PYRO_DIAG_FAIL" 4 "PYRO_DIAG_LS_ON" 3 "PYRO_DIAG_OPEN" 2 "PYRO_DIAG_HS_ON" 1 "PYRO_DIAG_INIT" 0 "PYRO_INACTIVE" ;
VAL_ 1876 ecuSerialNrChar15_BMS21 90 "'Z'" 89 "'Y'" 88 "'X'" 87 "'W'" 86 "'V'" 85 "'U'" 84 "'T'" 83 "'S'" 82 "'R'" 81 "'Q'" 80 "'P'" 79 "'O'" 78 "'N'" 77 "'M'" 76 "'L'" 75 "'K'" 74 "'J'" 73 "'I'" 72 "'H'" 71 "'G'" 70 "'F'" 69 "'E'" 68 "'D'" 67 "'C'" 66 "'B'" 65 "'A'" 57 "'9'" 56 "'8'" 55 "'7'" 54 "'6'" 53 "'5'" 52 "'4'" 51 "'3'" 50 "'2'" 49 "'1'" 48 "'0'" ;
VAL_ 1876 ecuSerialNrChar14_BMS21 90 "'Z'" 89 "'Y'" 88 "'X'" 87 "'W'" 86 "'V'" 85 "'U'" 84 "'T'" 83 "'S'" 82 "'R'" 81 "'Q'" 80 "'P'" 79 "'O'" 78 "'N'" 77 "'M'" 76 "'L'" 75 "'K'" 74 "'J'" 73 "'I'" 72 "'H'" 71 "'G'" 70 "'F'" 69 "'E'" 68 "'D'" 67 "'C'" 66 "'B'" 65 "'A'" 57 "'9'" 56 "'8'" 55 "'7'" 54 "'6'" 53 "'5'" 52 "'4'" 51 "'3'" 50 "'2'" 49 "'1'" 48 "'0'" ;
VAL_ 1876 ecuSerialNrChar13_BMS21 90 "'Z'" 89 "'Y'" 88 "'X'" 87 "'W'" 86 "'V'" 85 "'U'" 84 "'T'" 83 "'S'" 82 "'R'" 81 "'Q'" 80 "'P'" 79 "'O'" 78 "'N'" 77 "'M'" 76 "'L'" 75 "'K'" 74 "'J'" 73 "'I'" 72 "'H'" 71 "'G'" 70 "'F'" 69 "'E'" 68 "'D'" 67 "'C'" 66 "'B'" 65 "'A'" 57 "'9'" 56 "'8'" 55 "'7'" 54 "'6'" 53 "'5'" 52 "'4'" 51 "'3'" 50 "'2'" 49 "'1'" 48 "'0'" ;
VAL_ 1876 ecuSerialNrChar12_BMS21 90 "'Z'" 89 "'Y'" 88 "'X'" 87 "'W'" 86 "'V'" 85 "'U'" 84 "'T'" 83 "'S'" 82 "'R'" 81 "'Q'" 80 "'P'" 79 "'O'" 78 "'N'" 77 "'M'" 76 "'L'" 75 "'K'" 74 "'J'" 73 "'I'" 72 "'H'" 71 "'G'" 70 "'F'" 69 "'E'" 68 "'D'" 67 "'C'" 66 "'B'" 65 "'A'" 57 "'9'" 56 "'8'" 55 "'7'" 54 "'6'" 53 "'5'" 52 "'4'" 51 "'3'" 50 "'2'" 49 "'1'" 48 "'0'" ;
VAL_ 1876 ecuSerialNrChar11_BMS21 90 "'Z'" 89 "'Y'" 88 "'X'" 87 "'W'" 86 "'V'" 85 "'U'" 84 "'T'" 83 "'S'" 82 "'R'" 81 "'Q'" 80 "'P'" 79 "'O'" 78 "'N'" 77 "'M'" 76 "'L'" 75 "'K'" 74 "'J'" 73 "'I'" 72 "'H'" 71 "'G'" 70 "'F'" 69 "'E'" 68 "'D'" 67 "'C'" 66 "'B'" 65 "'A'" 57 "'9'" 56 "'8'" 55 "'7'" 54 "'6'" 53 "'5'" 52 "'4'" 51 "'3'" 50 "'2'" 49 "'1'" 48 "'0'" ;
VAL_ 1876 ecuSerialNrChar10_BMS21 90 "'Z'" 89 "'Y'" 88 "'X'" 87 "'W'" 86 "'V'" 85 "'U'" 84 "'T'" 83 "'S'" 82 "'R'" 81 "'Q'" 80 "'P'" 79 "'O'" 78 "'N'" 77 "'M'" 76 "'L'" 75 "'K'" 74 "'J'" 73 "'I'" 72 "'H'" 71 "'G'" 70 "'F'" 69 "'E'" 68 "'D'" 67 "'C'" 66 "'B'" 65 "'A'" 57 "'9'" 56 "'8'" 55 "'7'" 54 "'6'" 53 "'5'" 52 "'4'" 51 "'3'" 50 "'2'" 49 "'1'" 48 "'0'" ;
VAL_ 1876 ecuSerialNrChar09_BMS21 90 "'Z'" 89 "'Y'" 88 "'X'" 87 "'W'" 86 "'V'" 85 "'U'" 84 "'T'" 83 "'S'" 82 "'R'" 81 "'Q'" 80 "'P'" 79 "'O'" 78 "'N'" 77 "'M'" 76 "'L'" 75 "'K'" 74 "'J'" 73 "'I'" 72 "'H'" 71 "'G'" 70 "'F'" 69 "'E'" 68 "'D'" 67 "'C'" 66 "'B'" 65 "'A'" 57 "'9'" 56 "'8'" 55 "'7'" 54 "'6'" 53 "'5'" 52 "'4'" 51 "'3'" 50 "'2'" 49 "'1'" 48 "'0'" ;
VAL_ 1876 ecuSerialNrChar08_BMS21 90 "'Z'" 89 "'Y'" 88 "'X'" 87 "'W'" 86 "'V'" 85 "'U'" 84 "'T'" 83 "'S'" 82 "'R'" 81 "'Q'" 80 "'P'" 79 "'O'" 78 "'N'" 77 "'M'" 76 "'L'" 75 "'K'" 74 "'J'" 73 "'I'" 72 "'H'" 71 "'G'" 70 "'F'" 69 "'E'" 68 "'D'" 67 "'C'" 66 "'B'" 65 "'A'" 57 "'9'" 56 "'8'" 55 "'7'" 54 "'6'" 53 "'5'" 52 "'4'" 51 "'3'" 50 "'2'" 49 "'1'" 48 "'0'" ;
VAL_ 1876 ecuSerialNrChar07_BMS21 90 "'Z'" 89 "'Y'" 88 "'X'" 87 "'W'" 86 "'V'" 85 "'U'" 84 "'T'" 83 "'S'" 82 "'R'" 81 "'Q'" 80 "'P'" 79 "'O'" 78 "'N'" 77 "'M'" 76 "'L'" 75 "'K'" 74 "'J'" 73 "'I'" 72 "'H'" 71 "'G'" 70 "'F'" 69 "'E'" 68 "'D'" 67 "'C'" 66 "'B'" 65 "'A'" 57 "'9'" 56 "'8'" 55 "'7'" 54 "'6'" 53 "'5'" 52 "'4'" 51 "'3'" 50 "'2'" 49 "'1'" 48 "'0'" ;
VAL_ 1876 ecuSerialNrChar06_BMS21 90 "'Z'" 89 "'Y'" 88 "'X'" 87 "'W'" 86 "'V'" 85 "'U'" 84 "'T'" 83 "'S'" 82 "'R'" 81 "'Q'" 80 "'P'" 79 "'O'" 78 "'N'" 77 "'M'" 76 "'L'" 75 "'K'" 74 "'J'" 73 "'I'" 72 "'H'" 71 "'G'" 70 "'F'" 69 "'E'" 68 "'D'" 67 "'C'" 66 "'B'" 65 "'A'" 57 "'9'" 56 "'8'" 55 "'7'" 54 "'6'" 53 "'5'" 52 "'4'" 51 "'3'" 50 "'2'" 49 "'1'" 48 "'0'" ;
VAL_ 1876 ecuSerialNrChar05_BMS21 90 "'Z'" 89 "'Y'" 88 "'X'" 87 "'W'" 86 "'V'" 85 "'U'" 84 "'T'" 83 "'S'" 82 "'R'" 81 "'Q'" 80 "'P'" 79 "'O'" 78 "'N'" 77 "'M'" 76 "'L'" 75 "'K'" 74 "'J'" 73 "'I'" 72 "'H'" 71 "'G'" 70 "'F'" 69 "'E'" 68 "'D'" 67 "'C'" 66 "'B'" 65 "'A'" 57 "'9'" 56 "'8'" 55 "'7'" 54 "'6'" 53 "'5'" 52 "'4'" 51 "'3'" 50 "'2'" 49 "'1'" 48 "'0'" ;
VAL_ 1876 analogGPIO1Current_BMS21 255 "SNA" ;
VAL_ 1876 analogGPIO1Volt_BMS21 255 "SNA" ;
VAL_ 1876 analogGPIO2Current_BMS21 255 "SNA" ;
VAL_ 1876 analogGPIO2Volt_BMS21 255 "SNA" ;
VAL_ 1876 pumpSpeedReqLoadValue_BMS21 255 "SNA" ;
VAL_ 1876 ssaRTMonth_BMS21 255 "SNA" ;
VAL_ 1876 ssaRTDay_BMS21 255 "SNA" ;
VAL_ 1876 appTask50HzStackUsage_BMS21 255 "SNA" ;
VAL_ 1876 OBDMILRequested_BMS21 3 "MIL_SNA" 1 "MIL_ON" 0 "MIL_OFF" ;
VAL_ 1876 OBDConfirmedDTCsCount_BMS21 255 "SNA" ;
VAL_ 1876 OBDFirstConfirmedDTC_BMS21 255 "SNA" ;
VAL_ 1876 OBDPermanentDTCCount_BMS21 255 "SNA" ;
VAL_ 1876 OBDFirstPermanentDTC_BMS21 255 "SNA" ;
VAL_ 1876 nmStartupReason_BMS21 15 "NM_STARTUP_INVALID" 7 "NM_STARTUP_TESTERPRESENT" 6 "NM_STARTUP_RQ" 5 "NM_STARTUP_CAN" 4 "NM_STARTUP_THERMALEVENT" 3 "NM_STARTUP_AUXCONTACTORS" 2 "NM_STARTUP_CONTACTORS" 1 "NM_STARTUP_KEY" 0 "NM_STARTUP_NOSTARTUP" ;
VAL_ 1876 contactorType_BMS21 15 "SNA" 1 "GV240_12V" 0 "CTR_TYPE_CALIBRATION (GV240_24V)" ;
VAL_ 1876 activeIsoTestDuration_BMS21 255 "SNA" ;
VAL_ 1876 balancingState_BMS21 6 "BALANCING_OFF_TEMP_SHUTDOWN" 5 "BALANCING_OFF_VOLTAGE_SHUTDOWN" 4 "BALANCING_ON_DCM_EEPROM" 3 "BALANCING_ON_DCM_BRICK" 2 "BALANCING_ON_DCM_PATTERN" 1 "BALANCING_ON_ME_APP" 0 "BALANCING_OFF" ;
VAL_ 1876 chronoStackWrCnt_BMS21 -1 "SNA" ;
VAL_ 1876 wakeReason_BMS21 6 "ECU_WAKEREASON_MCUWDG" 14 "ECU_WAKEREASON_INIT" 15 "ECU_WAKEREASON_UNKNOWN" 5 "ECU_WAKEREASON_AUTO" 4 "ECU_WAKEREASON_POR" 3 "ECU_WAKEREASON_CLOCK" 2 "ECU_WAKEREASON_PRESSURE" 1 "ECU_WAKEREASON_CAN" 0 "ECU_WAKEREASON_KEY" ;
VAL_ 1876 coolantOutletTemperature_BMS21 255 "SNA" ;
VAL_ 1876 coolantInletTemperature_BMS21 255 "SNA" ;
VAL_ 1876 variantCodingCount_BMS21 65535 "SNA" ;
VAL_ 1876 SWVersionCusApp_BMS21 -1 "SNA" ;
VAL_ 1876 contactorOpenRequest_BMS21 15 "CTR_OPEN_INVALID" 1 "CTR_OPEN_IMMEDIATE" 0 "CTR_OPEN_FAST " ;
VAL_ 1876 maxBrickVoltageChargeLimit_BMS21 65535 "SNA" ;
VAL_ 1876 desiccantTimer_BMS21 -1 "SNA" ;
VAL_ 1876 batSwitchOpenReason_BMS21 65535 "SNA" ;
VAL_ 1876 balancingTime_BMS21 65535 "SNA" ;
VAL_ 1876 ecuSerialNrChar01_BMS21 90 "'Z'" 89 "'Y'" 88 "'X'" 87 "'W'" 86 "'V'" 85 "'U'" 84 "'T'" 83 "'S'" 82 "'R'" 81 "'Q'" 80 "'P'" 79 "'O'" 78 "'N'" 77 "'M'" 76 "'L'" 75 "'K'" 74 "'J'" 73 "'I'" 72 "'H'" 71 "'G'" 70 "'F'" 69 "'E'" 68 "'D'" 67 "'C'" 66 "'B'" 65 "'A'" 57 "'9'" 56 "'8'" 55 "'7'" 54 "'6'" 53 "'5'" 52 "'4'" 51 "'3'" 50 "'2'" 49 "'1'" 48 "'0'" ;
VAL_ 1876 ecuSerialNrChar02_BMS21 90 "'Z'" 89 "'Y'" 88 "'X'" 87 "'W'" 86 "'V'" 85 "'U'" 84 "'T'" 83 "'S'" 82 "'R'" 81 "'Q'" 80 "'P'" 79 "'O'" 78 "'N'" 77 "'M'" 76 "'L'" 75 "'K'" 74 "'J'" 73 "'I'" 72 "'H'" 71 "'G'" 70 "'F'" 69 "'E'" 68 "'D'" 67 "'C'" 66 "'B'" 65 "'A'" 57 "'9'" 56 "'8'" 55 "'7'" 54 "'6'" 53 "'5'" 52 "'4'" 51 "'3'" 50 "'2'" 49 "'1'" 48 "'0'" ;
VAL_ 1876 ecuSerialNrChar03_BMS21 90 "'Z'" 89 "'Y'" 88 "'X'" 87 "'W'" 86 "'V'" 85 "'U'" 84 "'T'" 83 "'S'" 82 "'R'" 81 "'Q'" 80 "'P'" 79 "'O'" 78 "'N'" 77 "'M'" 76 "'L'" 75 "'K'" 74 "'J'" 73 "'I'" 72 "'H'" 71 "'G'" 70 "'F'" 69 "'E'" 68 "'D'" 67 "'C'" 66 "'B'" 65 "'A'" 57 "'9'" 56 "'8'" 55 "'7'" 54 "'6'" 53 "'5'" 52 "'4'" 51 "'3'" 50 "'2'" 49 "'1'" 48 "'0'" ;
VAL_ 1876 ecuSerialNrChar04_BMS21 90 "'Z'" 89 "'Y'" 88 "'X'" 87 "'W'" 86 "'V'" 85 "'U'" 84 "'T'" 83 "'S'" 82 "'R'" 81 "'Q'" 80 "'P'" 79 "'O'" 78 "'N'" 77 "'M'" 76 "'L'" 75 "'K'" 74 "'J'" 73 "'I'" 72 "'H'" 71 "'G'" 70 "'F'" 69 "'E'" 68 "'D'" 67 "'C'" 66 "'B'" 65 "'A'" 57 "'9'" 56 "'8'" 55 "'7'" 54 "'6'" 53 "'5'" 52 "'4'" 51 "'3'" 50 "'2'" 49 "'1'" 48 "'0'" ;
VAL_ 1876 ecuSerialNrChar16_BMS21 90 "'Z'" 89 "'Y'" 88 "'X'" 87 "'W'" 86 "'V'" 85 "'U'" 84 "'T'" 83 "'S'" 82 "'R'" 81 "'Q'" 80 "'P'" 79 "'O'" 78 "'N'" 77 "'M'" 76 "'L'" 75 "'K'" 74 "'J'" 73 "'I'" 72 "'H'" 71 "'G'" 70 "'F'" 69 "'E'" 68 "'D'" 67 "'C'" 66 "'B'" 65 "'A'" 57 "'9'" 56 "'8'" 55 "'7'" 54 "'6'" 53 "'5'" 52 "'4'" 51 "'3'" 50 "'2'" 49 "'1'" 48 "'0'" ;
VAL_ 1876 ecuSerialNrChar17_BMS21 90 "'Z'" 89 "'Y'" 88 "'X'" 87 "'W'" 86 "'V'" 85 "'U'" 84 "'T'" 83 "'S'" 82 "'R'" 81 "'Q'" 80 "'P'" 79 "'O'" 78 "'N'" 77 "'M'" 76 "'L'" 75 "'K'" 74 "'J'" 73 "'I'" 72 "'H'" 71 "'G'" 70 "'F'" 69 "'E'" 68 "'D'" 67 "'C'" 66 "'B'" 65 "'A'" 57 "'9'" 56 "'8'" 55 "'7'" 54 "'6'" 53 "'5'" 52 "'4'" 51 "'3'" 50 "'2'" 49 "'1'" 48 "'0'" ;
VAL_ 1876 ecuSerialNrChar18_BMS21 90 "'Z'" 89 "'Y'" 88 "'X'" 87 "'W'" 86 "'V'" 85 "'U'" 84 "'T'" 83 "'S'" 82 "'R'" 81 "'Q'" 80 "'P'" 79 "'O'" 78 "'N'" 77 "'M'" 76 "'L'" 75 "'K'" 74 "'J'" 73 "'I'" 72 "'H'" 71 "'G'" 70 "'F'" 69 "'E'" 68 "'D'" 67 "'C'" 66 "'B'" 65 "'A'" 57 "'9'" 56 "'8'" 55 "'7'" 54 "'6'" 53 "'5'" 52 "'4'" 51 "'3'" 50 "'2'" 49 "'1'" 48 "'0'" ;
VAL_ 1876 ecuSerialNrChar19_BMS21 90 "'Z'" 89 "'Y'" 88 "'X'" 87 "'W'" 86 "'V'" 85 "'U'" 84 "'T'" 83 "'S'" 82 "'R'" 81 "'Q'" 80 "'P'" 79 "'O'" 78 "'N'" 77 "'M'" 76 "'L'" 75 "'K'" 74 "'J'" 73 "'I'" 72 "'H'" 71 "'G'" 70 "'F'" 69 "'E'" 68 "'D'" 67 "'C'" 66 "'B'" 65 "'A'" 57 "'9'" 56 "'8'" 55 "'7'" 54 "'6'" 53 "'5'" 52 "'4'" 51 "'3'" 50 "'2'" 49 "'1'" 48 "'0'" ;
VAL_ 1876 maxModuleTemperature_BMS21 255 "SNA" ;
VAL_ 1876 meanModuleTemperature_BMS21 255 "SNA" ;
VAL_ 1876 minModuleTemperature_BMS21 255 "SNA" ;
VAL_ 1876 nmOperationalMode_BMS21 2 "NM_BUSSLEEP_MODE" 1 "NM_PREPAREBUSSLEEP_MODE" 0 "NM_NETWORK_MODE" ;
VAL_ 1876 nmNetworkMode_BMS21 2 "NM_MODE_READY_SLEEP" 1 "NM_MODE_NORMAL_OPERATION" 0 "NM_MODE_REPEAT_MESSAGE" ;
VAL_ 1876 nmNetworkState_BMS21 1 "NM_STATE_REQUESTED" 0 "NM_STATE_RELEASED" ;
VAL_ 1876 ecuState_BMS21 4 "ECU_SLEEPING" 3 "ECU_GOING_TO_SLEEP" 2 "ECU_AWAKE_CAN_ACTIVE" 1 "ECU_AWAKE_CAN_INACTIVE" 0 "ECU_INIT" ;
VAL_ 1876 SPIRxTxDiag_BMS21 3 "SPIRXTX_SLAVEREQUESTPACKAGE" 2 "SPIRXTX_CRC" 1 "SPIRXTX_WRONG_PACKETINDEX" 0 "SPIRXTX_ALL_OK" ;
VAL_ 1876 minSOC_BMS21 65535 "SNA" ;
VAL_ 1876 maxSOC_BMS21 65535 "SNA" ;
VAL_ 1876 appTaskMaxCpuUsage_BMS21 255 "SNA" ;
VAL_ 1876 appTaskCpuUsage_BMS21 255 "SNA" ;
VAL_ 1876 appTask50HzCpuUsage_BMS21 255 "SNA" ;
VAL_ 1876 appTask10HzStackUsage_BMS21 255 "SNA" ;
VAL_ 1876 appTask100HzCpuUsage_BMS21 255 "SNA" ;
VAL_ 1876 appTask10HzCpuUsage_BMS21 255 "SNA" ;
VAL_ 1876 appTask1HzCpuUsage_BMS21 255 "SNA" ;
VAL_ 1876 pumpSpeedReq_BMS21 255 "SNA" ;
VAL_ 1876 regenCurrPredBrickVOffset_BMS21 255 "SNA" ;
VAL_ 1876 dischgCurrPredBrickVOffset_BMS21 255 "SNA" ;
VAL_ 1876 PCANBusOffState_BMS21 3 "SNA" 2 "CAN_BUSOFF_PHASE2" 1 "CAN_BUSOFF_PHASE1" 0 "CAN_BUSOFF_NORMAL" ;
VAL_ 1876 SCANBusOffState_BMS21 3 "SNA" 2 "CAN_BUSOFF_PHASE2" 1 "CAN_BUSOFF_PHASE1" 0 "CAN_BUSOFF_NORMAL" ;
VAL_ 1876 PTCANBusOffState_BMS21 3 "SNA" 2 "CAN_BUSOFF_PHASE2" 1 "CAN_BUSOFF_PHASE1" 0 "CAN_BUSOFF_NORMAL" ;
VAL_ 1876 customerModelVsCellType_BMS21 0 "L" 1 "P" ;
VAL_ 1876 balancingVoltageTarget_BMS21 255 "VOLTAGEBASED_BALANCING_INACTIVE" ;
VAL_ 1876 analogAddr5_BMS21 255 "SNA" ;
VAL_ 1876 analogAddr0_BMS21 255 "SNA" ;
VAL_ 1876 analogAddr4_BMS21 255 "SNA" ;
VAL_ 1876 analogAddr3_BMS21 255 "SNA" ;
VAL_ 1876 analogAddr2_BMS21 255 "SNA" ;
VAL_ 1876 analogAddr1_BMS21 255 "SNA" ;
VAL_ 1876 debugSlowMpex1_BMS21 43 "S43" 42 "S42" 41 "S41" 40 "S40" 39 "S39" 38 "S38" 37 "S37" 36 "S36" 0 "S00" 1 "S01" 2 "S02" 3 "S03" 4 "S04" 5 "S05" 6 "S06" 7 "S07" 8 "S08" 9 "S09" 10 "S10" 11 "S11" 12 "S12" 13 "S13" 14 "S14" 15 "S15" 16 "S16" 17 "S17" 18 "S18" 19 "S19" 20 "S20" 21 "S21" 22 "S22" 23 "S23" 24 "S24" 25 "S25" 26 "S26" 27 "S27" 28 "S28" 29 "S29" 30 "S30" 31 "S31" 32 "S32" 33 "S33" 34 "S34" 35 "S35" ;
VAL_ 1876 analog3V3DSupply_BMS21 255 "SNA" ;
VAL_ 1876 pressure_BMS21 255 "SNA" ;
VAL_ 1876 analog3P3VA_BMS21 255 "SNA" ;
VAL_ 1876 analog5VA_BMS21 255 "SNA" ;
VAL_ 1876 analog5VD_BMS21 255 "SNA" ;
VAL_ 1876 analog5VSensorSupply_BMS21 255 "SNA" ;
VAL_ 1876 analog6V5_BMS21 255 "SNA" ;
VAL_ 1876 isolationResistanceIntern_BMS21 65535 "SNA" ;
VAL_ 1876 isolationResistanceExtern_BMS21 65535 "SNA" ;
VAL_ 1876 linkVoltage_BMS21 65535 "SNA" ;
VAL_ 1876 eepromWriteCyclesBasics_BMS21 65535 "SNA" ;
VAL_ 1876 eepromBlockIndex_BMS21 255 "SNA" ;
VAL_ 1876 regenCurrentOpLimit_BMS21 65535 "SNA" ;
VAL_ 1876 regenCurrentErrorLimit_BMS21 65535 "SNA" ;
VAL_ 1876 lifetime_BMS21 -1 "SNA" ;
VAL_ 1876 eepromReadTime_BMS21 255 "SNA" ;
VAL_ 1876 pumpSpeedReqMaxT_BMS21 65535 "SNA" ;
VAL_ 1876 pumpSpeedReqDeltaT_BMS21 65535 "SNA" ;
VAL_ 1876 packVoltageCMB_BMS21 65535 "SNA" ;
VAL_ 1876 ctrOffTime_BMS21 65535 "SNA" ;
VAL_ 1876 sleepTime_BMS21 65535 "SNA" ;
VAL_ 1876 SPIRxTxTimeAllPckts_BMS21 255 "SNA" ;
VAL_ 1876 isolationTestState_BMS21 3 "ISOLATION_DISABLED" 2 "ISOLATION_TEST_NEG" 1 "ISOLATION_TEST_POS" 0 "ISOLATION_OFF" ;
VAL_ 1748 SPIRxTxHeaderMux3Status_BMS21 1 "SPIRXTX_MUX_MISSING" 0 "SPIRXTX_MUX_GOOD" ;
VAL_ 1748 SPIRxTxHeaderMux2Status_BMS21 1 "SPIRXTX_MUX_MISSING" 0 "SPIRXTX_MUX_GOOD" ;
VAL_ 1748 SPIRxTxHeaderMux1Status_BMS21 1 "SPIRXTX_MUX_MISSING" 0 "SPIRXTX_MUX_GOOD" ;
VAL_ 1748 SPIRxTxHeaderMux0Status_BMS21 1 "SPIRXTX_MUX_MISSING" 0 "SPIRXTX_MUX_GOOD" ;
VAL_ 1748 activeIsoState_BMS21 4 "ISOACTV_COMPLETE" 3 "ISOACTV_TIMEOUT" 2 "ISOACTV_PENDING" 1 "ISOACTV_INIT" 0 "ISOACTV_OFF" ;
VAL_ 1748 activeIsoNegLink_BMS21 65535 "SNA" ;
VAL_ 1748 activeIsoPosLink_BMS21 65535 "SNA" ;
VAL_ 1748 activeIsoPosBuffer_BMS21 65535 "SNA" ;
VAL_ 1748 activeIsoNegBuffer_BMS21 65535 "SNA" ;
VAL_ 1748 activeIsoResRaw_BMS21 65535 "SNA" ;
VAL_ 1748 activeIsoResFilter_BMS21 65535 "SNA" ;
VAL_ 1748 contactorStateAux_BMS21 4 "CTR_INVALID" 3 "CTR_STRING_OPENING" 2 "CTR_STRING_ON" 1 "CTR_STRING_PRECHARGE" 0 "CTR_STRING_OFF" ;
VAL_ 1748 batSwitchOpenReqEssMstr_BMS21 3 "INVALID" 2 "IMMEDIATE_OPEN" 1 "FAST_OPEN" 0 "DO_NOT_OPEN" ;
VAL_ 1748 packShutdownTarget_BMS21 3 "BMS_INVALID" 1 "BMS_STRING_FAULT" 0 "BMS_STANDBY" ;
VAL_ 1748 weldedState_BMS21 3 "CTR_NEG1_WELDED" 2 "CTR_POS1_WELDED" 0 "CTR_NOTWELDED" 1 "CTR_BOTH_WELDED" ;
VAL_ 1748 contactorStateRq_BMS21 4 "CTR_INVALID" 3 "CTR_STRING_OPENING" 2 "CTR_STRING_ON" 1 "CTR_STRING_PRECHARGE" 0 "CTR_STRING_OFF" ;
VAL_ 1748 strMstrStrPrechgState_BMS21 7 "NOT_A_STRING_MASTER" 6 "STRING_PRCHG_NDEF2" 5 "STRING_PRCHG_NDEF1" 4 "STRING_PRCHG_FAULT" 3 "STRING_PRCHG_ON" 2 "STRING_PRCHG_ACTV" 1 "STRING_PRCHG_INIT" 0 "STRING_PRCHG_OFF" ;
VAL_ 1748 packShutdwnTmrQual_BMS21 0 "SHUTDOWN_ACTIVE" 1 "SHUTDOWN_INACTIVE" ;
VAL_ 1748 packStateRequest_BMS21 7 "STATE_INVALID" 6 "STATE_SYSTEM_FAULT" 5 "STATE_STRING_FAULT" 4 "STATE_LIMPHOME" 3 "STATE_ACCESSORY" 2 "STATE_CHARGE" 1 "STATE_DRIVE" 0 "STATE_STANDBY" ;
VAL_ 1748 packState_BMS21 15 "STATE_INVALID" 6 "STATE_ESS_FAULT" 5 "STATE_STRING_FAULT" 4 "STATE_LIMPHOME" 3 "STATE_ACCESSORY" 2 "STATE_CHARGE" 1 "STATE_DRIVE" 0 "STATE_STANDBY" ;
VAL_ 1748 SPIRxTxTimer_BMS21 255 "SNA" ;
VAL_ 1748 moduleTMinMaxMeanQual_BMS21 1 "QUAL_ERROR" 0 "QUAL_VALID" ;
VAL_ 1748 currentQual_BMS21 1 "QUAL_ERROR" 0 "QUAL_VALID" ;
VAL_ 1748 brickVMinMaxMeanQual_BMS21 1 "QUAL_ERROR" 0 "QUAL_VALID" ;
VAL_ 1748 debugFastMpex1_BMS21 0 "F00" 1 "F01" 2 "F02" 3 "F03" 4 "F04" 5 "F05" 6 "F06" 7 "F07" 8 "F08" 9 "F09" 10 "F10" 11 "F11" 12 "F12" 13 "F13" 14 "F14" 15 "F15" ;
VAL_ 1748 itemState_BMS21 3 "ITEM_INVALID" 2 "ITEM_EMERGENCY" 1 "ITEM_OFF" 0 "ITEM_ON" ;
VAL_ 1748 posLink_BMS21 255 "SNA" ;
VAL_ 1748 posPack_BMS21 255 "SNA" ;
VAL_ 1748 prechargeState_BMS21 14 "CTR_PRCHG_WAIT_CY_MATCH" 15 "CTR_PRCHG_NEG_OPEN" 13 "CTR_PRCHG_POS_WELD_CHECK" 12 "CTR_PRCHG_PRE_COND_CHECK" 11 "CTR_PRCHG_NEG2_WELD_CHECK" 10 "CTR_PRCHG_CLOSEMID" 9 "CTR_PRCHG_CLOSEAUX" 8 "CTR_PRCHG_FAILED" 7 "CTR_PRCHG_COMPLETE" 6 "CTR_PRCHG_CLOSE_POS" 5 "CTR_PRCHG_MONITOR_VOLTAGE" 4 "CTR_PRCHG_CLOSE_NEG" 3 "CTR_PRCHG_NEG_WELD_CHECK" 2 "CTR_PRCHG_CLOSE_RELAY" 1 "CTR_PRCHG_WELD_CHECK" 0 "CTR_PRCHG_OFF" ;
VAL_ 1748 contactorState_BMS21 4 "CTR_INVALID" 3 "CTR_STRING_OPENING" 2 "CTR_STRING_ON" 1 "CTR_STRING_PRECHARGE" 0 "CTR_STRING_OFF" ;
