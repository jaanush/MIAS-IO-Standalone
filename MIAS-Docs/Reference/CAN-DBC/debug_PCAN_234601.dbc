VERSION ""

NS_ :

BS_:
BU_: ME SC01 BMS01 BMS PT
BO_ 1217 BMS02_DebugEventMap4: 8 BMS02
 SG_ DEM096_SC_STATE_SELFTEST_BMS02 : 9|2@0+ (1,0) [0|0] ""  PT
 SG_ DEM097_SC_STATE_TEMP_BMS02 : 11|2@0+ (1,0) [0|0] ""  PT
 SG_ DEM098_SC_STATE_VOLTAGE_BMS02 : 13|2@0+ (1,0) [0|0] ""  PT
 SG_ DEM099_SC_STATE_HVIL_BMS02 : 15|2@0+ (1,0) [0|0] ""  PT
 SG_ DEM100_SC_STATE_CONTACTORS_BMS02 : 1|2@0+ (1,0) [0|0] ""  PT
 SG_ DEM101_SC_STATE_CURRENT_BMS02 : 3|2@0+ (1,0) [0|0] ""  PT
 SG_ DEM102_SC_STATE_CANRX_BMS02 : 5|2@0+ (1,0) [0|0] ""  PT
 SG_ DEM103_SC_STATE_CRASH_BMS02 : 7|2@0+ (1,0) [0|0] ""  PT
 SG_ DEM104_SC_STATE_CCTRL_BMS02 : 25|2@0+ (1,0) [0|0] ""  PT
 SG_ DEM105_SC_STATE_CANTX_BMS02 : 27|2@0+ (1,0) [0|0] ""  PT
 SG_ DEM106_SC_STATE_THERMALEVT_BMS02 : 29|2@0+ (1,0) [0|0] ""  PT
 SG_ DEM107_SC_STATE_COOLANT_BMS02 : 31|2@0+ (1,0) [0|0] ""  PT
 SG_ DEM108_SC_SELFTEST_SFTY_UC_BMS02 : 17|2@0+ (1,0) [0|0] ""  PT
 SG_ DEM109_SC_TEMP_HIGH_BMS02 : 19|2@0+ (1,0) [0|0] ""  PT
 SG_ DEM110_SC_TEMP_NTC_OPEN_BMS02 : 21|2@0+ (1,0) [0|0] ""  PT
 SG_ DEM111_SC_TEMP_NTC_SHORT_BMS02 : 23|2@0+ (1,0) [0|0] ""  PT
 SG_ DEM112_CMB_DISCONNECTED_BMS02 : 41|2@0+ (1,0) [0|0] ""  PT
 SG_ DEM113_CMB_DEFECT_BMS02 : 43|2@0+ (1,0) [0|0] ""  PT
 SG_ DEM114_CMB_COMMERROR_BMS02 : 45|2@0+ (1,0) [0|0] ""  PT
 SG_ DEM115_SC_CURR_HALL_PWR_LO_BMS02 : 47|2@0+ (1,0) [0|0] ""  PT
 SG_ DEM116_SC_CURR_HALL_VHIGH_BMS02 : 33|2@0+ (1,0) [0|0] ""  PT
 SG_ DEM117_SC_CURR_HALL_ADC_BMS02 : 35|2@0+ (1,0) [0|0] ""  PT
 SG_ DEM118_SC_CURR_HALL_VLOW_BMS02 : 37|2@0+ (1,0) [0|0] ""  PT
 SG_ DEM119_SC_CURR_ISENSE_PWR_BMS02 : 39|2@0+ (1,0) [0|0] ""  PT
 SG_ DEM120_SC_CURR_ISENSE1_MIA_BMS02 : 57|2@0+ (1,0) [0|0] ""  PT
 SG_ DEM121_SC_CURR_ISENSE2_MIA_BMS02 : 59|2@0+ (1,0) [0|0] ""  PT
 SG_ DEM122_SC_CURR_ISENSE3_MIA_BMS02 : 61|2@0+ (1,0) [0|0] ""  PT
 SG_ DEM123_SC_CURR_ISENSE4_MIA_BMS02 : 63|2@0+ (1,0) [0|0] ""  PT
 SG_ DEM124_SC_CURR_ISENSE5_MIA_BMS02 : 49|2@0+ (1,0) [0|0] ""  PT
 SG_ DEM125_SC_CURR_ISENSE1_FLT_BMS02 : 51|2@0+ (1,0) [0|0] ""  PT
 SG_ DEM126_SC_CURR_ISENSE2_FLT_BMS02 : 53|2@0+ (1,0) [0|0] ""  PT
 SG_ DEM127_SC_CURR_ISENSE3_FLT_BMS02 : 55|2@0+ (1,0) [0|0] ""  PT

BO_ 1281 BMS02_DebugEventMap5: 8 BMS02
 SG_ DEM128_SC_CURR_ISENSE4_FLT_BMS02 : 9|2@0+ (1,0) [0|0] ""  PT
 SG_ DEM129_SC_CURR_ISENSE5_FLT_BMS02 : 11|2@0+ (1,0) [0|0] ""  PT
 SG_ DEM130_SC_CURR_OFFSET_BMS02 : 13|2@0+ (1,0) [0|0] ""  PT
 SG_ DEM131_SC_CURR_PLAUSI_BMS02 : 15|2@0+ (1,0) [0|0] ""  PT
 SG_ DEM132_SC_CURR_CHARGE_HIGH_BMS02 : 1|2@0+ (1,0) [0|0] ""  PT
 SG_ DEM133_SC_CURR_DSCHAR_HIGH_BMS02 : 3|2@0+ (1,0) [0|0] ""  PT
 SG_ DEM134_SC_V_CMB_SUMOFCELL_BMS02 : 5|2@0+ (1,0) [0|0] ""  PT
 SG_ DEM135_SC_V_SENSE_OPENWIRE_BMS02 : 7|2@0+ (1,0) [0|0] ""  PT
 SG_ DEM136_SC_V_CMB_DRV_FROZEN_BMS02 : 25|2@0+ (1,0) [0|0] ""  PT
 SG_ DEM137_SC_V_PACK_PLAUSI_BMS02 : 27|2@0+ (1,0) [0|0] ""  PT
 SG_ DEM138_SC_HVIL_HW_FLT_BMS02 : 29|2@0+ (1,0) [0|0] ""  PT
 SG_ DEM139_SC_HVIL_OPEN_BMS02 : 31|2@0+ (1,0) [0|0] ""  PT
 SG_ DEM140_SC_HVIL_TO_SUP_BMS02 : 17|2@0+ (1,0) [0|0] ""  PT
 SG_ DEM141_SC_HVIL_TO_CHAS_BMS02 : 19|2@0+ (1,0) [0|0] ""  PT
 SG_ DEM142_SC_HVIL_R_HIGH_BMS02 : 21|2@0+ (1,0) [0|0] ""  PT
 SG_ DEM143_SC_HVIL_SHORT_BMS02 : 23|2@0+ (1,0) [0|0] ""  PT
 SG_ DEM144_SC_CN_ISO_FAIL_BMS02 : 41|2@0+ (1,0) [0|0] ""  PT
 SG_ DEM145_HVIL_SYS_BMS02 : 43|2@0+ (1,0) [0|0] ""  PT
 SG_ DEM146_SC_CN_POS1_WELDED_BMS02 : 45|2@0+ (1,0) [0|0] ""  PT
 SG_ DEM147_SC_CN_NEG1_WELDED_BMS02 : 47|2@0+ (1,0) [0|0] ""  PT
 SG_ DEM148_SC_CN_POS2_WELDED_BMS02 : 33|2@0+ (1,0) [0|0] ""  PT
 SG_ DEM149_SC_CN_NEG2_WELDED_BMS02 : 35|2@0+ (1,0) [0|0] ""  PT
 SG_ DEM150_SC_CN_POS3_WELDED_BMS02 : 37|2@0+ (1,0) [0|0] ""  PT
 SG_ DEM151_SC_CN_NEG3_WELDED_BMS02 : 39|2@0+ (1,0) [0|0] ""  PT
 SG_ DEM152_SC_CN_HIGH_CY_BMS02 : 57|2@0+ (1,0) [0|0] ""  PT
 SG_ DEM153_SC_CN_ISOANDPOTWELD_BMS02 : 59|2@0+ (1,0) [0|0] ""  PT
 SG_ DEM154_SC_TEMP_PLAUSI_BMS02 : 61|2@0+ (1,0) [0|0] ""  PT
 SG_ DEM155_SC_CURR_HALL_PWR_HI_BMS02 : 63|2@0+ (1,0) [0|0] ""  PT
 SG_ DEM156_SC_PYRO_TRIGGERED_BMS02 : 49|2@0+ (1,0) [0|0] ""  PT
 SG_ DEM157_SC_PYRO_OPEN_BMS02 : 51|2@0+ (1,0) [0|0] ""  PT
 SG_ DEM158_AUX_CTRS_END_OF_LIF_BMS02 : 53|2@0+ (1,0) [0|0] ""  PT
 SG_ DEM159_SC_CANRX_PT_MIA_BMS02 : 55|2@0+ (1,0) [0|0] ""  PT

BO_ 1345 BMS02_DebugEventMap6: 8 BMS02
 SG_ DEM160_SC_CANRX_PT_CRCALIV_BMS02 : 9|2@0+ (1,0) [0|0] ""  PT
 SG_ DEM161_SC_CANRX_LIN_SHUTDN_BMS02 : 11|2@0+ (1,0) [0|0] ""  PT
 SG_ DEM162_SC_CANRX_LIN_MIA_BMS02 : 13|2@0+ (1,0) [0|0] ""  PT
 SG_ DEM163_SC_CRASH1_BMS02 : 15|2@0+ (1,0) [0|0] ""  PT
 SG_ DEM164_SC_CRASH2_BMS02 : 1|2@0+ (1,0) [0|0] ""  PT
 SG_ DEM165_SC_CRASHCAN_BMS02 : 3|2@0+ (1,0) [0|0] ""  PT
 SG_ DEM166_SC_CCTRL_SELFTEST_BMS02 : 5|2@0+ (1,0) [0|0] ""  PT
 SG_ DEM167_SC_CCTRL_DRIVER_FAU_BMS02 : 7|2@0+ (1,0) [0|0] ""  PT
 SG_ DEM168_SC_CCTRL_HISIDESTCL_BMS02 : 25|2@0+ (1,0) [0|0] ""  PT
 SG_ DEM169_SC_CCTRL_HISIDESTOP_BMS02 : 27|2@0+ (1,0) [0|0] ""  PT
 SG_ DEM170_SC_CCTRL_LOSIDESTCL_BMS02 : 29|2@0+ (1,0) [0|0] ""  PT
 SG_ DEM171_SC_CCTRL_HVCNDITION_BMS02 : 31|2@0+ (1,0) [0|0] ""  PT
 SG_ DEM172_SC_CCTRL_POS1_OPN_BMS02 : 17|2@0+ (1,0) [0|0] ""  PT
 SG_ DEM173_SC_CCTRL_POS2_OPN_BMS02 : 19|2@0+ (1,0) [0|0] ""  PT
 SG_ DEM174_SC_CCTRL_POS3_OPN_BMS02 : 21|2@0+ (1,0) [0|0] ""  PT
 SG_ DEM175_SC_CCTRL_NEG1_OPN_BMS02 : 23|2@0+ (1,0) [0|0] ""  PT
 SG_ DEM176_SC_CCTRL_NEG2_OPN_BMS02 : 41|2@0+ (1,0) [0|0] ""  PT
 SG_ DEM177_SC_CCTRL_PRE2_OPN_BMS02 : 43|2@0+ (1,0) [0|0] ""  PT
 SG_ DEM178_SC_CCTRL_PRE1_OPN_BMS02 : 45|2@0+ (1,0) [0|0] ""  PT
 SG_ DEM179_SC_CCTRL_LOSIDESTOP_BMS02 : 47|2@0+ (1,0) [0|0] ""  PT
 SG_ DEM180_SC_CCTRL_UNEXPECTED_BMS02 : 33|2@0+ (1,0) [0|0] ""  PT
 SG_ DEM181_SC_V_OUT_OF_RANGE_BMS02 : 35|2@0+ (1,0) [0|0] ""  PT
 SG_ DEM182_SC_V_LATCHED_UVOV_BMS02 : 37|2@0+ (1,0) [0|0] ""  PT
 SG_ DEM183_ISO_EXT_STRAT_2_BMS02 : 39|2@0+ (1,0) [0|0] ""  PT
 SG_ DEM184_SC_CANTX_CTRS_BMS02 : 57|2@0+ (1,0) [0|0] ""  PT
 SG_ DEM185_SC_CANTX_HVIL_BMS02 : 59|2@0+ (1,0) [0|0] ""  PT
 SG_ DEM186_SC_CANTX_ISOL_BMS02 : 61|2@0+ (1,0) [0|0] ""  PT
 SG_ DEM187_SC_SBC_WATCHDOG_BMS02 : 63|2@0+ (1,0) [0|0] ""  PT
 SG_ DEM188_SC_SBC_FAULT_BMS02 : 49|2@0+ (1,0) [0|0] ""  PT
 SG_ DEM189_SC_WATCHDOG_BMS02 : 51|2@0+ (1,0) [0|0] ""  PT
 SG_ DEM190_SC_SELFTEST_RAM_BMS02 : 53|2@0+ (1,0) [0|0] ""  PT
 SG_ DEM191_SC_SELFTEST_FLASH_BMS02 : 55|2@0+ (1,0) [0|0] ""  PT

BO_ 1409 BMS02_DebugEventMap7: 8 BMS02
 SG_ DEM192_CMB_ONBOARDRH_OH_BMS02 : 9|2@0+ (1,0) [0|0] ""  PT
 SG_ DEM193_CMB_ONBOARDRH_SNA_BMS02 : 11|2@0+ (1,0) [0|0] ""  PT
 SG_ DEM194_CMB_ONBOARDT_OT_BMS02 : 13|2@0+ (1,0) [0|0] ""  PT
 SG_ DEM195_CMB_ONBOARDT_CHANGE_BMS02 : 15|2@0+ (1,0) [0|0] ""  PT
 SG_ DEM196_PRESSURE_CHANGE_BMS02 : 1|2@0+ (1,0) [0|0] ""  PT
 SG_ DEM197_PRESSURE_OVER_BMS02 : 3|2@0+ (1,0) [0|0] ""  PT
 SG_ DEM198_PRESSURE_UNDER_BMS02 : 5|2@0+ (1,0) [0|0] ""  PT
 SG_ DEM199_PRESSURE_INVALID_BMS02 : 7|2@0+ (1,0) [0|0] ""  PT
 SG_ DEM200_THERMAL_EVENT_BMS02 : 25|2@0+ (1,0) [0|0] ""  PT
 SG_ DEM201_CMB_ONBOARDT_SNA_BMS02 : 27|2@0+ (1,0) [0|0] ""  PT
 SG_ DEM202_REPLACE_DESICCANT_BMS02 : 29|2@0+ (1,0) [0|0] ""  PT
 SG_ DEM203_COOLANT_FLOOD_FAULT_BMS02 : 31|2@0+ (1,0) [0|0] ""  PT
 SG_ DEM204_LOW_BRICKCAPACITY_BMS02 : 17|2@0+ (1,0) [0|0] ""  PT
 SG_ DEM205_BMS_ONBOARDT_OT_BMS02 : 19|2@0+ (1,0) [0|0] ""  PT
 SG_ DEM206_HUMIDITY_CHANGE_BMS02 : 21|2@0+ (1,0) [0|0] ""  PT
 SG_ DEM207_ISENSE_SUPPLY_CURR_BMS02 : 23|2@0+ (1,0) [0|0] ""  PT
 SG_ DEM208_SOC_LOW_BMS02 : 41|2@0+ (1,0) [0|0] ""  PT
 SG_ DEM209_SOC_TOOLOW_BMS02 : 43|2@0+ (1,0) [0|0] ""  PT
 SG_ DEM210_SOC_TOOHIGH_BMS02 : 45|2@0+ (1,0) [0|0] ""  PT
 SG_ DEM211_BALANCING_REQUIRED_BMS02 : 47|2@0+ (1,0) [0|0] ""  PT
 SG_ DEM212_DEEP_DISCHARGE_BMS02 : 33|2@0+ (1,0) [0|0] ""  PT
 SG_ DEM213_CAN1_BUS_OFF_BMS02 : 35|2@0+ (1,0) [0|0] ""  PT
 SG_ DEM214_CAN2_BUS_OFF_BMS02 : 37|2@0+ (1,0) [0|0] ""  PT
 SG_ DEM215_CAN3_BUS_OFF_BMS02 : 39|2@0+ (1,0) [0|0] ""  PT
 SG_ DEM216_OUTLET_NTC_RATNAL_BMS02 : 57|2@0+ (1,0) [0|0] ""  PT
 SG_ DEM217_FUSE_PACK_BMS02 : 59|2@0+ (1,0) [0|0] ""  PT
 SG_ DEM218_FUSE_B_OPEN_BMS02 : 61|2@0+ (1,0) [0|0] ""  PT
 SG_ DEM219_FUSE_C_OPEN_BMS02 : 63|2@0+ (1,0) [0|0] ""  PT
 SG_ DEM220_FUSE_D_OPEN_BMS02 : 49|2@0+ (1,0) [0|0] ""  PT
 SG_ DEM221_FUSE_E_OPEN_BMS02 : 51|2@0+ (1,0) [0|0] ""  PT
 SG_ DEM222_PUMP_DRY_RUN_BMS02 : 53|2@0+ (1,0) [0|0] ""  PT
 SG_ DEM223_PUMP_PERFORMANCE_BMS02 : 55|2@0+ (1,0) [0|0] ""  PT

BO_ 1473 BMS02_DebugEventMap8: 8 BMS02
 SG_ DEM224_PUMP_LIN_FAILURE_BMS02 : 9|2@0+ (1,0) [0|0] ""  PT
 SG_ DEM225_PUMP_SUPPLY_VOLTAGE_BMS02 : 11|2@0+ (1,0) [0|0] ""  PT
 SG_ DEM226_PUMP_RECOVERY_FAIL_BMS02 : 13|2@0+ (1,0) [0|0] ""  PT
 SG_ DEM227_CTR_POS_OPENED_BMS02 : 15|2@0+ (1,0) [0|0] ""  PT
 SG_ DEM228_CTR_NEG_OPENED_BMS02 : 1|2@0+ (1,0) [0|0] ""  PT
 SG_ DEM229_STRSET_SLAVE1_FAULT_BMS02 : 3|2@0+ (1,0) [0|0] ""  PT
 SG_ DEM230_STRSET_SLAVE2_FAULT_BMS02 : 5|2@0+ (1,0) [0|0] ""  PT
 SG_ DEM231_CTRSAUX_CLFAIL_HVON_BMS02 : 7|2@0+ (1,0) [0|0] ""  PT
 SG_ DEM232_CTRSAUX_CLFAIL_VDIF_BMS02 : 25|2@0+ (1,0) [0|0] ""  PT
 SG_ DEM233_CTRSAUX_POS1_OPENED_BMS02 : 27|2@0+ (1,0) [0|0] ""  PT
 SG_ DEM234_CTRSAUX_NEG1_OPENED_BMS02 : 29|2@0+ (1,0) [0|0] ""  PT
 SG_ DEM235_CTRSAUX_POS1_WELDED_BMS02 : 31|2@0+ (1,0) [0|0] ""  PT
 SG_ DEM236_CTRSAUX_NEG1_WELDED_BMS02 : 17|2@0+ (1,0) [0|0] ""  PT
 SG_ DEM237_CTRSAUX_POS1_PULLIN_BMS02 : 19|2@0+ (1,0) [0|0] ""  PT
 SG_ DEM238_CTRSAUX_NEG1_PULLIN_BMS02 : 21|2@0+ (1,0) [0|0] ""  PT
 SG_ DEM239_INLET_NTC_RATNAL_BMS02 : 23|2@0+ (1,0) [0|0] ""  PT
 SG_ DEM240_INLET_NTC_HI_BMS02 : 41|2@0+ (1,0) [0|0] ""  PT
 SG_ DEM241_INLET_NTC_LO_BMS02 : 43|2@0+ (1,0) [0|0] ""  PT
 SG_ DEM242_VOLTAGE_LINK2_RATNA_BMS02 : 45|2@0+ (1,0) [0|0] ""  PT
 SG_ DEM243_VOLTAGE_LINK2_HI_BMS02 : 47|2@0+ (1,0) [0|0] ""  PT
 SG_ DEM244_VOLTAGE_LINK2_LO_BMS02 : 33|2@0+ (1,0) [0|0] ""  PT
 SG_ DEM245_CMB_ONBOARD_IMPOSSI_BMS02 : 35|2@0+ (1,0) [0|0] ""  PT
 SG_ DEM246_VOLTAGE_LINK1_HI_BMS02 : 37|2@0+ (1,0) [0|0] ""  PT
 SG_ DEM247_VOLTAGE_LINK1_LO_BMS02 : 39|2@0+ (1,0) [0|0] ""  PT
 SG_ DEM248_NTC_SUPPLY_LO_BMS02 : 57|2@0+ (1,0) [0|0] ""  PT
 SG_ DEM249_NTC_SUPPLY_HI_BMS02 : 59|2@0+ (1,0) [0|0] ""  PT
 SG_ DEM250_VOLTAGE_LINK3_RATNA_BMS02 : 61|2@0+ (1,0) [0|0] ""  PT
 SG_ DEM251_VOLTAGE_LINK3_HI_BMS02 : 63|2@0+ (1,0) [0|0] ""  PT
 SG_ DEM252_VOLTAGE_LINK3_LO_BMS02 : 49|2@0+ (1,0) [0|0] ""  PT
 SG_ DEM253_BALANCING_STUCK_BMS02 : 51|2@0+ (1,0) [0|0] ""  PT
 SG_ DEM254_ARM_EXCEPTION_BMS02 : 53|2@0+ (1,0) [0|0] ""  PT
 SG_ DEM255_ERROR_HOOKS_BMS02 : 55|2@0+ (1,0) [0|0] ""  PT

BO_ 833 BMS02_DebugEventMap9: 8 BMS02
 SG_ DEM256_XCP_CAL_CHANGE_BMS02 : 9|2@0+ (1,0) [0|0] ""  PT
 SG_ DEM257_XCP_CAL_PERM_CHANGE_BMS02 : 11|2@0+ (1,0) [0|0] ""  PT
 SG_ DEM258_TASK_TIME_OVERFLOW_BMS02 : 13|2@0+ (1,0) [0|0] ""  PT
 SG_ DEM259_ISO_CIRCUIT_BMS02 : 15|2@0+ (1,0) [0|0] ""  PT
 SG_ DEM260_COOLANT_MOIST_FAULT_BMS02 : 1|2@0+ (1,0) [0|0] ""  PT
 SG_ DEM261_COOLANT_FLOOD_WARN_BMS02 : 3|2@0+ (1,0) [0|0] ""  PT
 SG_ DEM262_COOLANT_MOIST_WARN_BMS02 : 5|2@0+ (1,0) [0|0] ""  PT
 SG_ DEM263_MODULET_IMPLAUSIBLE_BMS02 : 7|2@0+ (1,0) [0|0] ""  PT
 SG_ DEM264_REQUEST_ON_WITH_HV__BMS02 : 25|2@0+ (1,0) [0|0] ""  PT
 SG_ DEM265_CSERS_PCODE_BMS02 : 27|2@0+ (1,0) [0|0] ""  PT
 SG_ DEM266_PRELIM_CNTR_CL_FAIL_BMS02 : 29|2@0+ (1,0) [0|0] ""  PT
 SG_ DEM267_FLUIDLVL_LOW_BMS02 : 31|2@0+ (1,0) [0|0] ""  PT
 SG_ DEM268_FLUIDLVL_FAILURE_BMS02 : 17|2@0+ (1,0) [0|0] ""  PT
 SG_ DEM269_SC_COOLANT_CONTAM_BMS02 : 19|2@0+ (1,0) [0|0] ""  PT
 SG_ DEM270_SC_COOLANT_MIA_BMS02 : 21|2@0+ (1,0) [0|0] ""  PT
 SG_ DEM271_PRESSURE_VHI_BMS02 : 23|2@0+ (1,0) [0|0] ""  PT
 SG_ DEM272_PRESSURE_VLO_BMS02 : 41|2@0+ (1,0) [0|0] ""  PT
 SG_ DEM273_SC_COOLANT_FAIL_BMS02 : 43|2@0+ (1,0) [0|0] ""  PT
 SG_ DEM274_CTRSAUX_POS2_OPENED_BMS02 : 45|2@0+ (1,0) [0|0] ""  PT
 SG_ DEM275_CTRSAUX_POS3_OPENED_BMS02 : 47|2@0+ (1,0) [0|0] ""  PT
 SG_ DEM276_CTRSAUX_POS2_WELDED_BMS02 : 33|2@0+ (1,0) [0|0] ""  PT
 SG_ DEM277_CTRSAUX_POS3_WELDED_BMS02 : 35|2@0+ (1,0) [0|0] ""  PT
 SG_ DEM278_CTRSAUX_POS2_PULLIN_BMS02 : 37|2@0+ (1,0) [0|0] ""  PT
 SG_ DEM279_CTRSAUX_POS3_PULLIN_BMS02 : 39|2@0+ (1,0) [0|0] ""  PT
 SG_ DEM280_CMB_HUMIDITY_TEMP_C_BMS02 : 57|2@0+ (1,0) [0|0] ""  PT
 SG_ DEM281_THERMAL_EVENT_CMB_R_BMS02 : 59|2@0+ (1,0) [0|0] ""  PT
 SG_ DEM282_CUS_BRICKOV_BMS02 : 61|2@0+ (1,0) [0|0] ""  PT
 SG_ DEM283_CUS_BRICKUV_BMS02 : 63|2@0+ (1,0) [0|0] ""  PT
 SG_ DEM284_CUS_OVERCHRG_BMS02 : 49|2@0+ (1,0) [0|0] ""  PT
 SG_ DEM285_CUS_OVERDCHRG_BMS02 : 51|2@0+ (1,0) [0|0] ""  PT
 SG_ DEM286_CUS_CURRENT_CHG_BMS02 : 53|2@0+ (1,0) [0|0] ""  PT
 SG_ DEM287_CUS_CURRENT_DCHG_BMS02 : 55|2@0+ (1,0) [0|0] ""  PT

BO_ 1601 SC02_DebugSlowMpex: 8 SC02
 SG_ FeeInitStatus_SC02 m43 : 23|16@0+ (1,0) [0|65535] ""  PT
 SG_ pressureFiltered_SC02 m22 : 47|8@0+ (0.4,0) [0|102] "psi"  PT
 SG_ shunt2IntegralAs_SC02 m46 : 23|32@0- (1,0) [-2147483648|2147483647] "As"  PT
 SG_ shunt1IntegralAs_SC02 m45 : 31|32@0- (1,0) [-2147483648|2147483647] "As"  PT
 SG_ selfTestStartupFault_SC02 m22 : 39|8@0+ (1,0) [0|255] ""  PT
 SG_ sbcARTimerStatus_SC02 m45 : 11|4@0+ (1,0) [0|15] ""  PT
 SG_ sbcARTimerValue_SC02 m45 : 23|8@0+ (1,0) [0|255] "s"  PT
 SG_ ESM_EFUSE_SAFETY_CHECK_FAIL_SC02 m21 : 41|1@0+ (1,0) [0|0] ""  PT
 SG_ ESM_EFUSE_SINGLEBIT_ERROR_SC02 m21 : 42|1@0+ (1,0) [0|0] ""  PT
 SG_ cmbVAIndex_SC02 m44 : 31|8@0+ (1,0) [0|0] ""  PT
 SG_ minVACMB_SC02 m44 : 39|16@0+ (0.0001,0) [0|6.5] "V"  PT
 SG_ maxVACMB_SC02 m44 : 55|16@0+ (0.0001,0) [0|6.5] "V"  PT
 SG_ pumpInternalFaultError_SC02 m23 : 16|1@0+ (1,0) [0|0] ""  PT
 SG_ pumpShortCircuitError_SC02 m23 : 17|1@0+ (1,0) [0|0] ""  PT
 SG_ pumpElectricError_SC02 m23 : 19|2@0+ (1,0) [0|0] ""  PT
 SG_ pumpPostRunMode_SC02 m23 : 22|3@0+ (1,0) [0|0] ""  PT
 SG_ pumpRsError_SC02 m23 : 23|1@0+ (1,0) [0|0] ""  PT
 SG_ pumpWakeUpStatus_SC02 m23 : 25|2@0+ (1,0) [0|0] ""  PT
 SG_ pumpRpmMonStat_SC02 m23 : 27|2@0+ (1,0) [0|0] ""  PT
 SG_ pumpPwmInStat_SC02 m23 : 29|2@0+ (1,0) [0|0] ""  PT
 SG_ pumpDiagTriggered_SC02 m23 : 30|1@0+ (1,0) [0|0] ""  PT
 SG_ pumpHwFault_SC02 m23 : 31|1@0+ (1,0) [0|0] ""  PT
 SG_ pumpPumpState_SC02 m23 : 34|3@0+ (1,0) [0|0] ""  PT
 SG_ pumpBlockError_SC02 m23 : 36|2@0+ (1,0) [0|0] ""  PT
 SG_ pumpLinError_SC02 m23 : 37|1@0+ (1,0) [0|0] ""  PT
 SG_ pumpDryRun_SC02 m23 : 39|2@0+ (1,0) [0|0] ""  PT
 SG_ pumpOverCurrent_SC02 m23 : 41|2@0+ (1,0) [0|0] ""  PT
 SG_ pumpVoltageDeratingError_SC02 m23 : 42|1@0+ (1,0) [0|0] ""  PT
 SG_ pumpSupVoltageError_SC02 m23 : 44|2@0+ (1,0) [0|0] ""  PT
 SG_ pumpUnderVoltage_SC02 m23 : 45|1@0+ (1,0) [0|0] ""  PT
 SG_ pumpOverVoltage_SC02 m23 : 46|1@0+ (1,0) [0|0] ""  PT
 SG_ pumpTempProtect_SC02 m23 : 47|1@0+ (1,0) [0|0] ""  PT
 SG_ pumpOverTempDeratingErr_SC02 m23 : 48|1@0+ (1,0) [0|0] ""  PT
 SG_ pumpOverTemperature_SC02 m23 : 50|2@0+ (1,0) [0|0] ""  PT
 SG_ cmbSM30MinSettleTime_SC02 m44 : 15|16@0+ (1,0) [0|65535] "ms"  PT
 SG_ cmbSM30SettleTimeFault_SC02 m32 : 42|1@0+ (1,0) [0|1] ""  PT
 SG_ pressure2_SC02 m22 : 15|8@0+ (0.4,0) [0|102] "psi"  PT
 SG_ cmbSM29ScoutTempIndex_SC02 m42 : 15|8@0+ (1,0) [0|255] ""  PT
 SG_ cmbSM19ScoutPDO_SC02 m42 : 55|16@0+ (0.0001,0) [0|6.5] "V"  PT
 SG_ cmbMaxSM15ratio_SC02 m41 : 39|16@0+ (0.00390625,0) [0|255.99609375] ""  PT
 SG_ cmbMinSM15ratio_SC02 m41 : 55|16@0+ (0.00390625,0) [0|255.99609375] ""  PT
 SG_ cmbMinSM17Ratio m42 : 39|16@0+ (0.00390625,0) [0|255.99609375] ""  PT
 SG_ cmbMaxSM17Ratio m42 : 23|16@0+ (0.00390625,0) [0|255.99609375] ""  PT
 SG_ cmbMaxSM16DiffC2S_SC02 m41 : 23|16@0+ (0.2,0) [0|13107] "mV"  PT
 SG_ isolationResInternRelaxed_SC02 m32 : 23|16@0+ (2,0) [0|130000] "kOhm"  PT
 SG_ pressureSensH2Concentr_SC02 m40 : 55|16@0+ (0.0025,0) [0|163.8375] "% H2"  PT
 SG_ pressureSensIntakePres_SC02 m40 : 39|16@0+ (0.0078125,-250) [-250|251.99] "kPa"  PT
 SG_ pressureSensIntakeTemp_SC02 m40 : 23|16@0+ (0.03125,-273) [-273|1734.96875] "C"  PT
 SG_ pressureSensRelHumidity_SC02 m40 : 15|8@0+ (0.4,0) [0|100] "%"  PT
 SG_ isolationSelftestMaxDiff_SC02 m32 : 39|8@0+ (0.1,0) [0|25.5] "V"  PT
 SG_ FEESector2Flags_SC02 m22 : 23|16@0+ (1,0) [0|0] ""  PT
 SG_ appTask500HzMaxAvg_SC02 m41 : 15|8@0+ (0.02,0) [0|5.1] "ms"  PT
 SG_ safetyHangLastLinkReg_SC02 m39 : 23|32@0+ (1,0) [0|4294967295] ""  PT
 SG_ safetyHangPresentLinkReg_SC02 m38 : 23|32@0+ (1,0) [0|4294967295] ""  PT
 SG_ safetyHangDataFaultStatus_SC02 m37 : 23|32@0+ (1,0) [0|4294967295] ""  PT
 SG_ safetyHangDataFaultAddr_SC02 m36 : 23|32@0+ (1,0) [0|4294967295] ""  PT
 SG_ safetyHangLastARMMode_SC02 m35 : 63|8@0+ (1,0) [0|255] ""  PT
 SG_ safetyHangPresARMMode_SC02 m35 : 55|8@0+ (1,0) [0|255] ""  PT
 SG_ safetyHangESMGrp3Reg_SC02 m35 : 23|32@0+ (1,0) [0|4294967295] ""  PT
 SG_ safetyHangInstrFaultStatus_SC02 m34 : 23|32@0+ (1,0) [0|4294967295] ""  PT
 SG_ safetyHangInstrFaultAddr_SC02 m33 : 23|32@0+ (1,0) [0|4294967295] ""  PT
 SG_ pressure_SC02 m4 : 63|8@0+ (0.4,0) [0|102] "psi"  PT
 SG_ cmbMaxSM33Diff_SC02 m31 : 15|8@0+ (0.001,0) [0|0.255] "V"  PT
 SG_ cmbMinSM29Diff_SC02 m17 : 15|8@0+ (0.001,0) [0|0.255] "V"  PT
 SG_ cmbSM4MinIndex_SC02 m24 : 15|8@0+ (1,0) [0|0] ""  PT
 SG_ cmbSM4DiffC2_SC02 m31 : 23|16@0+ (0.0001,0) [0|6.5] "V"  PT
 SG_ cmbMinSM4Diff_SC02 m31 : 39|16@0+ (0.0001,0) [0|6.5] "V"  PT
 SG_ cmbMaxSM4Diff_SC02 m21 : 55|16@0+ (0.0001,0) [0|6.5] "V"  PT
 SG_ cmbSM27MinIndex_SC02 m15 : 63|8@0+ (1,0) [0|0] ""  PT
 SG_ cmbSM27DiffC2_SC02 m24 : 55|16@0+ (0.0001,0) [0|6.5] "V"  PT
 SG_ cmbMinSM27Diff_SC02 m31 : 55|16@0+ (0.0001,0) [0|6.5] "V"  PT
 SG_ cmbMaxSM27Diff_SC02 m25 : 55|16@0+ (0.0001,0) [0|6.5] "V"  PT
 SG_ adcDriverFail_SC02 m4 : 51|4@0+ (1,0) [0|0] ""  PT
 SG_ mainUcHvilState_SC02 m32 : 41|2@0+ (1,0) [0|0] ""  PT
 SG_ mainUcIntIsoErr_SC02 m32 : 13|2@0+ (1,0) [0|0] ""  PT
 SG_ mainUcExtIsoErr_SC02 m32 : 15|2@0+ (1,0) [0|0] ""  PT
 SG_ safetyUcThermalStatus_SC02 m32 : 9|2@0+ (1,0) [0|0] ""  PT
 SG_ mainUcThermalStatus_SC02 m32 : 11|2@0+ (1,0) [0|0] ""  PT
 SG_ selfTestErrorAddress_SC02 m30 : 23|32@0+ (1,0) [0|4294967295] ""  PT
 SG_ selfTestDataFaultStatus_SC02 m29 : 23|32@0+ (1,0) [0|4294967295] ""  PT
 SG_ selfTestInstrFaultAddr_SC02 m28 : 23|32@0+ (1,0) [0|4294967295] ""  PT
 SG_ selfTestDataFaultAddr_SC02 m27 : 23|32@0+ (1,0) [0|4294967295] ""  PT
 SG_ selfTestInstrFaultStatus_SC02 m26 : 23|32@0+ (1,0) [0|4294967295] ""  PT
 SG_ internalIsolationError_SC02 m25 : 11|2@0+ (1,0) [0|0] ""  PT
 SG_ externalIsolationError_SC02 m25 : 13|2@0+ (1,0) [0|0] ""  PT
 SG_ isolationTestState_SC02 m25 : 9|2@0+ (1,0) [0|0] ""  PT
 SG_ isolationResistanceIntern_SC02 m25 : 23|16@0+ (2,0) [0|130000] "kOhm"  PT
 SG_ isolationResistanceExtern_SC02 m25 : 39|16@0+ (2,0) [0|130000] "kOhm"  PT
 SG_ maxAdolV13Diff_SC02 m24 : 23|16@0+ (0.0001,0) [0|6.5] "V"  PT
 SG_ maxAdolV7Diff_SC02 m24 : 39|16@0+ (0.0001,0) [0|6.5] "V"  PT
 SG_ pumpType_SC02 m23 : 15|8@0+ (1,0) [0|0] ""  PT
 SG_ pumpPhaseCurrent_SC02 m18 : 47|8@0+ (0.1,0) [0|0] "A"  PT
 SG_ hvWithstandTestQual_SC02 m21 : 15|8@0+ (1,0) [0|255] ""  PT
 SG_ ESM_RAM_ODD_ADDR_UNCORR_SC02 m21 : 18|1@0+ (1,0) [0|0] ""  PT
 SG_ ESM_RAM_EVEN_ADDR_UNCORR_SC02 m21 : 17|1@0+ (1,0) [0|0] ""  PT
 SG_ ESM_FMC_UNCORR_ERR_SC02 m21 : 40|1@0+ (1,0) [0|0] ""  PT
 SG_ ESM_RAM_ODDECC_UNCORR_SC02 m21 : 23|1@0+ (1,0) [0|0] ""  PT
 SG_ ESM_RAM_EVENECC_UNCORR_SC02 m21 : 22|1@0+ (1,0) [0|0] ""  PT
 SG_ ESM_EFUSE_FARM_ERR_SC02 m21 : 21|1@0+ (1,0) [0|0] ""  PT
 SG_ ESM_RTI_WWD_NMI_SC02 m21 : 20|1@0+ (1,0) [0|0] ""  PT
 SG_ ESM_TCM_ECC_LIVE_LOCK_SC02 m21 : 19|1@0+ (1,0) [0|0] ""  PT
 SG_ ESM_RAM_ODD_UNCORR_ERR_SC02 m21 : 16|1@0+ (1,0) [0|0] ""  PT
 SG_ ESM_RAM_EVEN_UNCORR_ERR_SC02 m21 : 31|1@0+ (1,0) [0|0] ""  PT
 SG_ ESM_FMC_ADDR_UNCORR_ERR_SC02 m21 : 30|1@0+ (1,0) [0|0] ""  PT
 SG_ ESM_CCM4_COMPARE_FAULT_SC02 m21 : 29|1@0+ (1,0) [0|0] ""  PT
 SG_ ESM_RAM_ODD_CORR_ERR_SC02 m21 : 28|1@0+ (1,0) [0|0] ""  PT
 SG_ ESM_RAM_EVEN_CORR_ERR_SC02 m21 : 27|1@0+ (1,0) [0|0] ""  PT
 SG_ ESM_CLK_MONITOR_SC02 m21 : 26|1@0+ (1,0) [0|0] ""  PT
 SG_ ESM_PLL_SLIP_SC02 m21 : 25|1@0+ (1,0) [0|0] ""  PT
 SG_ ESM_FMC_CORR_ERR_SC02 m21 : 24|1@0+ (1,0) [0|0] ""  PT
 SG_ analogMMCUSleepTrigger_SC02 m20 : 55|8@0+ (0.015,0) [0|0] "V"  PT
 SG_ analogPyroLSDStatus_SC02 m20 : 63|8@0+ (0.015,0) [0|0] "V"  PT
 SG_ analogGPIO2Volt_SC02 m19 : 47|8@0+ (0.1,0) [0|25] "V"  PT
 SG_ analogGPIO2Current_SC02 m19 : 55|8@0+ (0.015,0) [0|3.825] "A"  PT
 SG_ analogGPIO1Volt_SC02 m19 : 63|8@0+ (0.1,0) [0|25] "V"  PT
 SG_ analogGPIO1Current_SC02 m20 : 15|8@0+ (0.015,0) [0|3.825] "A"  PT
 SG_ currentModuleMax_SC02 m1 : 55|16@0+ (0.1,-3200) [-3200|3200] "A"  PT
 SG_ currentModuleMin_SC02 m1 : 39|16@0+ (0.1,-3200) [-3200|3200] "A"  PT
 SG_ cmbSumOfCellSTATRef_SC02 m20 : 39|16@0+ (0.0015,0) [0|131.07] "V"  PT
 SG_ cmbSumOfCells_SC02 m20 : 23|16@0+ (0.0015,0) [0|131.07] "V"  PT
 SG_ maxCMBDieTemp_SC02 m1 : 31|8@0+ (1,-40) [-40|200] "C"  PT
 SG_ minCMBDieTemp_SC02 m1 : 23|8@0+ (1,-40) [-40|200] "C"  PT
 SG_ appTaskSpiRxTx_SC02 m16 : 15|8@0+ (0.02,0) [0|5.1] "ms"  PT
 SG_ variantCodingCounts_SC02 m4 : 39|8@0+ (1,0) [0|0] ""  PT
 SG_ cmbMaxUpdateTime_SC02 m17 : 23|8@0+ (2,0) [0|500] "ms"  PT
 SG_ pumpSetSpeed_SC02 m18 : 55|8@0+ (1,0) [0|255] "PCT"  PT
 SG_ hvilResistance_SC02 m17 : 31|8@0+ (2,0) [0|0] "Ohm"  PT
 SG_ cmbAvgUpdateTime_SC02 m18 : 63|8@0+ (2,0) [0|500] "ms"  PT
 SG_ pumpTemperature_SC02 m18 : 39|8@0+ (1,-50) [0|0] "C"  PT
 SG_ pumpSpeed_SC02 m18 : 15|8@0+ (1,0) [0|255] "PCT"  PT
 SG_ pumpVoltage_SC02 m18 : 23|8@0+ (0.1,0) [0|0] "V"  PT
 SG_ pumpCurrent_SC02 m18 : 31|8@0+ (0.1,0) [0|0] "A"  PT
 SG_ posLink3_SC02 m17 : 39|16@0+ (0.04,-1250) [-1250|1371.4] "V"  PT
 SG_ negLink3_SC02 m17 : 55|16@0+ (0.04,-1250) [-1250|1371.4] "V"  PT
 SG_ posLink2_SC02 m16 : 39|16@0+ (0.04,-1250) [-1250|1371.4] "V"  PT
 SG_ negLink2_SC02 m16 : 55|16@0+ (0.04,-1250) [-1250|1371.4] "V"  PT
 SG_ cmbNrOfSamples_SC02 m16 : 23|8@0+ (1,0) [0|0] ""  PT
 SG_ cmbTaskTime_SC02 m16 : 31|8@0+ (1,0) [0|0] "ms"  PT
 SG_ appTask500HzMax_SC02 m15 : 15|8@0+ (0.02,0) [0|5.1] "ms"  PT
 SG_ moduleCount_SC02 m6 : 15|8@0+ (1,0) [0|0] ""  PT
 SG_ analogHallSense_SC02 m15 : 23|16@0+ (0.0001,0) [0|6.5535] "V"  PT
 SG_ cmbMaxDiagStepPeriodicity_SC02 m15 : 55|8@0+ (4,0) [0|1019] "ms"  PT
 SG_ minBrickVoltageLimit_SC02 m15 : 39|16@0+ (0.0001,0) [0|6.5535] "V"  PT
 SG_ appTask100Hz_SC02 m14 : 63|8@0+ (0.02,0) [0|5.1] "ms"  PT
 SG_ appTask10Hz_SC02 m14 : 55|8@0+ (0.02,0) [0|5.1] "ms"  PT
 SG_ appTaskAnalog_SC02 m14 : 47|8@0+ (0.02,0) [0|5.1] "ms"  PT
 SG_ appTaskADC_SC02 m14 : 39|8@0+ (0.02,0) [0|5.1] "ms"  PT
 SG_ appTask500HzAvg_SC02 m14 : 31|8@0+ (0.02,0) [0|5.1] "ms"  PT
 SG_ appTaskSBC_SC02 m14 : 23|8@0+ (0.02,0) [0|5.1] "ms"  PT
 SG_ appTaskCMBDriver_SC02 m14 : 15|8@0+ (0.02,0) [0|5.1] "ms"  PT
 SG_ safetyInitTime_SC02 m12 : 15|8@0+ (2,0) [0|500] "ms"  PT
 SG_ debugSlowMpex_SC02 M : 7|8@0+ (1,0) [0|0] ""  PT
 SG_ sbcWUAuto_SC02 m11 : 9|1@0+ (1,0) [0|0] ""  PT
 SG_ sbcWUUnknown_SC02 m11 : 8|1@0+ (1,0) [0|0] ""  PT
 SG_ sbcWUDebug_SC02 m11 : 10|1@0+ (1,0) [0|0] ""  PT
 SG_ sbcWUPOR_SC02 m11 : 11|1@0+ (1,0) [0|0] ""  PT
 SG_ sbcWUPressure_SC02 m11 : 12|1@0+ (1,0) [0|0] ""  PT
 SG_ sbcWUClock_SC02 m11 : 13|1@0+ (1,0) [0|0] ""  PT
 SG_ sbcWUCAN_SC02 m11 : 14|1@0+ (1,0) [0|0] ""  PT
 SG_ sbcWUKey_SC02 m11 : 15|1@0+ (1,0) [0|0] ""  PT
 SG_ mux960N3VRef_SC02 m13 : 39|16@0+ (-0.000805664,0) [0|0] "V"  PT
 SG_ mux960P2P5VRef_SC02 m13 : 55|16@0+ (0.000805664,0) [0|0] "V"  PT
 SG_ mux440Gnd_SC02 m10 : 15|8@0+ (0.000805664,0) [0|0] "V"  PT
 SG_ analogHallGain_SC02 m13 : 23|16@0+ (1E-005,0.8) [0.8|1.455] "k"  PT
 SG_ analogHallOffset_SC02 m13 : 15|8@0+ (0.0001,-0.005) [-0.005|0.0205] "V"  PT
 SG_ negPackPrime_SC02 m12 : 55|16@0+ (0.04,-1250) [-1250|1250] "V"  PT
 SG_ posPackPrime_SC02 m12 : 39|16@0+ (0.04,-1250) [-1250|1250] "V"  PT
 SG_ packVoltage_SC02 m12 : 23|16@0+ (0.04,-1250) [-1250|1250] "V"  PT
 SG_ sleepTime_SC02 m11 : 23|16@0+ (1,0) [0|0] "s"  PT
 SG_ analogNegHVOffset_SC02 m10 : 63|8@0+ (1,-120) [-120|120] "Bits"  PT
 SG_ analogPosHVOffset_SC02 m10 : 55|8@0+ (1,-120) [-120|120] "Bits"  PT
 SG_ analogNegHVGain_SC02 m10 : 39|16@0+ (1E-005,0.8) [0|0] "k"  PT
 SG_ analogPosHVGain_SC02 m10 : 23|16@0+ (1E-005,0.8) [0.8|1.45535] "k"  PT
 SG_ mux910Gnd_SC02 m8 : 15|8@0+ (0.000805664,0) [0|0] "V"  PT
 SG_ mux960Gnd_SC02 m9 : 15|8@0+ (0.000805664,0) [0|0] "V"  PT
 SG_ analogAddr5_SC02 m9 : 55|16@0+ (0.000805861,0) [0|0] "V"  PT
 SG_ analogAddr4_SC02 m9 : 39|16@0+ (0.000805861,0) [0|0] "V"  PT
 SG_ analogAddr3_SC02 m9 : 23|16@0+ (0.000805861,0) [0|0] "V"  PT
 SG_ analogAddr2_SC02 m8 : 55|16@0+ (0.000805861,0) [0|0] "V"  PT
 SG_ analogAddr1_SC02 m8 : 39|16@0+ (0.000805861,0) [0|0] "V"  PT
 SG_ analogAddr0_SC02 m8 : 23|16@0+ (0.000805861,0) [0|0] "V"  PT
 SG_ sbcVREF2P5_SC02 m7 : 15|8@0+ (0.003222656,2.25) [2.25|3.0715] "V"  PT
 SG_ mux910N3VRef_SC02 m7 : 39|16@0+ (-0.000805664,0) [0|0] "V"  PT
 SG_ mux910P2P5VRef_SC02 m7 : 55|16@0+ (0.000805664,0) [0|0] "V"  PT
 SG_ analogHvilCurrentPWM_SC02 m3 : 31|8@0+ (1,0) [0|255] "mA"  PT
 SG_ analogSBCSupply_SC02 m4 : 47|8@0+ (0.1,0) [0|25] "V"  PT
 SG_ analogHvilCurrent_SC02 m3 : 23|8@0+ (1,0) [0|255] "mA"  PT
 SG_ analogPressureSense_SC02 m4 : 23|8@0+ (0.025,0) [0|6.375] "V"  PT
 SG_ analog5VSensorSupply_SC02 m4 : 15|8@0+ (0.025,0) [0|6.375] "V"  PT
 SG_ analogPrechgRel2CoilMinus_SC02 m2 : 23|8@0+ (0.2,0) [0|51] "V"  PT
 SG_ analogPrechgRel1CoilMinus_SC02 m3 : 55|8@0+ (0.2,0) [0|51] "V"  PT
 SG_ analogNegCntr3CoilMinus_SC02 m2 : 31|8@0+ (0.2,0) [0|51] "V"  PT
 SG_ analogNegCntr2CoilMinus_SC02 m2 : 39|8@0+ (0.2,0) [0|51] "V"  PT
 SG_ analogNegCntr1CoilMinus_SC02 m2 : 47|8@0+ (0.2,0) [0|51] "V"  PT
 SG_ analogPosCntr3CoilMinus_SC02 m2 : 55|8@0+ (0.2,0) [0|51] "V"  PT
 SG_ analogPosCntr2CoilMinus_SC02 m2 : 63|8@0+ (0.2,0) [0|51] "V"  PT
 SG_ analogPosCntr1CoilMinus_SC02 m3 : 15|8@0+ (0.2,0) [0|51] "V"  PT
 SG_ minModuleTemperature_SC02 m1 : 15|8@0+ (1,-40) [-40|200] "C"  PT
 SG_ maxModuleTemperature_SC02 m2 : 15|8@0+ (1,-40) [-40|200] "C"  PT
 SG_ analogHvilReturn_SC02 m3 : 39|8@0+ (0.1,0) [0|25] "V"  PT
 SG_ analog5VDSupply_SC02 m3 : 47|8@0+ (0.025,0) [0|6.375] "V"  PT
 SG_ analogHvilOut_SC02 m3 : 63|8@0+ (0.1,0) [0|25] "V"  PT
 SG_ analogCurrentSensor12V_SC02 m4 : 31|8@0+ (0.075,0) [0|19] "V"  PT
 SG_ cmbErrorCounter_SC02 m6 : 47|8@0+ (1,0) [0|255] ""  PT
 SG_ PECErrorCounter_SC02 m6 : 39|8@0+ (1,0) [0|255] ""  PT
 SG_ maxVREF2_SC02 m7 : 23|16@0+ (0.0001,0) [0|6.5] "V"  PT
 SG_ minVREF2_SC02 m6 : 55|16@0+ (0.0001,0) [0|6.5] "V"  PT
 SG_ currentPlausiCounter_SC02 m5 : 15|8@0+ (1,0) [0|0] ""  PT
 SG_ hallCurrentOffset_SC02 m5 : 39|16@0+ (0.001,-30) [-30|30] "A"  PT
 SG_ sumOfCurrentsFiltered_SC02 m5 : 23|16@0+ (0.1,-3200) [-3200|3353.5] "A"  PT
 SG_ hallCurrentAveraged_SC02 m5 : 55|16@0+ (0.1,-3200) [-3200|3200] "A"  PT
 SG_ analogHallSupply_SC02 m6 : 23|16@0+ (0.0005,0) [0|32.7675] "V"  PT
 SG_ SWVersion_SC02 m11 : 39|32@0+ (1,0) [0|4294967295] ""  PT
 SG_ contactorControlPos1_SC02 m19 : 23|4@0+ (1,0) [0|7] ""  PT
 SG_ contactorControlNeg1_SC02 m19 : 19|4@0+ (1,0) [0|7] ""  PT
 SG_ contactorControlPre1_SC02 m19 : 11|4@0+ (1,0) [0|7] ""  PT
 SG_ contactorControlPos2_SC02 m19 : 31|4@0+ (1,0) [0|7] ""  PT
 SG_ contactorControlNeg2_SC02 m19 : 27|4@0+ (1,0) [0|7] ""  PT
 SG_ contactorControlPre2_SC02 m19 : 15|4@0+ (1,0) [0|7] ""  PT
 SG_ contactorControlPos3_SC02 m19 : 39|4@0+ (1,0) [0|7] ""  PT
 SG_ contactorControlNeg3_SC02 m19 : 35|4@0+ (1,0) [0|7] ""  PT

BO_ 1665 SC02_DebugFastMpex: 8 SC02
 SG_ selfTestFaultCntrCtrl_SC02 m11 : 23|8@0+ (1,0) [0|0] ""  PT
 SG_ cmbASICFault_SC02 m11 : 15|8@0+ (1,0) [0|0] ""  PT
 SG_ DIGIO_PYRO_LSD_EN_SC02 m2 : 12|1@0+ (1,0) [0|0] ""  PT
 SG_ mainUcExtIsoResistance_SC02 m10 : 55|16@0+ (1,0) [0|0] "KOhm"  PT
 SG_ BMS_C38_AR2MsgFault_SC02 m10 : 47|2@0+ (1,0) [0|0] ""  PT
 SG_ stateCoolant_SC02 m10 : 45|1@0+ (1,0) [0|0] ""  PT
 SG_ stateThermalEvent_SC02 m10 : 44|1@0+ (1,0) [0|0] ""  PT
 SG_ stateCANTx_SC02 m10 : 43|1@0+ (1,0) [0|0] ""  PT
 SG_ CANTxFaultTriggerFailed_SC02 m10 : 42|1@0+ (1,0) [0|0] ""  PT
 SG_ CANTxBMS1ST3MsgFault_SC02 m10 : 10|1@0+ (1,0) [0|0] ""  PT
 SG_ CANTxBMSDispReqMsgFault_SC02 m10 : 9|1@0+ (1,0) [0|0] ""  PT
 SG_ CANTxHVBatMsgFault_SC02 m10 : 8|1@0+ (1,0) [0|0] ""  PT
 SG_ mainUcCntrCtrlReq_SC02 m10 : 41|2@0+ (1,0) [0|0] ""  PT
 SG_ mainUcCntrWeldState_SC02 m10 : 39|4@0+ (1,0) [0|0] ""  PT
 SG_ safetyUcCntrState_SC02 m10 : 33|2@0+ (1,0) [0|0] ""  PT
 SG_ mainUcCntrState_SC02 m10 : 35|2@0+ (1,0) [0|0] ""  PT
 SG_ safetyCANMsg4Fault_SC02 m10 : 31|4@0+ (1,0) [0|0] ""  PT
 SG_ safetyCANMsg3Fault_SC02 m10 : 27|4@0+ (1,0) [0|0] ""  PT
 SG_ safetyCANMsg2Fault_SC02 m10 : 23|4@0+ (1,0) [0|0] ""  PT
 SG_ safetyCANMsg1Fault_SC02 m10 : 19|4@0+ (1,0) [0|0] ""  PT
 SG_ cmbBalancingDesired_SC02 m10 : 15|1@0+ (1,0) [0|0] ""  PT
 SG_ DIGIO_GPIO1_ON_SC02 m2 : 10|1@0+ (1,0) [0|0] ""  PT
 SG_ DIGIO_ZDW_LSD_EN_SC02 m2 : 11|1@0+ (1,0) [0|0] ""  PT
 SG_ currentShortCircuit_SC02 m2 : 9|1@0+ (1,0) [0|0] ""  PT
 SG_ contactorCntrSelfTest_SC02 m10 : 14|4@0+ (1,0) [0|15] ""  PT
 SG_ maxBrickVoltage_SC02 m11 : 39|16@0+ (0.0001,0) [0|6.5] "V"  PT
 SG_ minBrickVoltage_SC02 m11 : 55|16@0+ (0.0001,0) [0|6.5] "V"  PT
 SG_ cmbLastUpdateTime_SC02 m0 : 55|8@0+ (2,0) [0|500] "ms"  PT
 SG_ weldCheckState_SC02 m2 : 15|3@0+ (1,0) [0|0] ""  PT
 SG_ debugFastMpex_SC02 M : 7|8@0+ (1,0) [0|0] ""  PT
 SG_ SPIRxTxTimeAllPckts_SC02 m0 : 63|8@0+ (2,0) [0|500] "ms"  PT
 SG_ sleepRqASW_SC02 m2 : 8|1@0+ (1,0) [0|0] ""  PT
 SG_ prechgCtr1OnReqASW_SC02 m1 : 27|1@0+ (1,0) [0|0] ""  PT
 SG_ negCtr1OnReqASW_SC02 m1 : 25|1@0+ (1,0) [0|0] ""  PT
 SG_ posCtr1OnReqASW_SC02 m1 : 26|1@0+ (1,0) [0|0] ""  PT
 SG_ key_SC02 m1 : 24|1@0+ (1,0) [0|0] ""  PT
 SG_ stateContactorControl_SC02 m0 : 41|1@0+ (1,0) [0|0] ""  PT
 SG_ DIGIO_MULTIPLEX_m101_S3_SC02 m0 : 40|1@0+ (1,0) [0|0] ""  PT
 SG_ analogCntrPwrPlus_SC02 m1 : 15|8@0+ (0.2,0) [0|50] "V"  PT
 SG_ weldedState_SC02 m11 : 25|2@0+ (1,0) [0|3] ""  PT
 SG_ stateVoltage_SC02 m0 : 43|1@0+ (1,0) [0|0] ""  PT
 SG_ stateTemperature_SC02 m0 : 44|1@0+ (1,0) [0|0] ""  PT
 SG_ stateSelfTest_SC02 m0 : 45|1@0+ (1,0) [0|0] ""  PT
 SG_ stateHVIL_SC02 m0 : 46|1@0+ (1,0) [0|0] ""  PT
 SG_ stateCurrent_SC02 m0 : 47|1@0+ (1,0) [0|0] ""  PT
 SG_ stateCrash2_SC02 m0 : 36|1@0+ (1,0) [0|0] ""  PT
 SG_ stateCrash1_SC02 m0 : 37|1@0+ (1,0) [0|0] ""  PT
 SG_ stateContactors_SC02 m0 : 38|1@0+ (1,0) [0|0] ""  PT
 SG_ stateCANRx_SC02 m0 : 39|1@0+ (1,0) [0|0] ""  PT
 SG_ itemState_SC02 m0 : 35|4@0+ (1,0) [0|0] ""  PT
 SG_ DIGIO_SAFETY_GPIO0_SC02 m0 : 8|1@0+ (1,0) [0|0] ""  PT
 SG_ DIGIO_SC_LED501_CONTROL_SC02 m0 : 9|1@0+ (1,0) [0|0] ""  PT
 SG_ DIGIO_LNK_ISO_TST_SW_SC02 m0 : 10|1@0+ (1,0) [0|0] ""  PT
 SG_ DIGIO_SC_LED500_CONTROL_SC02 m0 : 11|1@0+ (1,0) [0|0] ""  PT
 SG_ DIGIO_POS_CNTR1_ON_SC02 m0 : 12|1@0+ (1,0) [0|0] ""  PT
 SG_ DIGIO_NEG_CNTR3_ON_SC02 m0 : 13|1@0+ (1,0) [0|0] ""  PT
 SG_ DIGIO_PRECHG_REL2_ON_SC02 m0 : 14|1@0+ (1,0) [0|0] ""  PT
 SG_ DIGIO_NEG_ISO_TEST_SW_SC02 m0 : 15|1@0+ (1,0) [0|0] ""  PT
 SG_ DIGIO_PRECHG_REL1_ON_SC02 m0 : 16|1@0+ (1,0) [0|0] ""  PT
 SG_ DIGIO_POS_ISO_TEST_SC02 m0 : 17|1@0+ (1,0) [0|0] ""  PT
 SG_ DIGIO_HVIL_PWM_SC02 m0 : 18|1@0+ (1,0) [0|0] ""  PT
 SG_ DIGIO_CNTR_HISIDE_ON_SC_SC02 m0 : 19|1@0+ (1,0) [0|0] ""  PT
 SG_ DIGIO_CRASH_DETECT_SC02 m0 : 20|1@0+ (1,0) [0|0] ""  PT
 SG_ DIGIO_NEG_CNTR2_ON_SC02 m0 : 21|1@0+ (1,0) [0|0] ""  PT
 SG_ DIGIO_NEG_CNTR1_ON_SC02 m0 : 22|1@0+ (1,0) [0|0] ""  PT
 SG_ DIGIO_POS_CNTR3_ON_SC02 m0 : 23|1@0+ (1,0) [0|0] ""  PT
 SG_ DIGIO_POS_CNTR2_ON_SC02 m0 : 24|1@0+ (1,0) [0|0] ""  PT
 SG_ DIGIO_MULTIPLEX_m101_S2_SC02 m0 : 25|1@0+ (1,0) [0|0] ""  PT
 SG_ DIGIO_MULTIPLEX_8TO1_S1_SC02 m0 : 26|1@0+ (1,0) [0|0] ""  PT
 SG_ DIGIO_CNTR_CLOSE_OK_CHCKD_SC02 m0 : 27|1@0+ (1,0) [0|0] ""  PT
 SG_ DIGIO_MULTIPLEX_8TO1_S2_SC02 m0 : 28|1@0+ (1,0) [0|0] ""  PT
 SG_ DIGIO_CNTR_CLOSE_OK_SC02 m0 : 29|1@0+ (1,0) [0|0] ""  PT
 SG_ DIGIO_MULTIPLEX_m101_S1_SC02 m0 : 30|1@0+ (1,0) [0|0] ""  PT
 SG_ DIGIO_CNTR_HISIDE_ON_CHCKD_SC02 m0 : 31|1@0+ (1,0) [0|0] ""  PT
 SG_ posPack_SC02 m2 : 23|16@0+ (0.04,-1250) [-1250|1250] "V"  PT
 SG_ posLink_SC02 m2 : 55|16@0+ (0.04,-1250) [-1250|1371.4] "V"  PT
 SG_ negPack_SC02 m2 : 39|16@0+ (0.04,-1250) [-1250|1250] "V"  PT
 SG_ negLink_SC02 m1 : 39|16@0+ (0.04,-1250) [-1250|1371.4] "V"  PT
 SG_ hallCurrent_SC02 m1 : 23|12@0+ (0.6,-1200) [-1200|1257] "A"  PT
 SG_ analogCntrPwrPlusISense_SC02 m1 : 63|8@0+ (0.05,0) [0|12.5] "A"  PT
 SG_ analogCntrPwrPlusSwitched_SC02 m1 : 55|8@0+ (0.2,0) [0|50] "V"  PT
 SG_ BIT_ANALOG_REF_FAIL_SC02 m3 : 8|1@0+ (1,0) [0|0] ""  PT
 SG_ BIT_ANALOG_ADCDRIVER_FAIL_SC02 m3 : 9|1@0+ (1,0) [0|0] ""  PT
 SG_ BIT_ANALOG_MUX910_HW_SC02 m3 : 10|1@0+ (1,0) [0|0] ""  PT
 SG_ BIT_ANALOG_MUX960_HW_SC02 m3 : 11|1@0+ (1,0) [0|0] ""  PT
 SG_ BIT_ANALOG_MUX301_HW_SC02 m3 : 12|1@0+ (1,0) [0|0] ""  PT
 SG_ BIT_ANALOG_MUX440_HW_SC02 m3 : 13|1@0+ (1,0) [0|0] ""  PT
 SG_ BIT_ANALOG_5VA_FAIL_SC02 m3 : 14|1@0+ (1,0) [0|0] ""  PT
 SG_ BIT_ANALOG_HV_SIGN_SC02 m3 : 15|1@0+ (1,0) [0|0] ""  PT
 SG_ BIT_CAN_ISENSE01_MIA_SC02 m3 : 24|1@0+ (1,0) [0|0] ""  PT
 SG_ BIT_CAN_ISENSE02_MIA_SC02 m3 : 25|1@0+ (1,0) [0|0] ""  PT
 SG_ BIT_CAN_ISENSE03_MIA_SC02 m3 : 26|1@0+ (1,0) [0|0] ""  PT
 SG_ BIT_CAN_ISENSE04_MIA_SC02 m3 : 27|1@0+ (1,0) [0|0] ""  PT
 SG_ BIT_CAN_ISENSE05_MIA_SC02 m3 : 28|1@0+ (1,0) [0|0] ""  PT
 SG_ BIT_CAN_PT_MIA_SC02 m3 : 29|1@0+ (1,0) [0|0] ""  PT
 SG_ BIT_CAN_PT_CRC_SC02 m3 : 30|1@0+ (1,0) [0|0] ""  PT
 SG_ BIT_CAN_PT_ALIVE_SC02 m3 : 31|1@0+ (1,0) [0|0] ""  PT
 SG_ BIT_CAN_SAFETYLIN_MIA_SC02 m3 : 32|1@0+ (1,0) [0|0] ""  PT
 SG_ BIT_CAN_SAFETYLIN_SHUTDOWN_SC02 m3 : 33|1@0+ (1,0) [0|0] ""  PT
 SG_ BIT_CMB_GPIO_SHORT_SC02 m3 : 40|1@0+ (1,0) [0|0] ""  PT
 SG_ BIT_CMB_C2S_LEAK_SC02 m3 : 41|1@0+ (1,0) [0|0] ""  PT
 SG_ BIT_CMB_SENSE_LINE_SC02 m3 : 42|1@0+ (1,0) [0|0] ""  PT
 SG_ BIT_CMB_SUMOFCELL_CHECK_SC02 m3 : 43|1@0+ (1,0) [0|0] ""  PT
 SG_ BIT_CMB_DRIVER_TIMING_SC02 m3 : 44|1@0+ (1,0) [0|0] ""  PT
 SG_ BIT_CMB_CLEAR_SC02 m3 : 45|1@0+ (1,0) [0|0] ""  PT
 SG_ BIT_CMB_SELFTEST_SC02 m3 : 46|1@0+ (1,0) [0|0] ""  PT
 SG_ BIT_CMB_GPIO_OPEN_SC02 m3 : 47|1@0+ (1,0) [0|0] ""  PT
 SG_ BIT_CMB_CELLV_RANGE_ERR_SC02 m3 : 48|1@0+ (1,0) [0|0] ""  PT
 SG_ BIT_CMB_ADOL_CHECK_SC02 m3 : 49|1@0+ (1,0) [0|0] ""  PT
 SG_ BIT_CMB_BALANCING_STUCK_SC02 m3 : 50|1@0+ (1,0) [0|0] ""  PT
 SG_ BIT_CMB_SUPPLY_SC02 m3 : 51|1@0+ (1,0) [0|0] ""  PT
 SG_ BIT_CMB_DEFECT_SC02 m3 : 52|1@0+ (1,0) [0|0] ""  PT
 SG_ BIT_CMB_PEC_ERROR_SC02 m3 : 53|1@0+ (1,0) [0|0] ""  PT
 SG_ BIT_CMB_GPIO_ERROR_SC02 m3 : 54|1@0+ (1,0) [0|0] ""  PT
 SG_ BIT_CMB_DIGTLREDNCY_LF_SC02 m3 : 55|1@0+ (1,0) [0|0] ""  PT
 SG_ BIT_CCTRL_SELFTEST_SC02 m4 : 8|1@0+ (1,0) [0|0] ""  PT
 SG_ BIT_CCTRL_DRIVER_FAULT_SC02 m4 : 9|1@0+ (1,0) [0|0] ""  PT
 SG_ BIT_CCTRL_HISIDE_STCLSD_SC02 m4 : 10|1@0+ (1,0) [0|0] ""  PT
 SG_ BIT_CCTRL_LOSIDE_STCLSD_SC02 m4 : 11|1@0+ (1,0) [0|0] ""  PT
 SG_ BIT_CCTRL_HISIDE_STUCK_OPEN_SC02 m4 : 12|1@0+ (1,0) [0|0] ""  PT
 SG_ BIT_CCTRL_HVOLTAGE_COND_SC02 m4 : 13|1@0+ (1,0) [0|0] ""  PT
 SG_ BIT_CCTRL_POS1_OPENCIRC_SC02 m4 : 14|1@0+ (1,0) [0|0] ""  PT
 SG_ BIT_CCTRL_NEG1_OPENCIRC_SC02 m4 : 15|1@0+ (1,0) [0|0] ""  PT
 SG_ BIT_CCTRL_PRECHG1_OPENCIRC_SC02 m4 : 16|1@0+ (1,0) [0|0] ""  PT
 SG_ BIT_CCTRL_POS2_OPENCIRC_SC02 m4 : 17|1@0+ (1,0) [0|0] ""  PT
 SG_ BIT_CCTRL_NEG2_OPENCIRC_SC02 m4 : 18|1@0+ (1,0) [0|0] ""  PT
 SG_ BIT_CCTRL_LOSDE_STOPEN_SC02 m4 : 19|1@0+ (1,0) [0|0] ""  PT
 SG_ BIT_CCTRL_POS3_OPENCIRC_SC02 m4 : 20|1@0+ (1,0) [0|0] ""  PT
 SG_ BIT_CCTRL_PRECHG2_OPENCIRC_SC02 m4 : 21|1@0+ (1,0) [0|0] ""  PT
 SG_ BIT_CCTRL_ITEM_OFF_OPEN_SC02 m4 : 22|1@0+ (1,0) [0|0] ""  PT
 SG_ BIT_CCTRL_UNEXPECTED_OPEN_SC02 m4 : 23|1@0+ (1,0) [0|0] ""  PT
 SG_ BIT_CNTR_ISOLATION_SC02 m4 : 24|1@0+ (1,0) [0|0] ""  PT
 SG_ BIT_CNTR_ISO_AND_POT_WELD_SC02 m4 : 25|1@0+ (1,0) [0|0] ""  PT
 SG_ BIT_CNTR_POS1_WELDED_SC02 m4 : 26|1@0+ (1,0) [0|0] ""  PT
 SG_ BIT_CNTR_NEG1_WELDED_SC02 m4 : 27|1@0+ (1,0) [0|0] ""  PT
 SG_ BIT_CNTR_POS2_WELDED_SC02 m4 : 28|1@0+ (1,0) [0|0] ""  PT
 SG_ BIT_CNTR_NEG2_WELDED_SC02 m4 : 29|1@0+ (1,0) [0|0] ""  PT
 SG_ BIT_CNTR_POS3_WELDED_SC02 m4 : 30|1@0+ (1,0) [0|0] ""  PT
 SG_ BIT_CNTR_NEG3_WELDED_SC02 m4 : 31|1@0+ (1,0) [0|0] ""  PT
 SG_ BIT_CNTR_P_ANDOR_N_WELD_SC02 m4 : 32|1@0+ (1,0) [0|0] ""  PT
 SG_ BIT_CNTR_HIGH_CY_SC02 m4 : 33|1@0+ (1,0) [0|0] ""  PT
 SG_ BIT_CNTR_WELDCHECK_TIMEOUT_SC02 m4 : 34|1@0+ (1,0) [0|0] ""  PT
 SG_ BIT_CURRENT_PLAUSIBILITY_SC02 m4 : 40|1@0+ (1,0) [0|0] ""  PT
 SG_ BIT_CURRENT_OVERCHARGE_SC02 m4 : 41|1@0+ (1,0) [0|0] ""  PT
 SG_ BIT_CURRENT_OVERDISCHARGE_SC02 m4 : 42|1@0+ (1,0) [0|0] ""  PT
 SG_ BIT_CURRENT_ISENSE1_INVALID_SC02 m4 : 43|1@0+ (1,0) [0|0] ""  PT
 SG_ BIT_CURRENT_ISENSE2_INVALID_SC02 m4 : 44|1@0+ (1,0) [0|0] ""  PT
 SG_ BIT_CURRENT_ISENSE3_INVALID_SC02 m4 : 45|1@0+ (1,0) [0|0] ""  PT
 SG_ BIT_CURRENT_ISENSE4_INVALID_SC02 m4 : 46|1@0+ (1,0) [0|0] ""  PT
 SG_ BIT_CURRENT_ISENSE5_INVALID_SC02 m4 : 47|1@0+ (1,0) [0|0] ""  PT
 SG_ BIT_CURRENT_HALL_INVALID_SC02 m4 : 48|1@0+ (1,0) [0|0] ""  PT
 SG_ BIT_CURRENT_OFFSET_FAULT_SC02 m4 : 49|1@0+ (1,0) [0|0] ""  PT
 SG_ BIT_FLUXGATE1_CURRENT_FAULT_SC02 m5 : 8|1@0+ (1,0) [0|0] ""  PT
 SG_ BIT_FLUXGATE_12V_LOW_SC02 m5 : 18|1@0+ (1,0) [0|0] ""  PT
 SG_ BIT_HALL_INVALID_SC02 m5 : 24|1@0+ (1,0) [0|0] ""  PT
 SG_ BIT_HALL_PWR_FAIL_LO_SC02 m5 : 25|1@0+ (1,0) [0|0] ""  PT
 SG_ BIT_HALL_SENSELO_SC02 m5 : 26|1@0+ (1,0) [0|0] ""  PT
 SG_ BIT_HALL_SENSEHI_SC02 m5 : 27|1@0+ (1,0) [0|0] ""  PT
 SG_ BIT_HVIL_HW_FAULT_SC02 m5 : 40|1@0+ (1,0) [0|0] ""  PT
 SG_ BIT_HVIL_OPEN_CIRCUIT_SC02 m5 : 41|1@0+ (1,0) [0|0] ""  PT
 SG_ BIT_HVIL_SHORT_SUPPLY_SC02 m5 : 42|1@0+ (1,0) [0|0] ""  PT
 SG_ BIT_HVIL_SHORT_CHASSIS_SC02 m5 : 43|1@0+ (1,0) [0|0] ""  PT
 SG_ BIT_HVIL_RESISTANCE_HIGH_SC02 m5 : 44|1@0+ (1,0) [0|0] ""  PT
 SG_ BIT_HVIL_SHORT_CIRCUIT_SC02 m5 : 45|1@0+ (1,0) [0|0] ""  PT
 SG_ BIT_ISASHUNT1_CURRENT_FAULT_SC02 m7 : 24|1@0+ (1,0) [0|0] ""  PT
 SG_ BIT_ISASHUNT2_CURRENT_FAULT_SC02 m7 : 25|1@0+ (1,0) [0|0] ""  PT
 SG_ BIT_ISASHUNT3_CURRENT_FAULT_SC02 m7 : 26|1@0+ (1,0) [0|0] ""  PT
 SG_ BIT_ISASHUNT4_CURRENT_FAULT_SC02 m7 : 27|1@0+ (1,0) [0|0] ""  PT
 SG_ BIT_ISASHUNT5_CURRENT_FAULT_SC02 m7 : 28|1@0+ (1,0) [0|0] ""  PT
 SG_ BIT_ISASHUNT1_CHARGE_FAULT_SC02 m7 : 29|1@0+ (1,0) [0|0] ""  PT
 SG_ BIT_ISASHUNT2_CHARGE_FAULT_SC02 m7 : 30|1@0+ (1,0) [0|0] ""  PT
 SG_ BIT_ISASHUNT3_CHARGE_FAULT_SC02 m7 : 31|1@0+ (1,0) [0|0] ""  PT
 SG_ BIT_ISASHUNT4_CHARGE_FAULT_SC02 m7 : 32|1@0+ (1,0) [0|0] ""  PT
 SG_ BIT_ISASHUNT5_CHARGE_FAULT_SC02 m7 : 33|1@0+ (1,0) [0|0] ""  PT
 SG_ BIT_ISASHUNT_SUPPLY_LOW_SC02 m7 : 34|1@0+ (1,0) [0|0] ""  PT
 SG_ BIT_LINK_POS_HW_FAIL_SC02 m7 : 40|1@0+ (1,0) [0|0] ""  PT
 SG_ BIT_LINK_NEG_HW_FAIL_SC02 m7 : 41|1@0+ (1,0) [0|0] ""  PT
 SG_ BIT_PUMP_LIN_FAILURE_SC02 m8 : 8|1@0+ (1,0) [0|0] ""  PT
 SG_ BIT_PUMP_OVERTEMPERATURE_SC02 m8 : 9|1@0+ (1,0) [0|0] ""  PT
 SG_ BIT_PUMP_SPEED_HIGH_SC02 m8 : 10|1@0+ (1,0) [0|0] ""  PT
 SG_ BIT_PUMP_SPEED_LOW_SC02 m8 : 11|1@0+ (1,0) [0|0] ""  PT
 SG_ BIT_PUMP_DRY_RUN_SC02 m8 : 12|1@0+ (1,0) [0|0] ""  PT
 SG_ BIT_SBC_VCORE_OOR_SC02 m6 : 8|1@0+ (1,0) [0|0] ""  PT
 SG_ BIT_SBC_SELFTEST_SC02 m6 : 9|1@0+ (1,0) [0|0] ""  PT
 SG_ BIT_SBC_INIT_SC02 m6 : 10|1@0+ (1,0) [0|0] ""  PT
 SG_ BIT_SBC_WATCHDOG_SC02 m6 : 11|1@0+ (1,0) [0|0] ""  PT
 SG_ BIT_SBC_FECBITFLIP_SC02 m6 : 12|1@0+ (1,0) [0|0] ""  PT
 SG_ BIT_SBC_VREUV_SC02 m6 : 13|1@0+ (1,0) [0|0] ""  PT
 SG_ BIT_SBC_FAILSAFE_SC02 m6 : 14|1@0+ (1,0) [0|0] ""  PT
 SG_ BIT_SBC_VAUX_OOR_SC02 m6 : 15|1@0+ (1,0) [0|0] ""  PT
 SG_ BIT_SBC_VCCA_OOR_SC02 m6 : 16|1@0+ (1,0) [0|0] ""  PT
 SG_ BIT_SBC_FCRBM_OOR_SC02 m6 : 17|1@0+ (1,0) [0|0] ""  PT
 SG_ BIT_SBC_FLT_ERR_CNTR_SC02 m6 : 18|1@0+ (1,0) [0|0] ""  PT
 SG_ BIT_SBC_FS0B_FAIL_SC02 m6 : 19|1@0+ (1,0) [0|0] ""  PT
 SG_ BIT_SBC_SPI_ERRORS_SC02 m6 : 20|1@0+ (1,0) [0|0] ""  PT
 SG_ BIT_SBC_SPI_TX_FAIL_SC02 m6 : 21|1@0+ (1,0) [0|0] ""  PT
 SG_ BIT_SBC_NERROR_ACTIVE_SC02 m6 : 22|1@0+ (1,0) [0|0] ""  PT
 SG_ BIT_SELFTEST_RAM_SC02 m6 : 24|1@0+ (1,0) [0|0] ""  PT
 SG_ BIT_SELFTEST_FLASH_SC02 m6 : 25|1@0+ (1,0) [0|0] ""  PT
 SG_ BIT_SELFTEST_CLOCK_SC02 m6 : 26|1@0+ (1,0) [0|0] ""  PT
 SG_ BIT_SELFTEST_WATCHDOG_SC02 m6 : 27|1@0+ (1,0) [0|0] ""  PT
 SG_ BIT_SELFTEST_STACK_SC02 m6 : 28|1@0+ (1,0) [0|0] ""  PT
 SG_ BIT_SELFTEST_L2L3_SC02 m6 : 29|1@0+ (1,0) [0|0] ""  PT
 SG_ BIT_SELFTEST_EFUSE_SC02 m6 : 30|1@0+ (1,0) [0|0] ""  PT
 SG_ BIT_SELFTEST_EXCEPTION_SC02 m6 : 31|1@0+ (1,0) [0|0] ""  PT
 SG_ BIT_SELFTEST_5VD_FAIL_SC02 m6 : 32|1@0+ (1,0) [0|0] ""  PT
 SG_ BIT_SELFTEST_VIM_SC02 m6 : 33|1@0+ (1,0) [0|0] ""  PT
 SG_ BIT_SELFTEST_TASKTIME_SC02 m6 : 34|1@0+ (1,0) [0|0] ""  PT
 SG_ BIT_SELFTEST_RTI_SC02 m6 : 35|1@0+ (1,0) [0|0] ""  PT
 SG_ BIT_SELFTEST_ESM_SC02 m6 : 36|1@0+ (1,0) [0|0] ""  PT
 SG_ BIT_SELFTEST_IOM_SC02 m6 : 37|1@0+ (1,0) [0|0] ""  PT
 SG_ BIT_SELFTEST_SBC_SC02 m6 : 38|1@0+ (1,0) [0|0] ""  PT
 SG_ BIT_SELFTEST_STARTUP_SC02 m6 : 39|1@0+ (1,0) [0|0] ""  PT
 SG_ BIT_TEMP_MODULEOVERTEMP_SC02 m6 : 40|1@0+ (1,0) [0|0] ""  PT
 SG_ BIT_TEMP_MODULETEMP_INVALID_SC02 m6 : 41|1@0+ (1,0) [0|0] ""  PT
 SG_ BIT_TEMP_NTC_OPENWIRE_SC02 m6 : 42|1@0+ (1,0) [0|0] ""  PT
 SG_ BIT_TEMP_NTC_SHORT_SC02 m6 : 43|1@0+ (1,0) [0|0] ""  PT
 SG_ BIT_TEMP_PLAUSIBILITY_SC02 m6 : 44|1@0+ (1,0) [0|0] ""  PT
 SG_ BIT_VOLTAGE_BRICKV_INVALID_SC02 m7 : 8|1@0+ (1,0) [0|0] ""  PT
 SG_ BIT_VOLTAGE_BRICKUV_SC02 m7 : 9|1@0+ (1,0) [0|0] ""  PT
 SG_ BIT_VOLTAGE_BRICKOV_SC02 m7 : 10|1@0+ (1,0) [0|0] ""  PT
 SG_ BIT_VOLTAGE_BRICKDEEPDSCHG_SC02 m7 : 11|1@0+ (1,0) [0|0] ""  PT
 SG_ BIT_VOLTAGE_PACKV_INVALID_SC02 m7 : 12|1@0+ (1,0) [0|0] ""  PT
 SG_ BIT_VOLTAGE_PLAUSIBILITY_SC02 m7 : 13|1@0+ (1,0) [0|0] ""  PT
 SG_ BIT_VOLTAGE_CMB_PLAUSI_SC02 m7 : 14|1@0+ (1,0) [0|0] ""  PT
 SG_ BIT_VOLTAGE_SENSE_OPENWIRE_SC02 m7 : 15|1@0+ (1,0) [0|0] ""  PT
 SG_ BIT_VOLTAGE_BRICKV_FROZEN_SC02 m7 : 16|1@0+ (1,0) [0|0] ""  PT
 SG_ BIT_PUMP_BLOCK_SC02 m8 : 13|1@0+ (1,0) [0|0] ""  PT
 SG_ BIT_PUMP_SUPPLY_SC02 m8 : 14|1@0+ (1,0) [0|0] ""  PT
 SG_ BIT_PUMP_OVERCURRENT_SC02 m8 : 15|1@0+ (1,0) [0|0] ""  PT
 SG_ BIT_PUMP_ELECTRIC_SC02 m8 : 16|1@0+ (1,0) [0|0] ""  PT
 SG_ BIT_PUMP_RS_SC02 m8 : 17|1@0+ (1,0) [0|0] ""  PT
 SG_ BIT_HALL_PWR_FAIL_HI_SC02 m5 : 28|1@0+ (1,0) [0|0] ""  PT
 SG_ BIT_VOLTAGE_OUT_OF_RANGE_SC02 m7 : 17|1@0+ (1,0) [0|0] ""  PT
 SG_ BIT_ISO_OFF_TIME_SHORT_SC02 m8 : 24|1@0+ (1,0) [0|0] ""  PT
 SG_ BIT_ISO_ON_TIME_SHORT_SC02 m8 : 25|1@0+ (1,0) [0|0] ""  PT
 SG_ BIT_ISO_INTERNAL_INACTIVE_SC02 m8 : 26|1@0+ (1,0) [0|0] ""  PT
 SG_ BIT_ISO_SW_STATE_INVALID_SC02 m8 : 27|1@0+ (1,0) [0|0] ""  PT
 SG_ BIT_ISO_PACKV_SNA_SWOFF_SC02 m8 : 28|1@0+ (1,0) [0|0] ""  PT
 SG_ BIT_ISO_PACKV_SNA_SWON_SC02 m8 : 29|1@0+ (1,0) [0|0] ""  PT
 SG_ BIT_ISO_EXTERNAL_INACTIVE_SC02 m8 : 30|1@0+ (1,0) [0|0] ""  PT
 SG_ BIT_CANTX_CNTR_STAT_FAULT_SC02 m8 : 40|1@0+ (1,0) [0|0] ""  PT
 SG_ BIT_CANTX_CNTR_WELD_FAULT_SC02 m8 : 41|1@0+ (1,0) [0|0] ""  PT
 SG_ BIT_CANTX_THERMAL_FAULT_SC02 m8 : 42|1@0+ (1,0) [0|0] ""  PT
 SG_ BIT_CANTX_ISOLATION_FAULT_SC02 m8 : 43|1@0+ (1,0) [0|0] ""  PT
 SG_ BIT_CANTX_HVIL_FAULT_SC02 m8 : 44|1@0+ (1,0) [0|0] ""  PT
 SG_ BIT_VOLTAGE_STATELATCHED_SC02 m7 : 18|1@0+ (1,0) [0|0] ""  PT
 SG_ BIT_CANTX_ISOLATION_PREFLT_SC02 m8 : 45|1@0+ (1,0) [0|0] ""  PT
 SG_ BIT_CANTX_FLTRIGGER_FAILED_SC02 m8 : 46|1@0+ (1,0) [0|0] ""  PT
 SG_ BIT_ISO_TEST_SWITCH_FAULT_SC02 m8 : 31|1@0+ (1,0) [0|0] ""  PT
 SG_ BIT_THERMAL_ADC_FAULT_SC02 m9 : 8|1@0+ (1,0) [0|0] ""  PT
 SG_ BIT_THERMAL_PRESSURE_VHI_SC02 m9 : 9|1@0+ (1,0) [0|0] ""  PT
 SG_ BIT_THERMAL_PRESSURE_VLO_SC02 m9 : 10|1@0+ (1,0) [0|0] ""  PT
 SG_ BIT_THERMAL_PRIMARY_EVT_SC02 m9 : 11|1@0+ (1,0) [0|0] ""  PT
 SG_ BIT_THERMAL_SECONRY_EVT_SC02 m9 : 12|1@0+ (1,0) [0|0] ""  PT
 SG_ BIT_THERMAL_PRESSURE_INV_SC02 m9 : 13|1@0+ (1,0) [0|0] ""  PT
 SG_ BIT_THERMAL_EVTLATCHED_SC02 m9 : 14|1@0+ (1,0) [0|0] ""  PT
 SG_ BIT_COOLANT_CANMIA_SC02 m9 : 24|1@0+ (1,0) [0|0] ""  PT
 SG_ BIT_COOLANT_SENSRFAIL_SC02 m9 : 25|1@0+ (1,0) [0|0] ""  PT
 SG_ BIT_COOLANT_WATERDETCD_SC02 m9 : 26|1@0+ (1,0) [0|0] ""  PT
 SG_ BIT_COOLANT_LATCHED_SC02 m9 : 27|1@0+ (1,0) [0|0] ""  PT
 SG_ BIT_ANALOG_PULLUP_DSBLD_SC02 m3 : 17|1@0+ (1,0) [0|0] ""  PT
 SG_ BIT_ANALOG_PULLUP_DSBLRQ_SC02 m3 : 16|1@0+ (1,0) [0|0] ""  PT
 SG_ BIT_SBC_REG_ERROR_SC02 m6 : 23|1@0+ (1,0) [0|0] ""  PT
 SG_ BIT_CURRENT_LATCHED_SC02 m4 : 50|1@0+ (1,0) [0|0] ""  PT
 SG_ BIT_TEMP_LATCHED_SC02 m6 : 45|1@0+ (1,0) [0|0] ""  PT
 SG_ BIT_ISO_PLAUSI_SWOFF_SC02 m8 : 32|1@0+ (1,0) [0|0] ""  PT
 SG_ BIT_ISO_PLAUSI_SWON_SC02 m8 : 33|1@0+ (1,0) [0|0] ""  PT
 SG_ BIT_ISO_RELAXED_INACTIVE_SC02 m8 : 34|1@0+ (1,0) [0|0] ""  PT
 SG_ BIT_THERMAL_PRESSURE_MIA_SC02 m9 : 15|1@0+ (1,0) [0|0] ""  PT
 SG_ BIT_LINK_PACK_MISMATCH_SC02 m7 : 42|1@0+ (1,0) [0|0] ""  PT
 SG_ BIT_CAN_PT_EMERGENCY_SC02 m3 : 34|1@0+ (1,0) [0|0] ""  PT
 SG_ BIT_THERMAL_PRES_SUPPLY_OOR_SC02 m9 : 16|1@0+ (1,0) [0|0] ""  PT
 SG_ BIT_CAN_SM_DISABLE_SC02 m3 : 35|1@0+ (1,0) [0|0] ""  PT
 SG_ BIT_THERMAL_PRESSURE_FLT_SC02 m9 : 17|1@0+ (1,0) [0|0] ""  PT
 SG_ BIT_CURRENT_SENSOR_FAULT_SC02 m9 : 40|1@0+ (1,0) [0|0] ""  PT
 SG_ BIT_CURRENT_SENSOR_CHARGE_FAULT_SC02 m9 : 45|1@0+ (1,0) [0|0] ""  PT
 SG_ BIT_CURRENT_SENSOR_SUP_LOW_SC02 m9 : 50|1@0+ (1,0) [0|0] ""  PT
 SG_ BIT_THERMAL_H2SENSE_FAULT_SC02 m9 : 18|1@0+ (1,0) [0|0] ""  PT
 SG_ BIT_VOLTAGE_BRICKCOUNT_INVALID_SC02 m7 : 19|1@0+ (1,0) [0|0] ""  PT

BO_ 1921 BMS02_DebugOnboard: 7 BMS02
 SG_ cmbCoolantTemp08_BMS02 m8 : 55|8@0+ (1,-40) [-40|200] "C"  PT
 SG_ cmbCoolantTemp07_BMS02 m7 : 55|8@0+ (1,-40) [-40|200] "C"  PT
 SG_ cmbCoolantTemp06_BMS02 m6 : 55|8@0+ (1,-40) [-40|200] "C"  PT
 SG_ cmbCoolantTemp05_BMS02 m5 : 55|8@0+ (1,-40) [-40|200] "C"  PT
 SG_ cmbCoolantTemp04_BMS02 m4 : 55|8@0+ (1,-40) [-40|200] "C"  PT
 SG_ cmbCoolantTemp03_BMS02 m3 : 55|8@0+ (1,-40) [-40|200] "C"  PT
 SG_ cmbCoolantTemp02_BMS02 m2 : 55|8@0+ (1,-40) [-40|200] "C"  PT
 SG_ cmbCoolantTemp01_BMS02 m1 : 55|8@0+ (1,-40) [-40|200] "C"  PT
 SG_ cmbOnboardPressure32_BMS02 m32 : 39|16@0+ (1,0) [0|600] "kPa"  PT
 SG_ cmbOnboardPressure31_BMS02 m31 : 39|16@0+ (1,0) [0|600] "kPa"  PT
 SG_ cmbOnboardPressure30_BMS02 m30 : 39|16@0+ (1,0) [0|600] "kPa"  PT
 SG_ cmbOnboardPressure29_BMS02 m29 : 39|16@0+ (1,0) [0|600] "kPa"  PT
 SG_ cmbOnboardPressure28_BMS02 m28 : 39|16@0+ (1,0) [0|600] "kPa"  PT
 SG_ cmbOnboardPressure27_BMS02 m27 : 39|16@0+ (1,0) [0|600] "kPa"  PT
 SG_ cmbOnboardPressure26_BMS02 m26 : 39|16@0+ (1,0) [0|600] "kPa"  PT
 SG_ cmbOnboardPressure25_BMS02 m25 : 39|16@0+ (1,0) [0|600] "kPa"  PT
 SG_ cmbOnboardPressure24_BMS02 m24 : 39|16@0+ (1,0) [0|600] "kPa"  PT
 SG_ cmbOnboardPressure23_BMS02 m23 : 39|16@0+ (1,0) [0|600] "kPa"  PT
 SG_ cmbOnboardPressure22_BMS02 m22 : 39|16@0+ (1,0) [0|600] "kPa"  PT
 SG_ cmbOnboardPressure21_BMS02 m21 : 39|16@0+ (1,0) [0|600] "kPa"  PT
 SG_ cmbOnboardPressure20_BMS02 m20 : 39|16@0+ (1,0) [0|600] "kPa"  PT
 SG_ cmbOnboardPressure19_BMS02 m19 : 39|16@0+ (1,0) [0|600] "kPa"  PT
 SG_ cmbOnboardPressure18_BMS02 m18 : 39|16@0+ (1,0) [0|600] "kPa"  PT
 SG_ cmbOnboardPressure17_BMS02 m17 : 39|16@0+ (1,0) [0|600] "kPa"  PT
 SG_ cmbOnboardPressure16_BMS02 m16 : 39|16@0+ (1,0) [0|600] "kPa"  PT
 SG_ cmbOnboardPressure15_BMS02 m15 : 39|16@0+ (1,0) [0|600] "kPa"  PT
 SG_ cmbOnboardPressure14_BMS02 m14 : 39|16@0+ (1,0) [0|600] "kPa"  PT
 SG_ cmbOnboardPressure13_BMS02 m13 : 39|16@0+ (1,0) [0|600] "kPa"  PT
 SG_ cmbOnboardPressure12_BMS02 m12 : 39|16@0+ (1,0) [0|600] "kPa"  PT
 SG_ cmbOnboardPressure11_BMS02 m11 : 39|16@0+ (1,0) [0|600] "kPa"  PT
 SG_ cmbOnboardPressure10_BMS02 m10 : 39|16@0+ (1,0) [0|600] "kPa"  PT
 SG_ cmbOnboardPressure09_BMS02 m9 : 39|16@0+ (1,0) [0|600] "kPa"  PT
 SG_ cmbOnboardPressure08_BMS02 m8 : 39|16@0+ (1,0) [0|600] "kPa"  PT
 SG_ cmbOnboardPressure07_BMS02 m7 : 39|16@0+ (1,0) [0|600] "kPa"  PT
 SG_ cmbOnboardPressure06_BMS02 m6 : 39|16@0+ (1,0) [0|600] "kPa"  PT
 SG_ cmbOnboardPressure05_BMS02 m5 : 39|16@0+ (1,0) [0|600] "kPa"  PT
 SG_ cmbOnboardPressure04_BMS02 m4 : 39|16@0+ (1,0) [0|600] "kPa"  PT
 SG_ cmbOnboardPressure03_BMS02 m3 : 39|16@0+ (1,0) [0|600] "kPa"  PT
 SG_ cmbOnboardPressure02_BMS02 m2 : 39|16@0+ (1,0) [0|600] "kPa"  PT
 SG_ cmbOnboardPressure01_BMS02 m1 : 39|16@0+ (1,0) [0|600] "kPa"  PT
 SG_ onboardMultiplexor_BMS02 M : 7|8@0+ (1,0) [0|0] ""  PT
 SG_ minCmbOnboardTemperature_BMS02 m0 : 31|8@0+ (1,-40) [-40|200] "C"  PT
 SG_ minCmbOnboardHumidity_BMS02 m0 : 47|8@0+ (0.5,0) [0|120] "PCT"  PT
 SG_ maxCmbOnboardTemperature_BMS02 m0 : 39|8@0+ (1,-40) [-40|200] "C"  PT
 SG_ maxCmbOnboardHumidity_BMS02 m0 : 55|8@0+ (0.5,0) [0|120] "PCT"  PT
 SG_ bmsOnboardTemperature_BMS02 m0 : 15|8@0+ (1,-40) [-40|200] "C"  PT
 SG_ bmsOnboardHumidity_BMS02 m0 : 23|8@0+ (0.5,0) [0|120] "PCT"  PT
 SG_ cmbOnboardTemperature01_BMS02 m1 : 15|8@0+ (1,-40) [-40|200] "C"  PT
 SG_ cmbOnboardHumidity01_BMS02 m1 : 23|8@0+ (0.5,0) [0|120] "PCT"  PT
 SG_ moduleHeaterCurrent01_BMS02 m1 : 31|8@0+ (0.05,0) [0|10] "A"  PT
 SG_ cmbOnboardTemperature02_BMS02 m2 : 15|8@0+ (1,-40) [-40|200] "C"  PT
 SG_ cmbOnboardHumidity02_BMS02 m2 : 23|8@0+ (0.5,0) [0|120] "PCT"  PT
 SG_ moduleHeaterCurrent02_BMS02 m2 : 31|8@0+ (0.05,0) [0|10] "A"  PT
 SG_ cmbOnboardTemperature03_BMS02 m3 : 15|8@0+ (1,-40) [-40|200] "C"  PT
 SG_ cmbOnboardHumidity03_BMS02 m3 : 23|8@0+ (0.5,0) [0|120] "PCT"  PT
 SG_ moduleHeaterCurrent03_BMS02 m3 : 31|8@0+ (0.05,0) [0|10] "A"  PT
 SG_ cmbOnboardTemperature04_BMS02 m4 : 15|8@0+ (1,-40) [-40|200] "C"  PT
 SG_ cmbOnboardHumidity04_BMS02 m4 : 23|8@0+ (0.5,0) [0|120] "PCT"  PT
 SG_ moduleHeaterCurrent04_BMS02 m4 : 31|8@0+ (0.05,0) [0|10] "A"  PT
 SG_ cmbOnboardTemperature05_BMS02 m5 : 15|8@0+ (1,-40) [-40|200] "C"  PT
 SG_ cmbOnboardHumidity05_BMS02 m5 : 23|8@0+ (0.5,0) [0|120] "PCT"  PT
 SG_ moduleHeaterCurrent05_BMS02 m5 : 31|8@0+ (0.05,0) [0|10] "A"  PT
 SG_ cmbOnboardTemperature06_BMS02 m6 : 15|8@0+ (1,-40) [-40|200] "C"  PT
 SG_ cmbOnboardHumidity06_BMS02 m6 : 23|8@0+ (0.5,0) [0|120] "PCT"  PT
 SG_ moduleHeaterCurrent06_BMS02 m6 : 31|8@0+ (0.05,0) [0|10] "A"  PT
 SG_ cmbOnboardTemperature07_BMS02 m7 : 15|8@0+ (1,-40) [-40|200] "C"  PT
 SG_ cmbOnboardHumidity07_BMS02 m7 : 23|8@0+ (0.5,0) [0|120] "PCT"  PT
 SG_ moduleHeaterCurrent07_BMS02 m7 : 31|8@0+ (0.05,0) [0|10] "A"  PT
 SG_ cmbOnboardTemperature08_BMS02 m8 : 15|8@0+ (1,-40) [-40|200] "C"  PT
 SG_ cmbOnboardHumidity08_BMS02 m8 : 23|8@0+ (0.5,0) [0|120] "PCT"  PT
 SG_ moduleHeaterCurrent08_BMS02 m8 : 31|8@0+ (0.05,0) [0|10] "A"  PT
 SG_ cmbOnboardTemperature09_BMS02 m9 : 15|8@0+ (1,-40) [-40|200] "C"  PT
 SG_ cmbOnboardHumidity09_BMS02 m9 : 23|8@0+ (0.5,0) [0|120] "PCT"  PT
 SG_ moduleHeaterCurrent09_BMS02 m9 : 31|8@0+ (0.05,0) [0|10] "A"  PT
 SG_ cmbOnboardTemperature10_BMS02 m10 : 15|8@0+ (1,-40) [-40|200] "C"  PT
 SG_ cmbOnboardHumidity10_BMS02 m10 : 23|8@0+ (0.5,0) [0|120] "PCT"  PT
 SG_ moduleHeaterCurrent10_BMS02 m10 : 31|8@0+ (0.05,0) [0|10] "A"  PT
 SG_ cmbOnboardTemperature11_BMS02 m11 : 15|8@0+ (1,-40) [-40|200] "C"  PT
 SG_ cmbOnboardHumidity11_BMS02 m11 : 23|8@0+ (0.5,0) [0|120] "PCT"  PT
 SG_ moduleHeaterCurrent11_BMS02 m11 : 31|8@0+ (0.05,0) [0|10] "A"  PT
 SG_ cmbOnboardTemperature12_BMS02 m12 : 15|8@0+ (1,-40) [-40|200] "C"  PT
 SG_ cmbOnboardHumidity12_BMS02 m12 : 23|8@0+ (0.5,0) [0|120] "PCT"  PT
 SG_ moduleHeaterCurrent12_BMS02 m12 : 31|8@0+ (0.05,0) [0|10] "A"  PT
 SG_ cmbOnboardTemperature13_BMS02 m13 : 15|8@0+ (1,-40) [-40|200] "C"  PT
 SG_ cmbOnboardHumidity13_BMS02 m13 : 23|8@0+ (0.5,0) [0|120] "PCT"  PT
 SG_ moduleHeaterCurrent13_BMS02 m13 : 31|8@0+ (0.05,0) [0|10] "A"  PT
 SG_ cmbOnboardTemperature14_BMS02 m14 : 15|8@0+ (1,-40) [-40|200] "C"  PT
 SG_ cmbOnboardHumidity14_BMS02 m14 : 23|8@0+ (0.5,0) [0|120] "PCT"  PT
 SG_ moduleHeaterCurrent14_BMS02 m14 : 31|8@0+ (0.05,0) [0|10] "A"  PT
 SG_ cmbOnboardTemperature15_BMS02 m15 : 15|8@0+ (1,-40) [-40|200] "C"  PT
 SG_ cmbOnboardHumidity15_BMS02 m15 : 23|8@0+ (0.5,0) [0|120] "PCT"  PT
 SG_ moduleHeaterCurrent15_BMS02 m15 : 31|8@0+ (0.05,0) [0|10] "A"  PT
 SG_ cmbOnboardTemperature16_BMS02 m16 : 15|8@0+ (1,-40) [-40|200] "C"  PT
 SG_ cmbOnboardHumidity16_BMS02 m16 : 23|8@0+ (0.5,0) [0|120] "PCT"  PT
 SG_ moduleHeaterCurrent16_BMS02 m16 : 31|8@0+ (0.05,0) [0|10] "A"  PT
 SG_ cmbOnboardTemperature17_BMS02 m17 : 15|8@0+ (1,-40) [-40|200] "C"  PT
 SG_ cmbOnboardHumidity17_BMS02 m17 : 23|8@0+ (0.5,0) [0|120] "PCT"  PT
 SG_ moduleHeaterCurrent17_BMS02 m17 : 31|8@0+ (0.05,0) [0|10] "A"  PT
 SG_ cmbOnboardTemperature18_BMS02 m18 : 15|8@0+ (1,-40) [-40|200] "C"  PT
 SG_ cmbOnboardHumidity18_BMS02 m18 : 23|8@0+ (0.5,0) [0|120] "PCT"  PT
 SG_ moduleHeaterCurrent18_BMS02 m18 : 31|8@0+ (0.05,0) [0|10] "A"  PT
 SG_ cmbOnboardTemperature19_BMS02 m19 : 15|8@0+ (1,-40) [-40|200] "C"  PT
 SG_ cmbOnboardHumidity19_BMS02 m19 : 23|8@0+ (0.5,0) [0|120] "PCT"  PT
 SG_ moduleHeaterCurrent19_BMS02 m19 : 31|8@0+ (0.05,0) [0|10] "A"  PT
 SG_ cmbOnboardTemperature20_BMS02 m20 : 15|8@0+ (1,-40) [-40|200] "C"  PT
 SG_ cmbOnboardHumidity20_BMS02 m20 : 23|8@0+ (0.5,0) [0|120] "PCT"  PT
 SG_ moduleHeaterCurrent20_BMS02 m20 : 31|8@0+ (0.05,0) [0|10] "A"  PT
 SG_ cmbOnboardTemperature21_BMS02 m21 : 15|8@0+ (1,-40) [-40|200] "C"  PT
 SG_ cmbOnboardHumidity21_BMS02 m21 : 23|8@0+ (0.5,0) [0|120] "PCT"  PT
 SG_ moduleHeaterCurrent21_BMS02 m21 : 31|8@0+ (0.05,0) [0|10] "A"  PT
 SG_ cmbOnboardTemperature22_BMS02 m22 : 15|8@0+ (1,-40) [-40|200] "C"  PT
 SG_ cmbOnboardHumidity22_BMS02 m22 : 23|8@0+ (0.5,0) [0|120] "PCT"  PT
 SG_ moduleHeaterCurrent22_BMS02 m22 : 31|8@0+ (0.05,0) [0|10] "A"  PT
 SG_ cmbOnboardTemperature23_BMS02 m23 : 15|8@0+ (1,-40) [-40|200] "C"  PT
 SG_ cmbOnboardHumidity23_BMS02 m23 : 23|8@0+ (0.5,0) [0|120] "PCT"  PT
 SG_ moduleHeaterCurrent23_BMS02 m23 : 31|8@0+ (0.05,0) [0|10] "A"  PT
 SG_ cmbOnboardTemperature24_BMS02 m24 : 15|8@0+ (1,-40) [-40|200] "C"  PT
 SG_ cmbOnboardHumidity24_BMS02 m24 : 23|8@0+ (0.5,0) [0|120] "PCT"  PT
 SG_ moduleHeaterCurrent24_BMS02 m24 : 31|8@0+ (0.05,0) [0|10] "A"  PT
 SG_ cmbOnboardTemperature25_BMS02 m25 : 15|8@0+ (1,-40) [-40|200] "C"  PT
 SG_ cmbOnboardHumidity25_BMS02 m25 : 23|8@0+ (0.5,0) [0|120] "PCT"  PT
 SG_ moduleHeaterCurrent25_BMS02 m25 : 31|8@0+ (0.05,0) [0|10] "A"  PT
 SG_ cmbOnboardTemperature26_BMS02 m26 : 15|8@0+ (1,-40) [-40|200] "C"  PT
 SG_ cmbOnboardHumidity26_BMS02 m26 : 23|8@0+ (0.5,0) [0|120] "PCT"  PT
 SG_ moduleHeaterCurrent26_BMS02 m26 : 31|8@0+ (0.05,0) [0|10] "A"  PT
 SG_ cmbOnboardTemperature27_BMS02 m27 : 15|8@0+ (1,-40) [-40|200] "C"  PT
 SG_ cmbOnboardHumidity27_BMS02 m27 : 23|8@0+ (0.5,0) [0|120] "PCT"  PT
 SG_ moduleHeaterCurrent27_BMS02 m27 : 31|8@0+ (0.05,0) [0|10] "A"  PT
 SG_ cmbOnboardTemperature28_BMS02 m28 : 15|8@0+ (1,-40) [-40|200] "C"  PT
 SG_ cmbOnboardHumidity28_BMS02 m28 : 23|8@0+ (0.5,0) [0|120] "PCT"  PT
 SG_ moduleHeaterCurrent28_BMS02 m28 : 31|8@0+ (0.05,0) [0|10] "A"  PT
 SG_ cmbOnboardTemperature29_BMS02 m29 : 15|8@0+ (1,-40) [-40|200] "C"  PT
 SG_ cmbOnboardHumidity29_BMS02 m29 : 23|8@0+ (0.5,0) [0|120] "PCT"  PT
 SG_ moduleHeaterCurrent29_BMS02 m29 : 31|8@0+ (0.05,0) [0|10] "A"  PT
 SG_ cmbOnboardTemperature30_BMS02 m30 : 15|8@0+ (1,-40) [-40|200] "C"  PT
 SG_ cmbOnboardHumidity30_BMS02 m30 : 23|8@0+ (0.5,0) [0|120] "PCT"  PT
 SG_ moduleHeaterCurrent30_BMS02 m30 : 31|8@0+ (0.05,0) [0|10] "A"  PT
 SG_ cmbOnboardTemperature31_BMS02 m31 : 15|8@0+ (1,-40) [-40|200] "C"  PT
 SG_ cmbOnboardHumidity31_BMS02 m31 : 23|8@0+ (0.5,0) [0|120] "PCT"  PT
 SG_ moduleHeaterCurrent31_BMS02 m31 : 31|8@0+ (0.05,0) [0|10] "A"  PT
 SG_ cmbOnboardTemperature32_BMS02 m32 : 15|8@0+ (1,-40) [-40|200] "C"  PT
 SG_ cmbOnboardHumidity32_BMS02 m32 : 23|8@0+ (0.5,0) [0|120] "PCT"  PT
 SG_ moduleHeaterCurrent32_BMS02 m32 : 31|8@0+ (0.05,0) [0|10] "A"  PT

BO_ 1985 BMS02_DebugCMB: 8 BMS02
 SG_ cmbMultiplexor_BMS02 M : 7|8@0+ (1,0) [0|0] ""  PT
 SG_ moduleTemperature01_BMS02 m1 : 15|8@0+ (1,-40) [-40|200] "C"  PT
 SG_ brickVoltage001_BMS02 m1 : 23|16@0+ (0.0001,0) [0|6.5] "V"  PT
 SG_ brickVoltage002_BMS02 m1 : 39|16@0+ (0.0001,0) [0|6.5] "V"  PT
 SG_ brickVoltage003_BMS02 m1 : 55|16@0+ (0.0001,0) [0|6.5] "V"  PT
 SG_ moduleTemperature02_BMS02 m2 : 15|8@0+ (1,-40) [-40|200] "C"  PT
 SG_ brickVoltage004_BMS02 m2 : 23|16@0+ (0.0001,0) [0|6.5] "V"  PT
 SG_ brickVoltage005_BMS02 m2 : 39|16@0+ (0.0001,0) [0|6.5] "V"  PT
 SG_ brickVoltage006_BMS02 m2 : 55|16@0+ (0.0001,0) [0|6.5] "V"  PT
 SG_ moduleTemperature03_BMS02 m3 : 15|8@0+ (1,-40) [-40|200] "C"  PT
 SG_ brickVoltage007_BMS02 m3 : 23|16@0+ (0.0001,0) [0|6.5] "V"  PT
 SG_ brickVoltage008_BMS02 m3 : 39|16@0+ (0.0001,0) [0|6.5] "V"  PT
 SG_ brickVoltage009_BMS02 m3 : 55|16@0+ (0.0001,0) [0|6.5] "V"  PT
 SG_ moduleTemperature04_BMS02 m4 : 15|8@0+ (1,-40) [-40|200] "C"  PT
 SG_ brickVoltage010_BMS02 m4 : 23|16@0+ (0.0001,0) [0|6.5] "V"  PT
 SG_ brickVoltage011_BMS02 m4 : 39|16@0+ (0.0001,0) [0|6.5] "V"  PT
 SG_ brickVoltage012_BMS02 m4 : 55|16@0+ (0.0001,0) [0|6.5] "V"  PT
 SG_ moduleTemperature05_BMS02 m5 : 15|8@0+ (1,-40) [-40|200] "C"  PT
 SG_ brickVoltage013_BMS02 m5 : 23|16@0+ (0.0001,0) [0|6.5] "V"  PT
 SG_ brickVoltage014_BMS02 m5 : 39|16@0+ (0.0001,0) [0|6.5] "V"  PT
 SG_ brickVoltage015_BMS02 m5 : 55|16@0+ (0.0001,0) [0|6.5] "V"  PT
 SG_ moduleTemperature06_BMS02 m6 : 15|8@0+ (1,-40) [-40|200] "C"  PT
 SG_ brickVoltage016_BMS02 m6 : 23|16@0+ (0.0001,0) [0|6.5] "V"  PT
 SG_ brickVoltage017_BMS02 m6 : 39|16@0+ (0.0001,0) [0|6.5] "V"  PT
 SG_ brickVoltage018_BMS02 m6 : 55|16@0+ (0.0001,0) [0|6.5] "V"  PT
 SG_ moduleTemperature07_BMS02 m7 : 15|8@0+ (1,-40) [-40|200] "C"  PT
 SG_ brickVoltage019_BMS02 m7 : 23|16@0+ (0.0001,0) [0|6.5] "V"  PT
 SG_ brickVoltage020_BMS02 m7 : 39|16@0+ (0.0001,0) [0|6.5] "V"  PT
 SG_ brickVoltage021_BMS02 m7 : 55|16@0+ (0.0001,0) [0|6.5] "V"  PT
 SG_ moduleTemperature08_BMS02 m8 : 15|8@0+ (1,-40) [-40|200] "C"  PT
 SG_ brickVoltage022_BMS02 m8 : 23|16@0+ (0.0001,0) [0|6.5] "V"  PT
 SG_ brickVoltage023_BMS02 m8 : 39|16@0+ (0.0001,0) [0|6.5] "V"  PT
 SG_ brickVoltage024_BMS02 m8 : 55|16@0+ (0.0001,0) [0|6.5] "V"  PT
 SG_ moduleTemperature09_BMS02 m9 : 15|8@0+ (1,-40) [-40|200] "C"  PT
 SG_ brickVoltage025_BMS02 m9 : 23|16@0+ (0.0001,0) [0|6.5] "V"  PT
 SG_ brickVoltage026_BMS02 m9 : 39|16@0+ (0.0001,0) [0|6.5] "V"  PT
 SG_ brickVoltage027_BMS02 m9 : 55|16@0+ (0.0001,0) [0|6.5] "V"  PT
 SG_ moduleTemperature10_BMS02 m10 : 15|8@0+ (1,-40) [-40|200] "C"  PT
 SG_ brickVoltage028_BMS02 m10 : 23|16@0+ (0.0001,0) [0|6.5] "V"  PT
 SG_ brickVoltage029_BMS02 m10 : 39|16@0+ (0.0001,0) [0|6.5] "V"  PT
 SG_ brickVoltage030_BMS02 m10 : 55|16@0+ (0.0001,0) [0|6.5] "V"  PT
 SG_ moduleTemperature11_BMS02 m11 : 15|8@0+ (1,-40) [-40|200] "C"  PT
 SG_ brickVoltage031_BMS02 m11 : 23|16@0+ (0.0001,0) [0|6.5] "V"  PT
 SG_ brickVoltage032_BMS02 m11 : 39|16@0+ (0.0001,0) [0|6.5] "V"  PT
 SG_ brickVoltage033_BMS02 m11 : 55|16@0+ (0.0001,0) [0|6.5] "V"  PT
 SG_ moduleTemperature12_BMS02 m12 : 15|8@0+ (1,-40) [-40|200] "C"  PT
 SG_ brickVoltage034_BMS02 m12 : 23|16@0+ (0.0001,0) [0|6.5] "V"  PT
 SG_ brickVoltage035_BMS02 m12 : 39|16@0+ (0.0001,0) [0|6.5] "V"  PT
 SG_ brickVoltage036_BMS02 m12 : 55|16@0+ (0.0001,0) [0|6.5] "V"  PT
 SG_ moduleTemperature13_BMS02 m13 : 15|8@0+ (1,-40) [-40|200] "C"  PT
 SG_ brickVoltage037_BMS02 m13 : 23|16@0+ (0.0001,0) [0|6.5] "V"  PT
 SG_ brickVoltage038_BMS02 m13 : 39|16@0+ (0.0001,0) [0|6.5] "V"  PT
 SG_ brickVoltage039_BMS02 m13 : 55|16@0+ (0.0001,0) [0|6.5] "V"  PT
 SG_ moduleTemperature14_BMS02 m14 : 15|8@0+ (1,-40) [-40|200] "C"  PT
 SG_ brickVoltage040_BMS02 m14 : 23|16@0+ (0.0001,0) [0|6.5] "V"  PT
 SG_ brickVoltage041_BMS02 m14 : 39|16@0+ (0.0001,0) [0|6.5] "V"  PT
 SG_ brickVoltage042_BMS02 m14 : 55|16@0+ (0.0001,0) [0|6.5] "V"  PT
 SG_ moduleTemperature15_BMS02 m15 : 15|8@0+ (1,-40) [-40|200] "C"  PT
 SG_ brickVoltage043_BMS02 m15 : 23|16@0+ (0.0001,0) [0|6.5] "V"  PT
 SG_ brickVoltage044_BMS02 m15 : 39|16@0+ (0.0001,0) [0|6.5] "V"  PT
 SG_ brickVoltage045_BMS02 m15 : 55|16@0+ (0.0001,0) [0|6.5] "V"  PT
 SG_ moduleTemperature16_BMS02 m16 : 15|8@0+ (1,-40) [-40|200] "C"  PT
 SG_ brickVoltage046_BMS02 m16 : 23|16@0+ (0.0001,0) [0|6.5] "V"  PT
 SG_ brickVoltage047_BMS02 m16 : 39|16@0+ (0.0001,0) [0|6.5] "V"  PT
 SG_ brickVoltage048_BMS02 m16 : 55|16@0+ (0.0001,0) [0|6.5] "V"  PT
 SG_ moduleTemperature17_BMS02 m17 : 15|8@0+ (1,-40) [-40|200] "C"  PT
 SG_ brickVoltage049_BMS02 m17 : 23|16@0+ (0.0001,0) [0|6.5] "V"  PT
 SG_ brickVoltage050_BMS02 m17 : 39|16@0+ (0.0001,0) [0|6.5] "V"  PT
 SG_ brickVoltage051_BMS02 m17 : 55|16@0+ (0.0001,0) [0|6.5] "V"  PT
 SG_ moduleTemperature18_BMS02 m18 : 15|8@0+ (1,-40) [-40|200] "C"  PT
 SG_ brickVoltage052_BMS02 m18 : 23|16@0+ (0.0001,0) [0|6.5] "V"  PT
 SG_ brickVoltage053_BMS02 m18 : 39|16@0+ (0.0001,0) [0|6.5] "V"  PT
 SG_ brickVoltage054_BMS02 m18 : 55|16@0+ (0.0001,0) [0|6.5] "V"  PT
 SG_ moduleTemperature19_BMS02 m19 : 15|8@0+ (1,-40) [-40|200] "C"  PT
 SG_ brickVoltage055_BMS02 m19 : 23|16@0+ (0.0001,0) [0|6.5] "V"  PT
 SG_ brickVoltage056_BMS02 m19 : 39|16@0+ (0.0001,0) [0|6.5] "V"  PT
 SG_ brickVoltage057_BMS02 m19 : 55|16@0+ (0.0001,0) [0|6.5] "V"  PT
 SG_ moduleTemperature20_BMS02 m20 : 15|8@0+ (1,-40) [-40|200] "C"  PT
 SG_ brickVoltage058_BMS02 m20 : 23|16@0+ (0.0001,0) [0|6.5] "V"  PT
 SG_ brickVoltage059_BMS02 m20 : 39|16@0+ (0.0001,0) [0|6.5] "V"  PT
 SG_ brickVoltage060_BMS02 m20 : 55|16@0+ (0.0001,0) [0|6.5] "V"  PT
 SG_ moduleTemperature21_BMS02 m21 : 15|8@0+ (1,-40) [-40|200] "C"  PT
 SG_ brickVoltage061_BMS02 m21 : 23|16@0+ (0.0001,0) [0|6.5] "V"  PT
 SG_ brickVoltage062_BMS02 m21 : 39|16@0+ (0.0001,0) [0|6.5] "V"  PT
 SG_ brickVoltage063_BMS02 m21 : 55|16@0+ (0.0001,0) [0|6.5] "V"  PT
 SG_ moduleTemperature22_BMS02 m22 : 15|8@0+ (1,-40) [-40|200] "C"  PT
 SG_ brickVoltage064_BMS02 m22 : 23|16@0+ (0.0001,0) [0|6.5] "V"  PT
 SG_ brickVoltage065_BMS02 m22 : 39|16@0+ (0.0001,0) [0|6.5] "V"  PT
 SG_ brickVoltage066_BMS02 m22 : 55|16@0+ (0.0001,0) [0|6.5] "V"  PT
 SG_ moduleTemperature23_BMS02 m23 : 15|8@0+ (1,-40) [-40|200] "C"  PT
 SG_ brickVoltage067_BMS02 m23 : 23|16@0+ (0.0001,0) [0|6.5] "V"  PT
 SG_ brickVoltage068_BMS02 m23 : 39|16@0+ (0.0001,0) [0|6.5] "V"  PT
 SG_ brickVoltage069_BMS02 m23 : 55|16@0+ (0.0001,0) [0|6.5] "V"  PT
 SG_ moduleTemperature24_BMS02 m24 : 15|8@0+ (1,-40) [-40|200] "C"  PT
 SG_ brickVoltage070_BMS02 m24 : 23|16@0+ (0.0001,0) [0|6.5] "V"  PT
 SG_ brickVoltage071_BMS02 m24 : 39|16@0+ (0.0001,0) [0|6.5] "V"  PT
 SG_ brickVoltage072_BMS02 m24 : 55|16@0+ (0.0001,0) [0|6.5] "V"  PT
 SG_ moduleTemperature25_BMS02 m25 : 15|8@0+ (1,-40) [-40|200] "C"  PT
 SG_ brickVoltage073_BMS02 m25 : 23|16@0+ (0.0001,0) [0|6.5] "V"  PT
 SG_ brickVoltage074_BMS02 m25 : 39|16@0+ (0.0001,0) [0|6.5] "V"  PT
 SG_ brickVoltage075_BMS02 m25 : 55|16@0+ (0.0001,0) [0|6.5] "V"  PT
 SG_ moduleTemperature26_BMS02 m26 : 15|8@0+ (1,-40) [-40|200] "C"  PT
 SG_ brickVoltage076_BMS02 m26 : 23|16@0+ (0.0001,0) [0|6.5] "V"  PT
 SG_ brickVoltage077_BMS02 m26 : 39|16@0+ (0.0001,0) [0|6.5] "V"  PT
 SG_ brickVoltage078_BMS02 m26 : 55|16@0+ (0.0001,0) [0|6.5] "V"  PT
 SG_ moduleTemperature27_BMS02 m27 : 15|8@0+ (1,-40) [-40|200] "C"  PT
 SG_ brickVoltage079_BMS02 m27 : 23|16@0+ (0.0001,0) [0|6.5] "V"  PT
 SG_ brickVoltage080_BMS02 m27 : 39|16@0+ (0.0001,0) [0|6.5] "V"  PT
 SG_ brickVoltage081_BMS02 m27 : 55|16@0+ (0.0001,0) [0|6.5] "V"  PT
 SG_ moduleTemperature28_BMS02 m28 : 15|8@0+ (1,-40) [-40|200] "C"  PT
 SG_ brickVoltage082_BMS02 m28 : 23|16@0+ (0.0001,0) [0|6.5] "V"  PT
 SG_ brickVoltage083_BMS02 m28 : 39|16@0+ (0.0001,0) [0|6.5] "V"  PT
 SG_ brickVoltage084_BMS02 m28 : 55|16@0+ (0.0001,0) [0|6.5] "V"  PT
 SG_ moduleTemperature29_BMS02 m29 : 15|8@0+ (1,-40) [-40|200] "C"  PT
 SG_ brickVoltage085_BMS02 m29 : 23|16@0+ (0.0001,0) [0|6.5] "V"  PT
 SG_ brickVoltage086_BMS02 m29 : 39|16@0+ (0.0001,0) [0|6.5] "V"  PT
 SG_ brickVoltage087_BMS02 m29 : 55|16@0+ (0.0001,0) [0|6.5] "V"  PT
 SG_ moduleTemperature30_BMS02 m30 : 15|8@0+ (1,-40) [-40|200] "C"  PT
 SG_ brickVoltage088_BMS02 m30 : 23|16@0+ (0.0001,0) [0|6.5] "V"  PT
 SG_ brickVoltage089_BMS02 m30 : 39|16@0+ (0.0001,0) [0|6.5] "V"  PT
 SG_ brickVoltage090_BMS02 m30 : 55|16@0+ (0.0001,0) [0|6.5] "V"  PT
 SG_ moduleTemperature31_BMS02 m31 : 15|8@0+ (1,-40) [-40|200] "C"  PT
 SG_ brickVoltage091_BMS02 m31 : 23|16@0+ (0.0001,0) [0|6.5] "V"  PT
 SG_ brickVoltage092_BMS02 m31 : 39|16@0+ (0.0001,0) [0|6.5] "V"  PT
 SG_ brickVoltage093_BMS02 m31 : 55|16@0+ (0.0001,0) [0|6.5] "V"  PT
 SG_ moduleTemperature32_BMS02 m32 : 15|8@0+ (1,-40) [-40|200] "C"  PT
 SG_ brickVoltage094_BMS02 m32 : 23|16@0+ (0.0001,0) [0|6.5] "V"  PT
 SG_ brickVoltage095_BMS02 m32 : 39|16@0+ (0.0001,0) [0|6.5] "V"  PT
 SG_ brickVoltage096_BMS02 m32 : 55|16@0+ (0.0001,0) [0|6.5] "V"  PT
 SG_ brickVoltage097_BMS02 m33 : 23|16@0+ (0.0001,0) [0|6.5] "V"  PT
 SG_ brickVoltage098_BMS02 m33 : 39|16@0+ (0.0001,0) [0|6.5] "V"  PT
 SG_ brickVoltage099_BMS02 m33 : 55|16@0+ (0.0001,0) [0|6.5] "V"  PT
 SG_ brickVoltage100_BMS02 m34 : 23|16@0+ (0.0001,0) [0|6.5] "V"  PT
 SG_ brickVoltage101_BMS02 m34 : 39|16@0+ (0.0001,0) [0|6.5] "V"  PT
 SG_ brickVoltage102_BMS02 m34 : 55|16@0+ (0.0001,0) [0|6.5] "V"  PT
 SG_ brickVoltage103_BMS02 m35 : 23|16@0+ (0.0001,0) [0|6.5] "V"  PT
 SG_ brickVoltage104_BMS02 m35 : 39|16@0+ (0.0001,0) [0|6.5] "V"  PT
 SG_ brickVoltage105_BMS02 m35 : 55|16@0+ (0.0001,0) [0|6.5] "V"  PT
 SG_ brickVoltage106_BMS02 m36 : 23|16@0+ (0.0001,0) [0|6.5] "V"  PT
 SG_ brickVoltage107_BMS02 m36 : 39|16@0+ (0.0001,0) [0|6.5] "V"  PT
 SG_ brickVoltage108_BMS02 m36 : 55|16@0+ (0.0001,0) [0|6.5] "V"  PT
 SG_ brickVoltage109_BMS02 m37 : 23|16@0+ (0.0001,0) [0|6.5] "V"  PT
 SG_ brickVoltage110_BMS02 m37 : 39|16@0+ (0.0001,0) [0|6.5] "V"  PT
 SG_ brickVoltage111_BMS02 m37 : 55|16@0+ (0.0001,0) [0|6.5] "V"  PT
 SG_ brickVoltage112_BMS02 m38 : 23|16@0+ (0.0001,0) [0|6.5] "V"  PT
 SG_ brickVoltage113_BMS02 m38 : 39|16@0+ (0.0001,0) [0|6.5] "V"  PT
 SG_ brickVoltage114_BMS02 m38 : 55|16@0+ (0.0001,0) [0|6.5] "V"  PT
 SG_ brickVoltage115_BMS02 m39 : 23|16@0+ (0.0001,0) [0|6.5] "V"  PT
 SG_ brickVoltage116_BMS02 m39 : 39|16@0+ (0.0001,0) [0|6.5] "V"  PT
 SG_ brickVoltage117_BMS02 m39 : 55|16@0+ (0.0001,0) [0|6.5] "V"  PT
 SG_ brickVoltage118_BMS02 m40 : 23|16@0+ (0.0001,0) [0|6.5] "V"  PT
 SG_ brickVoltage119_BMS02 m40 : 39|16@0+ (0.0001,0) [0|6.5] "V"  PT
 SG_ brickVoltage120_BMS02 m40 : 55|16@0+ (0.0001,0) [0|6.5] "V"  PT
 SG_ brickVoltage121_BMS02 m41 : 23|16@0+ (0.0001,0) [0|6.5] "V"  PT
 SG_ brickVoltage122_BMS02 m41 : 39|16@0+ (0.0001,0) [0|6.5] "V"  PT
 SG_ brickVoltage123_BMS02 m41 : 55|16@0+ (0.0001,0) [0|6.5] "V"  PT
 SG_ brickVoltage124_BMS02 m42 : 23|16@0+ (0.0001,0) [0|6.5] "V"  PT
 SG_ brickVoltage125_BMS02 m42 : 39|16@0+ (0.0001,0) [0|6.5] "V"  PT
 SG_ brickVoltage126_BMS02 m42 : 55|16@0+ (0.0001,0) [0|6.5] "V"  PT
 SG_ brickVoltage127_BMS02 m43 : 23|16@0+ (0.0001,0) [0|6.5] "V"  PT
 SG_ brickVoltage128_BMS02 m43 : 39|16@0+ (0.0001,0) [0|6.5] "V"  PT
 SG_ brickVoltage129_BMS02 m43 : 55|16@0+ (0.0001,0) [0|6.5] "V"  PT
 SG_ brickVoltage130_BMS02 m44 : 23|16@0+ (0.0001,0) [0|6.5] "V"  PT
 SG_ brickVoltage131_BMS02 m44 : 39|16@0+ (0.0001,0) [0|6.5] "V"  PT
 SG_ brickVoltage132_BMS02 m44 : 55|16@0+ (0.0001,0) [0|6.5] "V"  PT
 SG_ brickVoltage133_BMS02 m45 : 23|16@0+ (0.0001,0) [0|6.5] "V"  PT
 SG_ brickVoltage134_BMS02 m45 : 39|16@0+ (0.0001,0) [0|6.5] "V"  PT
 SG_ brickVoltage135_BMS02 m45 : 55|16@0+ (0.0001,0) [0|6.5] "V"  PT
 SG_ brickVoltage136_BMS02 m46 : 23|16@0+ (0.0001,0) [0|6.5] "V"  PT
 SG_ brickVoltage137_BMS02 m46 : 39|16@0+ (0.0001,0) [0|6.5] "V"  PT
 SG_ brickVoltage138_BMS02 m46 : 55|16@0+ (0.0001,0) [0|6.5] "V"  PT
 SG_ brickVoltage139_BMS02 m47 : 23|16@0+ (0.0001,0) [0|6.5] "V"  PT
 SG_ brickVoltage140_BMS02 m47 : 39|16@0+ (0.0001,0) [0|6.5] "V"  PT
 SG_ brickVoltage141_BMS02 m47 : 55|16@0+ (0.0001,0) [0|6.5] "V"  PT
 SG_ brickVoltage142_BMS02 m48 : 23|16@0+ (0.0001,0) [0|6.5] "V"  PT
 SG_ brickVoltage143_BMS02 m48 : 39|16@0+ (0.0001,0) [0|6.5] "V"  PT
 SG_ brickVoltage144_BMS02 m48 : 55|16@0+ (0.0001,0) [0|6.5] "V"  PT
 SG_ brickVoltage145_BMS02 m49 : 23|16@0+ (0.0001,0) [0|6.5] "V"  PT
 SG_ brickVoltage146_BMS02 m49 : 39|16@0+ (0.0001,0) [0|6.5] "V"  PT
 SG_ brickVoltage147_BMS02 m49 : 55|16@0+ (0.0001,0) [0|6.5] "V"  PT
 SG_ brickVoltage148_BMS02 m50 : 23|16@0+ (0.0001,0) [0|6.5] "V"  PT
 SG_ brickVoltage149_BMS02 m50 : 39|16@0+ (0.0001,0) [0|6.5] "V"  PT
 SG_ brickVoltage150_BMS02 m50 : 55|16@0+ (0.0001,0) [0|6.5] "V"  PT
 SG_ brickVoltage151_BMS02 m51 : 23|16@0+ (0.0001,0) [0|6.5] "V"  PT
 SG_ brickVoltage152_BMS02 m51 : 39|16@0+ (0.0001,0) [0|6.5] "V"  PT
 SG_ brickVoltage153_BMS02 m51 : 55|16@0+ (0.0001,0) [0|6.5] "V"  PT
 SG_ brickVoltage154_BMS02 m52 : 23|16@0+ (0.0001,0) [0|6.5] "V"  PT
 SG_ brickVoltage155_BMS02 m52 : 39|16@0+ (0.0001,0) [0|6.5] "V"  PT
 SG_ brickVoltage156_BMS02 m52 : 55|16@0+ (0.0001,0) [0|6.5] "V"  PT
 SG_ brickVoltage157_BMS02 m53 : 23|16@0+ (0.0001,0) [0|6.5] "V"  PT
 SG_ brickVoltage158_BMS02 m53 : 39|16@0+ (0.0001,0) [0|6.5] "V"  PT
 SG_ brickVoltage159_BMS02 m53 : 55|16@0+ (0.0001,0) [0|6.5] "V"  PT
 SG_ brickVoltage160_BMS02 m54 : 23|16@0+ (0.0001,0) [0|6.5] "V"  PT
 SG_ brickVoltage161_BMS02 m54 : 39|16@0+ (0.0001,0) [0|6.5] "V"  PT
 SG_ brickVoltage162_BMS02 m54 : 55|16@0+ (0.0001,0) [0|6.5] "V"  PT
 SG_ brickVoltage163_BMS02 m55 : 23|16@0+ (0.0001,0) [0|6.5] "V"  PT
 SG_ brickVoltage164_BMS02 m55 : 39|16@0+ (0.0001,0) [0|6.5] "V"  PT
 SG_ brickVoltage165_BMS02 m55 : 55|16@0+ (0.0001,0) [0|6.5] "V"  PT
 SG_ brickVoltage166_BMS02 m56 : 23|16@0+ (0.0001,0) [0|6.5] "V"  PT
 SG_ brickVoltage167_BMS02 m56 : 39|16@0+ (0.0001,0) [0|6.5] "V"  PT
 SG_ brickVoltage168_BMS02 m56 : 55|16@0+ (0.0001,0) [0|6.5] "V"  PT
 SG_ brickVoltage169_BMS02 m57 : 23|16@0+ (0.0001,0) [0|6.5] "V"  PT
 SG_ brickVoltage170_BMS02 m57 : 39|16@0+ (0.0001,0) [0|6.5] "V"  PT
 SG_ brickVoltage171_BMS02 m57 : 55|16@0+ (0.0001,0) [0|6.5] "V"  PT
 SG_ brickVoltage172_BMS02 m58 : 23|16@0+ (0.0001,0) [0|6.5] "V"  PT
 SG_ brickVoltage173_BMS02 m58 : 39|16@0+ (0.0001,0) [0|6.5] "V"  PT
 SG_ brickVoltage174_BMS02 m58 : 55|16@0+ (0.0001,0) [0|6.5] "V"  PT
 SG_ brickVoltage175_BMS02 m59 : 23|16@0+ (0.0001,0) [0|6.5] "V"  PT
 SG_ brickVoltage176_BMS02 m59 : 39|16@0+ (0.0001,0) [0|6.5] "V"  PT
 SG_ brickVoltage177_BMS02 m59 : 55|16@0+ (0.0001,0) [0|6.5] "V"  PT
 SG_ brickVoltage178_BMS02 m60 : 23|16@0+ (0.0001,0) [0|6.5] "V"  PT
 SG_ brickVoltage179_BMS02 m60 : 39|16@0+ (0.0001,0) [0|6.5] "V"  PT
 SG_ brickVoltage180_BMS02 m60 : 55|16@0+ (0.0001,0) [0|6.5] "V"  PT
 SG_ brickVoltage181_BMS02 m61 : 23|16@0+ (0.0001,0) [0|6.5] "V"  PT
 SG_ brickVoltage182_BMS02 m61 : 39|16@0+ (0.0001,0) [0|6.5] "V"  PT
 SG_ brickVoltage183_BMS02 m61 : 55|16@0+ (0.0001,0) [0|6.5] "V"  PT
 SG_ brickVoltage184_BMS02 m62 : 23|16@0+ (0.0001,0) [0|6.5] "V"  PT
 SG_ brickVoltage185_BMS02 m62 : 39|16@0+ (0.0001,0) [0|6.5] "V"  PT
 SG_ brickVoltage186_BMS02 m62 : 55|16@0+ (0.0001,0) [0|6.5] "V"  PT
 SG_ brickVoltage187_BMS02 m63 : 23|16@0+ (0.0001,0) [0|6.5] "V"  PT
 SG_ brickVoltage188_BMS02 m63 : 39|16@0+ (0.0001,0) [0|6.5] "V"  PT
 SG_ brickVoltage189_BMS02 m63 : 55|16@0+ (0.0001,0) [0|6.5] "V"  PT
 SG_ brickVoltage190_BMS02 m64 : 23|16@0+ (0.0001,0) [0|6.5] "V"  PT
 SG_ brickVoltage191_BMS02 m64 : 39|16@0+ (0.0001,0) [0|6.5] "V"  PT
 SG_ brickVoltage192_BMS02 m64 : 55|16@0+ (0.0001,0) [0|6.5] "V"  PT
 SG_ brickVoltage193_BMS02 m65 : 23|16@0+ (0.0001,0) [0|6.5] "V"  PT
 SG_ brickVoltage194_BMS02 m65 : 39|16@0+ (0.0001,0) [0|6.5] "V"  PT
 SG_ brickVoltage195_BMS02 m65 : 55|16@0+ (0.0001,0) [0|6.5] "V"  PT
 SG_ brickVoltage196_BMS02 m66 : 23|16@0+ (0.0001,0) [0|6.5] "V"  PT
 SG_ brickVoltage197_BMS02 m66 : 39|16@0+ (0.0001,0) [0|6.5] "V"  PT
 SG_ brickVoltage198_BMS02 m66 : 55|16@0+ (0.0001,0) [0|6.5] "V"  PT
 SG_ brickVoltage199_BMS02 m67 : 23|16@0+ (0.0001,0) [0|6.5] "V"  PT
 SG_ brickVoltage200_BMS02 m67 : 39|16@0+ (0.0001,0) [0|6.5] "V"  PT
 SG_ brickVoltage201_BMS02 m67 : 55|16@0+ (0.0001,0) [0|6.5] "V"  PT
 SG_ brickVoltage202_BMS02 m68 : 23|16@0+ (0.0001,0) [0|6.5] "V"  PT
 SG_ brickVoltage203_BMS02 m68 : 39|16@0+ (0.0001,0) [0|6.5] "V"  PT
 SG_ brickVoltage204_BMS02 m68 : 55|16@0+ (0.0001,0) [0|6.5] "V"  PT
 SG_ brickVoltage205_BMS02 m69 : 23|16@0+ (0.0001,0) [0|6.5] "V"  PT
 SG_ brickVoltage206_BMS02 m69 : 39|16@0+ (0.0001,0) [0|6.5] "V"  PT
 SG_ brickVoltage207_BMS02 m69 : 55|16@0+ (0.0001,0) [0|6.5] "V"  PT
 SG_ brickVoltage208_BMS02 m70 : 23|16@0+ (0.0001,0) [0|6.5] "V"  PT
 SG_ brickVoltage209_BMS02 m70 : 39|16@0+ (0.0001,0) [0|6.5] "V"  PT
 SG_ brickVoltage210_BMS02 m70 : 55|16@0+ (0.0001,0) [0|6.5] "V"  PT
 SG_ brickVoltage211_BMS02 m71 : 23|16@0+ (0.0001,0) [0|6.5] "V"  PT
 SG_ brickVoltage212_BMS02 m71 : 39|16@0+ (0.0001,0) [0|6.5] "V"  PT
 SG_ brickVoltage213_BMS02 m71 : 55|16@0+ (0.0001,0) [0|6.5] "V"  PT
 SG_ brickVoltage214_BMS02 m72 : 23|16@0+ (0.0001,0) [0|6.5] "V"  PT
 SG_ brickVoltage215_BMS02 m72 : 39|16@0+ (0.0001,0) [0|6.5] "V"  PT
 SG_ brickVoltage216_BMS02 m72 : 55|16@0+ (0.0001,0) [0|6.5] "V"  PT
 SG_ brickVoltage217_BMS02 m73 : 23|16@0+ (0.0001,0) [0|6.5] "V"  PT
 SG_ brickVoltage218_BMS02 m73 : 39|16@0+ (0.0001,0) [0|6.5] "V"  PT
 SG_ brickVoltage219_BMS02 m73 : 55|16@0+ (0.0001,0) [0|6.5] "V"  PT
 SG_ brickVoltage220_BMS02 m74 : 23|16@0+ (0.0001,0) [0|6.5] "V"  PT
 SG_ brickVoltage221_BMS02 m74 : 39|16@0+ (0.0001,0) [0|6.5] "V"  PT
 SG_ brickVoltage222_BMS02 m74 : 55|16@0+ (0.0001,0) [0|6.5] "V"  PT
 SG_ brickVoltage223_BMS02 m75 : 23|16@0+ (0.0001,0) [0|6.5] "V"  PT
 SG_ brickVoltage224_BMS02 m75 : 39|16@0+ (0.0001,0) [0|6.5] "V"  PT
 SG_ brickVoltage225_BMS02 m75 : 55|16@0+ (0.0001,0) [0|6.5] "V"  PT
 SG_ brickVoltage226_BMS02 m76 : 23|16@0+ (0.0001,0) [0|6.5] "V"  PT
 SG_ brickVoltage227_BMS02 m76 : 39|16@0+ (0.0001,0) [0|6.5] "V"  PT
 SG_ brickVoltage228_BMS02 m76 : 55|16@0+ (0.0001,0) [0|6.5] "V"  PT
 SG_ brickVoltage229_BMS02 m77 : 23|16@0+ (0.0001,0) [0|6.5] "V"  PT
 SG_ brickVoltage230_BMS02 m77 : 39|16@0+ (0.0001,0) [0|6.5] "V"  PT
 SG_ brickVoltage231_BMS02 m77 : 55|16@0+ (0.0001,0) [0|6.5] "V"  PT
 SG_ brickVoltage232_BMS02 m78 : 23|16@0+ (0.0001,0) [0|6.5] "V"  PT
 SG_ brickVoltage233_BMS02 m78 : 39|16@0+ (0.0001,0) [0|6.5] "V"  PT
 SG_ brickVoltage234_BMS02 m78 : 55|16@0+ (0.0001,0) [0|6.5] "V"  PT
 SG_ brickVoltage235_BMS02 m79 : 23|16@0+ (0.0001,0) [0|6.5] "V"  PT
 SG_ brickVoltage236_BMS02 m79 : 39|16@0+ (0.0001,0) [0|6.5] "V"  PT
 SG_ brickVoltage237_BMS02 m79 : 55|16@0+ (0.0001,0) [0|6.5] "V"  PT
 SG_ brickVoltage238_BMS02 m80 : 23|16@0+ (0.0001,0) [0|6.5] "V"  PT
 SG_ brickVoltage239_BMS02 m80 : 39|16@0+ (0.0001,0) [0|6.5] "V"  PT
 SG_ brickVoltage240_BMS02 m80 : 55|16@0+ (0.0001,0) [0|6.5] "V"  PT
 SG_ brickVoltage241_BMS02 m81 : 23|16@0+ (0.0001,0) [0|6.5] "V"  PT
 SG_ brickVoltage242_BMS02 m81 : 39|16@0+ (0.0001,0) [0|6.5] "V"  PT
 SG_ brickVoltage243_BMS02 m81 : 55|16@0+ (0.0001,0) [0|6.5] "V"  PT
 SG_ brickVoltage244_BMS02 m82 : 23|16@0+ (0.0001,0) [0|6.5] "V"  PT
 SG_ brickVoltage245_BMS02 m82 : 39|16@0+ (0.0001,0) [0|6.5] "V"  PT
 SG_ brickVoltage246_BMS02 m82 : 55|16@0+ (0.0001,0) [0|6.5] "V"  PT
 SG_ brickVoltage247_BMS02 m83 : 23|16@0+ (0.0001,0) [0|6.5] "V"  PT
 SG_ brickVoltage248_BMS02 m83 : 39|16@0+ (0.0001,0) [0|6.5] "V"  PT
 SG_ brickVoltage249_BMS02 m83 : 55|16@0+ (0.0001,0) [0|6.5] "V"  PT
 SG_ brickVoltage250_BMS02 m84 : 23|16@0+ (0.0001,0) [0|6.5] "V"  PT
 SG_ brickVoltage251_BMS02 m84 : 39|16@0+ (0.0001,0) [0|6.5] "V"  PT
 SG_ brickVoltage252_BMS02 m84 : 55|16@0+ (0.0001,0) [0|6.5] "V"  PT
 SG_ brickVoltage253_BMS02 m85 : 23|16@0+ (0.0001,0) [0|6.5] "V"  PT
 SG_ brickVoltage254_BMS02 m85 : 39|16@0+ (0.0001,0) [0|6.5] "V"  PT
 SG_ brickVoltage255_BMS02 m85 : 55|16@0+ (0.0001,0) [0|6.5] "V"  PT
 SG_ brickVoltage256_BMS02 m86 : 23|16@0+ (0.0001,0) [0|6.5] "V"  PT
 SG_ brickVoltage257_BMS02 m86 : 39|16@0+ (0.0001,0) [0|6.5] "V"  PT
 SG_ brickVoltage258_BMS02 m86 : 55|16@0+ (0.0001,0) [0|6.5] "V"  PT
 SG_ brickVoltage259_BMS02 m87 : 23|16@0+ (0.0001,0) [0|6.5] "V"  PT
 SG_ brickVoltage260_BMS02 m87 : 39|16@0+ (0.0001,0) [0|6.5] "V"  PT
 SG_ brickVoltage261_BMS02 m87 : 55|16@0+ (0.0001,0) [0|6.5] "V"  PT
 SG_ brickVoltage262_BMS02 m88 : 23|16@0+ (0.0001,0) [0|6.5] "V"  PT
 SG_ brickVoltage263_BMS02 m88 : 39|16@0+ (0.0001,0) [0|6.5] "V"  PT
 SG_ brickVoltage264_BMS02 m88 : 55|16@0+ (0.0001,0) [0|6.5] "V"  PT
 SG_ brickVoltage265_BMS02 m89 : 23|16@0+ (0.0001,0) [0|6.5] "V"  PT
 SG_ brickVoltage266_BMS02 m89 : 39|16@0+ (0.0001,0) [0|6.5] "V"  PT
 SG_ brickVoltage267_BMS02 m89 : 55|16@0+ (0.0001,0) [0|6.5] "V"  PT
 SG_ brickVoltage268_BMS02 m90 : 23|16@0+ (0.0001,0) [0|6.5] "V"  PT
 SG_ brickVoltage269_BMS02 m90 : 39|16@0+ (0.0001,0) [0|6.5] "V"  PT
 SG_ brickVoltage270_BMS02 m90 : 55|16@0+ (0.0001,0) [0|6.5] "V"  PT
 SG_ brickVoltage271_BMS02 m91 : 23|16@0+ (0.0001,0) [0|6.5] "V"  PT
 SG_ brickVoltage272_BMS02 m91 : 39|16@0+ (0.0001,0) [0|6.5] "V"  PT
 SG_ brickVoltage273_BMS02 m91 : 55|16@0+ (0.0001,0) [0|6.5] "V"  PT
 SG_ brickVoltage274_BMS02 m92 : 23|16@0+ (0.0001,0) [0|6.5] "V"  PT
 SG_ brickVoltage275_BMS02 m92 : 39|16@0+ (0.0001,0) [0|6.5] "V"  PT
 SG_ brickVoltage276_BMS02 m92 : 55|16@0+ (0.0001,0) [0|6.5] "V"  PT
 SG_ brickVoltage277_BMS02 m93 : 23|16@0+ (0.0001,0) [0|6.5] "V"  PT
 SG_ brickVoltage278_BMS02 m93 : 39|16@0+ (0.0001,0) [0|6.5] "V"  PT
 SG_ brickVoltage279_BMS02 m93 : 55|16@0+ (0.0001,0) [0|6.5] "V"  PT
 SG_ brickVoltage280_BMS02 m94 : 23|16@0+ (0.0001,0) [0|6.5] "V"  PT
 SG_ brickVoltage281_BMS02 m94 : 39|16@0+ (0.0001,0) [0|6.5] "V"  PT
 SG_ brickVoltage282_BMS02 m94 : 55|16@0+ (0.0001,0) [0|6.5] "V"  PT
 SG_ brickVoltage283_BMS02 m95 : 23|16@0+ (0.0001,0) [0|6.5] "V"  PT
 SG_ brickVoltage284_BMS02 m95 : 39|16@0+ (0.0001,0) [0|6.5] "V"  PT
 SG_ brickVoltage285_BMS02 m95 : 55|16@0+ (0.0001,0) [0|6.5] "V"  PT
 SG_ brickVoltage286_BMS02 m96 : 23|16@0+ (0.0001,0) [0|6.5] "V"  PT
 SG_ brickVoltage287_BMS02 m96 : 39|16@0+ (0.0001,0) [0|6.5] "V"  PT
 SG_ brickVoltage288_BMS02 m96 : 55|16@0+ (0.0001,0) [0|6.5] "V"  PT
 SG_ brickVoltage289_BMS02 m97 : 23|16@0+ (0.0001,0) [0|6.5] "V"  PT
 SG_ brickVoltage290_BMS02 m97 : 39|16@0+ (0.0001,0) [0|6.5] "V"  PT
 SG_ brickVoltage291_BMS02 m97 : 55|16@0+ (0.0001,0) [0|6.5] "V"  PT
 SG_ brickVoltage292_BMS02 m98 : 23|16@0+ (0.0001,0) [0|6.5] "V"  PT
 SG_ brickVoltage293_BMS02 m98 : 39|16@0+ (0.0001,0) [0|6.5] "V"  PT
 SG_ brickVoltage294_BMS02 m98 : 55|16@0+ (0.0001,0) [0|6.5] "V"  PT
 SG_ brickVoltage295_BMS02 m99 : 23|16@0+ (0.0001,0) [0|6.5] "V"  PT
 SG_ brickVoltage296_BMS02 m99 : 39|16@0+ (0.0001,0) [0|6.5] "V"  PT
 SG_ brickVoltage297_BMS02 m99 : 55|16@0+ (0.0001,0) [0|6.5] "V"  PT
 SG_ brickVoltage298_BMS02 m100 : 23|16@0+ (0.0001,0) [0|6.5] "V"  PT
 SG_ brickVoltage299_BMS02 m100 : 39|16@0+ (0.0001,0) [0|6.5] "V"  PT
 SG_ brickVoltage300_BMS02 m100 : 55|16@0+ (0.0001,0) [0|6.5] "V"  PT
 SG_ moduleTemperature33_BMS02 m33 : 15|8@0+ (1,-40) [-40|200] "C"  PT
 SG_ moduleTemperature34_BMS02 m34 : 15|8@0+ (1,-40) [-40|200] "C"  PT
 SG_ moduleTemperature35_BMS02 m35 : 15|8@0+ (1,-40) [-40|200] "C"  PT
 SG_ moduleTemperature36_BMS02 m36 : 15|8@0+ (1,-40) [-40|200] "C"  PT
 SG_ moduleTemperature37_BMS02 m37 : 15|8@0+ (1,-40) [-40|200] "C"  PT
 SG_ moduleTemperature38_BMS02 m38 : 15|8@0+ (1,-40) [-40|200] "C"  PT
 SG_ moduleTemperature39_BMS02 m39 : 15|8@0+ (1,-40) [-40|200] "C"  PT
 SG_ moduleTemperature40_BMS02 m40 : 15|8@0+ (1,-40) [-40|200] "C"  PT
 SG_ moduleTemperature41_BMS02 m41 : 15|8@0+ (1,-40) [-40|200] "C"  PT
 SG_ moduleTemperature42_BMS02 m42 : 15|8@0+ (1,-40) [-40|200] "C"  PT
 SG_ moduleTemperature43_BMS02 m43 : 15|8@0+ (1,-40) [-40|200] "C"  PT
 SG_ moduleTemperature44_BMS02 m44 : 15|8@0+ (1,-40) [-40|200] "C"  PT
 SG_ moduleTemperature45_BMS02 m45 : 15|8@0+ (1,-40) [-40|200] "C"  PT
 SG_ moduleTemperature46_BMS02 m46 : 15|8@0+ (1,-40) [-40|200] "C"  PT
 SG_ moduleTemperature47_BMS02 m47 : 15|8@0+ (1,-40) [-40|200] "C"  PT
 SG_ moduleTemperature48_BMS02 m48 : 15|8@0+ (1,-40) [-40|200] "C"  PT
 SG_ moduleTemperature49_BMS02 m49 : 15|8@0+ (1,-40) [-40|200] "C"  PT
 SG_ moduleTemperature50_BMS02 m50 : 15|8@0+ (1,-40) [-40|200] "C"  PT
 SG_ moduleTemperature51_BMS02 m51 : 15|8@0+ (1,-40) [-40|200] "C"  PT
 SG_ moduleTemperature52_BMS02 m52 : 15|8@0+ (1,-40) [-40|200] "C"  PT
 SG_ moduleTemperature53_BMS02 m53 : 15|8@0+ (1,-40) [-40|200] "C"  PT
 SG_ moduleTemperature54_BMS02 m54 : 15|8@0+ (1,-40) [-40|200] "C"  PT
 SG_ moduleTemperature55_BMS02 m55 : 15|8@0+ (1,-40) [-40|200] "C"  PT
 SG_ moduleTemperature56_BMS02 m56 : 15|8@0+ (1,-40) [-40|200] "C"  PT
 SG_ moduleTemperature57_BMS02 m57 : 15|8@0+ (1,-40) [-40|200] "C"  PT
 SG_ moduleTemperature58_BMS02 m58 : 15|8@0+ (1,-40) [-40|200] "C"  PT
 SG_ moduleTemperature59_BMS02 m59 : 15|8@0+ (1,-40) [-40|200] "C"  PT
 SG_ moduleTemperature60_BMS02 m60 : 15|8@0+ (1,-40) [-40|200] "C"  PT
 SG_ moduleTemperature61_BMS02 m61 : 15|8@0+ (1,-40) [-40|200] "C"  PT
 SG_ moduleTemperature62_BMS02 m62 : 15|8@0+ (1,-40) [-40|200] "C"  PT
 SG_ moduleTemperature63_BMS02 m63 : 15|8@0+ (1,-40) [-40|200] "C"  PT
 SG_ moduleTemperature64_BMS02 m64 : 15|8@0+ (1,-40) [-40|200] "C"  PT
 SG_ moduleTemperature65_BMS02 m65 : 15|8@0+ (1,-40) [-40|200] "C"  PT
 SG_ moduleTemperature66_BMS02 m66 : 15|8@0+ (1,-40) [-40|200] "C"  PT
 SG_ moduleTemperature67_BMS02 m67 : 15|8@0+ (1,-40) [-40|200] "C"  PT
 SG_ moduleTemperature68_BMS02 m68 : 15|8@0+ (1,-40) [-40|200] "C"  PT
 SG_ moduleTemperature69_BMS02 m69 : 15|8@0+ (1,-40) [-40|200] "C"  PT
 SG_ moduleTemperature70_BMS02 m70 : 15|8@0+ (1,-40) [-40|200] "C"  PT
 SG_ moduleTemperature71_BMS02 m71 : 15|8@0+ (1,-40) [-40|200] "C"  PT
 SG_ moduleTemperature72_BMS02 m72 : 15|8@0+ (1,-40) [-40|200] "C"  PT
 SG_ moduleTemperature73_BMS02 m73 : 15|8@0+ (1,-40) [-40|200] "C"  PT
 SG_ moduleTemperature74_BMS02 m74 : 15|8@0+ (1,-40) [-40|200] "C"  PT
 SG_ moduleTemperature75_BMS02 m75 : 15|8@0+ (1,-40) [-40|200] "C"  PT
 SG_ moduleTemperature76_BMS02 m76 : 15|8@0+ (1,-40) [-40|200] "C"  PT
 SG_ moduleTemperature77_BMS02 m77 : 15|8@0+ (1,-40) [-40|200] "C"  PT
 SG_ moduleTemperature78_BMS02 m78 : 15|8@0+ (1,-40) [-40|200] "C"  PT
 SG_ moduleTemperature79_BMS02 m79 : 15|8@0+ (1,-40) [-40|200] "C"  PT
 SG_ moduleTemperature80_BMS02 m80 : 15|8@0+ (1,-40) [-40|200] "C"  PT
 SG_ moduleTemperature81_BMS02 m81 : 15|8@0+ (1,-40) [-40|200] "C"  PT
 SG_ moduleTemperature82_BMS02 m82 : 15|8@0+ (1,-40) [-40|200] "C"  PT
 SG_ moduleTemperature83_BMS02 m83 : 15|8@0+ (1,-40) [-40|200] "C"  PT
 SG_ moduleTemperature84_BMS02 m84 : 15|8@0+ (1,-40) [-40|200] "C"  PT
 SG_ moduleTemperature85_BMS02 m85 : 15|8@0+ (1,-40) [-40|200] "C"  PT
 SG_ moduleTemperature86_BMS02 m86 : 15|8@0+ (1,-40) [-40|200] "C"  PT
 SG_ moduleTemperature87_BMS02 m87 : 15|8@0+ (1,-40) [-40|200] "C"  PT
 SG_ moduleTemperature88_BMS02 m88 : 15|8@0+ (1,-40) [-40|200] "C"  PT
 SG_ moduleTemperature89_BMS02 m89 : 15|8@0+ (1,-40) [-40|200] "C"  PT
 SG_ moduleTemperature90_BMS02 m90 : 15|8@0+ (1,-40) [-40|200] "C"  PT
 SG_ moduleTemperature91_BMS02 m91 : 15|8@0+ (1,-40) [-40|200] "C"  PT
 SG_ moduleTemperature92_BMS02 m92 : 15|8@0+ (1,-40) [-40|200] "C"  PT
 SG_ moduleTemperature93_BMS02 m93 : 15|8@0+ (1,-40) [-40|200] "C"  PT
 SG_ moduleTemperature94_BMS02 m94 : 15|8@0+ (1,-40) [-40|200] "C"  PT
 SG_ moduleTemperature95_BMS02 m95 : 15|8@0+ (1,-40) [-40|200] "C"  PT
 SG_ moduleTemperature96_BMS02 m96 : 15|8@0+ (1,-40) [-40|200] "C"  PT
 SG_ moduleTemperature97_BMS02 m97 : 15|8@0+ (1,-40) [-40|200] "C"  PT
 SG_ moduleTemperature98_BMS02 m98 : 15|8@0+ (1,-40) [-40|200] "C"  PT
 SG_ moduleTemperature99_BMS02 m99 : 15|8@0+ (1,-40) [-40|200] "C"  PT
 SG_ moduleTemperature100_BMS02 m100 : 15|8@0+ (1,-40) [-40|200] "C"  PT
 SG_ moduleTemperature101_BMS02 m101 : 15|8@0+ (1,-40) [-40|200] "C"  PT
 SG_ moduleTemperature102_BMS02 m102 : 15|8@0+ (1,-40) [-40|200] "C"  PT
 SG_ moduleTemperature103_BMS02 m103 : 15|8@0+ (1,-40) [-40|200] "C"  PT
 SG_ moduleTemperature104_BMS02 m104 : 15|8@0+ (1,-40) [-40|200] "C"  PT
 SG_ moduleTemperature105_BMS02 m105 : 15|8@0+ (1,-40) [-40|200] "C"  PT
 SG_ moduleTemperature106_BMS02 m106 : 15|8@0+ (1,-40) [-40|200] "C"  PT
 SG_ moduleTemperature107_BMS02 m107 : 15|8@0+ (1,-40) [-40|200] "C"  PT
 SG_ moduleTemperature108_BMS02 m108 : 15|8@0+ (1,-40) [-40|200] "C"  PT
 SG_ moduleTemperature109_BMS02 m109 : 15|8@0+ (1,-40) [-40|200] "C"  PT
 SG_ moduleTemperature110_BMS02 m110 : 15|8@0+ (1,-40) [-40|200] "C"  PT
 SG_ moduleTemperature111_BMS02 m111 : 15|8@0+ (1,-40) [-40|200] "C"  PT
 SG_ moduleTemperature112_BMS02 m112 : 15|8@0+ (1,-40) [-40|200] "C"  PT
 SG_ moduleTemperature113_BMS02 m113 : 15|8@0+ (1,-40) [-40|200] "C"  PT
 SG_ moduleTemperature114_BMS02 m114 : 15|8@0+ (1,-40) [-40|200] "C"  PT
 SG_ moduleTemperature115_BMS02 m115 : 15|8@0+ (1,-40) [-40|200] "C"  PT
 SG_ moduleTemperature116_BMS02 m116 : 15|8@0+ (1,-40) [-40|200] "C"  PT
 SG_ moduleTemperature117_BMS02 m117 : 15|8@0+ (1,-40) [-40|200] "C"  PT
 SG_ moduleTemperature118_BMS02 m118 : 15|8@0+ (1,-40) [-40|200] "C"  PT
 SG_ moduleTemperature119_BMS02 m119 : 15|8@0+ (1,-40) [-40|200] "C"  PT
 SG_ moduleTemperature120_BMS02 m120 : 15|8@0+ (1,-40) [-40|200] "C"  PT
 SG_ moduleTemperature121_BMS02 m121 : 15|8@0+ (1,-40) [-40|200] "C"  PT
 SG_ moduleTemperature122_BMS02 m122 : 15|8@0+ (1,-40) [-40|200] "C"  PT
 SG_ moduleTemperature123_BMS02 m123 : 15|8@0+ (1,-40) [-40|200] "C"  PT
 SG_ moduleTemperature124_BMS02 m124 : 15|8@0+ (1,-40) [-40|200] "C"  PT
 SG_ moduleTemperature125_BMS02 m125 : 15|8@0+ (1,-40) [-40|200] "C"  PT
 SG_ moduleTemperature126_BMS02 m126 : 15|8@0+ (1,-40) [-40|200] "C"  PT
 SG_ moduleTemperature127_BMS02 m127 : 15|8@0+ (1,-40) [-40|200] "C"  PT
 SG_ moduleTemperature128_BMS02 m128 : 15|8@0+ (1,-40) [-40|200] "C"  PT
 SG_ moduleTemperature129_BMS02 m129 : 15|8@0+ (1,-40) [-40|200] "C"  PT
 SG_ moduleTemperature130_BMS02 m130 : 15|8@0+ (1,-40) [-40|200] "C"  PT
 SG_ moduleTemperature131_BMS02 m131 : 15|8@0+ (1,-40) [-40|200] "C"  PT
 SG_ moduleTemperature132_BMS02 m132 : 15|8@0+ (1,-40) [-40|200] "C"  PT
 SG_ moduleTemperature133_BMS02 m133 : 15|8@0+ (1,-40) [-40|200] "C"  PT
 SG_ moduleTemperature134_BMS02 m134 : 15|8@0+ (1,-40) [-40|200] "C"  PT
 SG_ moduleTemperature135_BMS02 m135 : 15|8@0+ (1,-40) [-40|200] "C"  PT
 SG_ moduleTemperature136_BMS02 m136 : 15|8@0+ (1,-40) [-40|200] "C"  PT
 SG_ moduleTemperature137_BMS02 m137 : 15|8@0+ (1,-40) [-40|200] "C"  PT
 SG_ moduleTemperature138_BMS02 m138 : 15|8@0+ (1,-40) [-40|200] "C"  PT
 SG_ moduleTemperature139_BMS02 m139 : 15|8@0+ (1,-40) [-40|200] "C"  PT
 SG_ moduleTemperature140_BMS02 m140 : 15|8@0+ (1,-40) [-40|200] "C"  PT
 SG_ moduleTemperature141_BMS02 m141 : 15|8@0+ (1,-40) [-40|200] "C"  PT
 SG_ moduleTemperature142_BMS02 m142 : 15|8@0+ (1,-40) [-40|200] "C"  PT
 SG_ moduleTemperature143_BMS02 m143 : 15|8@0+ (1,-40) [-40|200] "C"  PT
 SG_ moduleTemperature144_BMS02 m144 : 15|8@0+ (1,-40) [-40|200] "C"  PT
 SG_ moduleTemperature145_BMS02 m145 : 15|8@0+ (1,-40) [-40|200] "C"  PT
 SG_ moduleTemperature146_BMS02 m146 : 15|8@0+ (1,-40) [-40|200] "C"  PT
 SG_ moduleTemperature147_BMS02 m147 : 15|8@0+ (1,-40) [-40|200] "C"  PT
 SG_ moduleTemperature148_BMS02 m148 : 15|8@0+ (1,-40) [-40|200] "C"  PT
 SG_ moduleTemperature149_BMS02 m149 : 15|8@0+ (1,-40) [-40|200] "C"  PT
 SG_ moduleTemperature150_BMS02 m150 : 15|8@0+ (1,-40) [-40|200] "C"  PT
 SG_ moduleTemperature151_BMS02 m151 : 15|8@0+ (1,-40) [-40|200] "C"  PT
 SG_ moduleTemperature152_BMS02 m152 : 15|8@0+ (1,-40) [-40|200] "C"  PT
 SG_ moduleTemperature153_BMS02 m153 : 15|8@0+ (1,-40) [-40|200] "C"  PT
 SG_ moduleTemperature154_BMS02 m154 : 15|8@0+ (1,-40) [-40|200] "C"  PT
 SG_ moduleTemperature155_BMS02 m155 : 15|8@0+ (1,-40) [-40|200] "C"  PT
 SG_ moduleTemperature156_BMS02 m156 : 15|8@0+ (1,-40) [-40|200] "C"  PT
 SG_ moduleTemperature157_BMS02 m157 : 15|8@0+ (1,-40) [-40|200] "C"  PT
 SG_ moduleTemperature158_BMS02 m158 : 15|8@0+ (1,-40) [-40|200] "C"  PT
 SG_ moduleTemperature159_BMS02 m159 : 15|8@0+ (1,-40) [-40|200] "C"  PT
 SG_ moduleTemperature160_BMS02 m160 : 15|8@0+ (1,-40) [-40|200] "C"  PT
 SG_ moduleTemperature161_BMS02 m161 : 15|8@0+ (1,-40) [-40|200] "C"  PT
 SG_ moduleTemperature162_BMS02 m162 : 15|8@0+ (1,-40) [-40|200] "C"  PT
 SG_ moduleTemperature163_BMS02 m163 : 15|8@0+ (1,-40) [-40|200] "C"  PT
 SG_ moduleTemperature164_BMS02 m164 : 15|8@0+ (1,-40) [-40|200] "C"  PT
 SG_ moduleTemperature165_BMS02 m165 : 15|8@0+ (1,-40) [-40|200] "C"  PT
 SG_ moduleTemperature166_BMS02 m166 : 15|8@0+ (1,-40) [-40|200] "C"  PT
 SG_ moduleTemperature167_BMS02 m167 : 15|8@0+ (1,-40) [-40|200] "C"  PT
 SG_ moduleTemperature168_BMS02 m168 : 15|8@0+ (1,-40) [-40|200] "C"  PT
 SG_ moduleTemperature169_BMS02 m169 : 15|8@0+ (1,-40) [-40|200] "C"  PT
 SG_ moduleTemperature170_BMS02 m170 : 15|8@0+ (1,-40) [-40|200] "C"  PT
 SG_ moduleTemperature171_BMS02 m171 : 15|8@0+ (1,-40) [-40|200] "C"  PT
 SG_ moduleTemperature172_BMS02 m172 : 15|8@0+ (1,-40) [-40|200] "C"  PT
 SG_ moduleTemperature173_BMS02 m173 : 15|8@0+ (1,-40) [-40|200] "C"  PT
 SG_ moduleTemperature174_BMS02 m174 : 15|8@0+ (1,-40) [-40|200] "C"  PT
 SG_ moduleTemperature175_BMS02 m175 : 15|8@0+ (1,-40) [-40|200] "C"  PT
 SG_ moduleTemperature176_BMS02 m176 : 15|8@0+ (1,-40) [-40|200] "C"  PT
 SG_ moduleTemperature177_BMS02 m177 : 15|8@0+ (1,-40) [-40|200] "C"  PT
 SG_ moduleTemperature178_BMS02 m178 : 15|8@0+ (1,-40) [-40|200] "C"  PT
 SG_ moduleTemperature179_BMS02 m179 : 15|8@0+ (1,-40) [-40|200] "C"  PT
 SG_ moduleTemperature180_BMS02 m180 : 15|8@0+ (1,-40) [-40|200] "C"  PT
 SG_ moduleTemperature181_BMS02 m181 : 15|8@0+ (1,-40) [-40|200] "C"  PT
 SG_ moduleTemperature182_BMS02 m182 : 15|8@0+ (1,-40) [-40|200] "C"  PT
 SG_ moduleTemperature183_BMS02 m183 : 15|8@0+ (1,-40) [-40|200] "C"  PT
 SG_ moduleTemperature184_BMS02 m184 : 15|8@0+ (1,-40) [-40|200] "C"  PT
 SG_ moduleTemperature185_BMS02 m185 : 15|8@0+ (1,-40) [-40|200] "C"  PT
 SG_ moduleTemperature186_BMS02 m186 : 15|8@0+ (1,-40) [-40|200] "C"  PT
 SG_ moduleTemperature187_BMS02 m187 : 15|8@0+ (1,-40) [-40|200] "C"  PT
 SG_ moduleTemperature188_BMS02 m188 : 15|8@0+ (1,-40) [-40|200] "C"  PT
 SG_ moduleTemperature189_BMS02 m189 : 15|8@0+ (1,-40) [-40|200] "C"  PT
 SG_ moduleTemperature190_BMS02 m190 : 15|8@0+ (1,-40) [-40|200] "C"  PT
 SG_ moduleTemperature191_BMS02 m191 : 15|8@0+ (1,-40) [-40|200] "C"  PT
 SG_ moduleTemperature192_BMS02 m192 : 15|8@0+ (1,-40) [-40|200] "C"  PT

BO_ 900 BMS05_DebugEventMap10: 8 BMS05
 SG_ DEM319_HV_DISABLE_DURING_S_BMS05 : 55|2@0+ (1,0) [0|3] ""  PT
 SG_ DEM318_HV_ENABLE_IMPLAUSIB_BMS05 : 53|2@0+ (1,0) [0|3] ""  PT
 SG_ DEM317_STRING_SUSPECT_OPEN_BMS05 : 51|2@0+ (1,0) [0|3] ""  PT
 SG_ DEM316_UNEXPCTD_BMS_ON_CAN_BMS05 : 49|2@0+ (1,0) [0|3] ""  PT
 SG_ DEM315_HV_WITHSTAND_TESTS__BMS05 : 63|2@0+ (1,0) [0|3] ""  PT
 SG_ DEM314_OBC_PILOT_ERROR_BMS05 : 61|2@0+ (1,0) [0|3] ""  PT
 SG_ DEM313_OBC_PILOT_HIGH_BMS05 : 59|2@0+ (1,0) [0|3] ""  PT
 SG_ DEM312_OBC_PROXIMITY_ERROR_BMS05 : 57|2@0+ (1,0) [0|3] ""  PT
 SG_ DEM311_CTRS_END_OF_LIFE_WA_BMS05 : 39|2@0+ (1,0) [0|3] ""  PT
 SG_ DEM310_BMSMIA_STRNGMSTR_AL_BMS05 : 37|2@0+ (1,0) [0|3] ""  PT
 SG_ DEM309_VOLTAGE_BRICKOV_WAR_BMS05 : 35|2@0+ (1,0) [0|3] ""  PT
 SG_ DEM308_PRESSURE_FLT_BMS05 : 33|2@0+ (1,0) [0|3] ""  PT
 SG_ DEM307_PRESSURE_MIA_BMS05 : 47|2@0+ (1,0) [0|3] ""  PT
 SG_ DEM306_SW_VERSION_MISMATCH_BMS05 : 45|2@0+ (1,0) [0|3] ""  PT
 SG_ DEM305_MODULET_OVERTEMP_WA_BMS05 : 43|2@0+ (1,0) [0|3] ""  PT
 SG_ DEM304_PCHG_OPENCIRCUIT_IN_BMS05 : 41|2@0+ (1,0) [0|3] ""  PT
 SG_ DEM303_MODULET_UNDERTEMP_W_BMS05 : 23|2@0+ (1,0) [0|3] ""  PT
 SG_ DEM302_MODULET_UT_BMS05 : 21|2@0+ (1,0) [0|3] ""  PT
 SG_ DEM301_FUSI_LOCK_BMS05 : 19|2@0+ (1,0) [0|3] ""  PT
 SG_ DEM300_DEBUG_SM_DISABLED_BMS05 : 17|2@0+ (1,0) [0|3] ""  PT
 SG_ DEM299_5V_SENSOR_SUPPLY_OU_BMS05 : 31|2@0+ (1,0) [0|3] ""  PT
 SG_ DEM298_IMPL_DRIVE_REQUEST_BMS05 : 29|2@0+ (1,0) [0|0] ""  PT
 SG_ DEM297_PCHG2_OPENCIRCUIT_BMS05 : 27|2@0+ (1,0) [0|0] ""  PT
 SG_ DEM296_CTRSAUX_IMPLAUSIBLE_BMS05 : 25|2@0+ (1,0) [0|0] ""  PT
 SG_ DEM295_CTRSAUX_LINKV_UNSAF_BMS05 : 7|2@0+ (1,0) [0|0] ""  PT
 SG_ DEM294_CANRX_PT_EMERGENCY_BMS05 : 5|2@0+ (1,0) [0|0] ""  PT
 SG_ DEM293_SBC_LDT_IMPLAUSIBLE_BMS05 : 3|2@0+ (1,0) [0|0] ""  PT
 SG_ DEM292_NUM_EXPECTED_STRING_BMS05 : 1|2@0+ (1,0) [0|0] ""  PT
 SG_ DEM291_NUM_EXPECTED_STRING_BMS05 : 15|2@0+ (1,0) [0|0] ""  PT
 SG_ DEM290_CMB_ONBOARD_DEFECT_BMS05 : 13|2@0+ (1,0) [0|0] ""  PT
 SG_ DEM289_TEMP_STATE_LATCHED_BMS05 : 11|2@0+ (1,0) [0|0] ""  PT
 SG_ DEM288_CURR_STATE_LATCHED_BMS05 : 9|2@0+ (1,0) [0|0] ""  PT

BO_ 964 BMS05_DebugSlowMpex2: 8 BMS05
 SG_ balancingInDriveTimer_BMS05 m18 : 15|16@0+ (1,0) [0|65535] "s"  PT
 SG_ SOCRestPolarization_BMS05 m11 : 63|8@0+ (0.002,0) [0|0.51] "V"  PT
 SG_ CoolantSensorState_BMS05 m1 : 51|2@0+ (1,0) [0|1] ""  PT
 SG_ temperatureModelOffset_BMS05 m7 : 15|8@0+ (0.1,0) [0|25.5] "C"  PT
 SG_ SOHCMinBrickHighEst_BMS05 m4 : 15|8@0+ (0.3,50) [50|126.5] "PCT"  PT
 SG_ SOHCMaxBrickHighEst_BMS05 m6 : 15|8@0+ (0.3,50) [50|126.5] "PCT"  PT
 SG_ regenCurrOpLkyBktThrs1_BMS05 m17 : 63|8@0+ (0.5,0) [0|127.5] "PCT"  PT
 SG_ dischargeCurrOpLkyBktThrs1_BMS05 m10 : 15|8@0+ (0.5,0) [0|127.5] "PCT"  PT
 SG_ regenCurrentOpLoadValue_BMS05 m16 : 15|8@0+ (0.5,0) [0|127.5] "PCT"  PT
 SG_ dischargeCurrOpLoadValue_BMS05 m15 : 15|8@0+ (0.5,0) [0|127.5] "PCT"  PT
 SG_ minBrickVoltageLimit_BMS05 m16 : 55|16@0+ (0.0001,0) [0|6.5535] "V"  PT
 SG_ SOHSuitableOCVRecal_BMS05 m1 : 49|1@0+ (1,0) [0|1] ""  PT
 SG_ currentModule3Integral_BMS05 m17 : 47|16@0+ (100,-3200000) [-3200000|3353500] "As"  PT
 SG_ currentModule2Integral_BMS05 m17 : 31|16@0+ (100,-3200000) [-3200000|3353500] "As"  PT
 SG_ currentModule1Integral_BMS05 m17 : 15|16@0+ (100,-3200000) [-3200000|3353500] "As"  PT
 SG_ currentModuleMin_BMS05 m16 : 23|16@0+ (0.1,-3200) [-3200|3200] "A"  PT
 SG_ currentModuleMax_BMS05 m16 : 39|16@0+ (0.1,-3200) [-3200|3200] "A"  PT
 SG_ maxBrickVoltageSync_BMS05 m9 : 39|16@0+ (0.0001,0) [0|6.5] "V"  PT
 SG_ minBrickVoltageSync_BMS05 m9 : 55|16@0+ (0.0001,0) [0|6.5] "V"  PT
 SG_ SOHCMinBrickLowEst_BMS05 m8 : 15|8@0+ (0.3,50) [50|126.5] "PCT"  PT
 SG_ SOHCMaxBrickLowEst_BMS05 m9 : 15|8@0+ (0.3,50) [50|126.5] "PCT"  PT
 SG_ gradLimSOC_BMS05 m10 : 39|16@0+ (0.002,0) [0|131.07] "PCT"  PT
 SG_ SOCRecalSlowOp_BMS05 m14 : 55|16@0+ (0.0001,-2) [-2|4.5535] "V"  PT
 SG_ SOHCMinIndex_BMS05 m12 : 39|16@0+ (1,0) [0|65535] ""  PT
 SG_ SOHCMaxIndex_BMS05 m12 : 55|16@0+ (1,0) [0|65535] ""  PT
 SG_ SOHRMinRegen_BMS05 m11 : 39|8@0+ (1,50) [50|305] "PCT"  PT
 SG_ SOHRMinDchg_BMS05 m11 : 15|8@0+ (1,50) [50|305] "PCT"  PT
 SG_ SOHRMeanRegen_BMS05 m11 : 47|8@0+ (1,50) [50|305] "PCT"  PT
 SG_ SOHRMeanDchg_BMS05 m11 : 23|8@0+ (1,50) [50|305] "PCT"  PT
 SG_ SOHRMaxRegen_BMS05 m11 : 55|8@0+ (1,50) [50|305] "PCT"  PT
 SG_ SOHRMaxDchg_BMS05 m11 : 31|8@0+ (1,50) [50|305] "PCT"  PT
 SG_ SOHCMin_BMS05 m12 : 15|8@0+ (0.3,50) [50|126.5] "PCT"  PT
 SG_ SOHCMean_BMS05 m12 : 23|8@0+ (0.3,50) [50|126.5] "PCT"  PT
 SG_ SOHCMax_BMS05 m12 : 31|8@0+ (0.3,50) [50|126.5] "PCT"  PT
 SG_ ppRegenCurrLimitPredShort_BMS05 m6 : 23|8@0+ (2,0) [0|510] "A"  PT
 SG_ ppRegenCurrLimitPredLong_BMS05 m6 : 31|8@0+ (2,0) [0|510] "A"  PT
 SG_ ppDchgCurrLimitPredShort_BMS05 m13 : 55|8@0+ (2,-510) [-510|0] "A"  PT
 SG_ ppDchgCurrLimitPredLong_BMS05 m13 : 63|8@0+ (2,-510) [-510|0] "A"  PT
 SG_ ppInconsistentPol_BMS05 m1 : 48|1@0+ (1,0) [0|0] ""  PT
 SG_ ppPolarizationV_BMS05 m3 : 55|16@0+ (0.0001,-3) [-3|3.5535] "V"  PT
 SG_ SOCRecalMinOCVEst_BMS05 m13 : 39|16@0+ (0.0001,0) [0|6.5535] "V"  PT
 SG_ SOCRecalMaxOCVEst_BMS05 m14 : 39|16@0+ (0.0001,0) [0|6.5535] "V"  PT
 SG_ SOCRecalMinSOCUpp_BMS05 m13 : 31|8@0+ (0.5,0) [0|127.5] "PCT"  PT
 SG_ SOCRecalMinSOCLow_BMS05 m13 : 15|8@0+ (0.5,0) [0|127.5] "PCT"  PT
 SG_ SOCRecalMinSOC_BMS05 m13 : 23|8@0+ (0.5,0) [0|127.5] "PCT"  PT
 SG_ SOCRecalMaxSOCUpp_BMS05 m14 : 31|8@0+ (0.5,0) [0|127.5] "PCT"  PT
 SG_ SOCRecalMaxSOCLow_BMS05 m14 : 15|8@0+ (0.5,0) [0|127.5] "PCT"  PT
 SG_ SOCRecalMaxSOC_BMS05 m14 : 23|8@0+ (0.5,0) [0|127.5] "PCT"  PT
 SG_ ppNewtonRootInRangeRegen_BMS05 m5 : 12|1@0+ (1,0) [0|0] ""  PT
 SG_ ppNewtonRootInRangeDchg_BMS05 m5 : 8|1@0+ (1,0) [0|0] ""  PT
 SG_ ppNewtonStepsRegen_BMS05 m5 : 15|3@0+ (1,0) [0|1] ""  PT
 SG_ ppNewtonStepsDchg_BMS05 m5 : 11|3@0+ (1,0) [0|1] ""  PT
 SG_ ppNewtonRegenVRes_BMS05 m5 : 31|8@0+ (0.001,-0.1) [-0.1|0.155] "V"  PT
 SG_ ppNewtonDchgVRes_BMS05 m5 : 23|8@0+ (0.001,-0.1) [-0.1|0.155] "V"  PT
 SG_ ppMinModelAlphaTarget_BMS05 m3 : 15|8@0+ (0.02,0) [0|5.1] ""  PT
 SG_ ppMaxModelAlphaTarget_BMS05 m1 : 63|8@0+ (0.02,0) [0|5.1] ""  PT
 SG_ ppLearningTauRegen_BMS05 m2 : 55|16@0+ (0.2,0) [0|0] "s"  PT
 SG_ ppLearningCriterionDyn_BMS05 m2 : 15|8@0+ (0.005,0) [0|0] ""  PT
 SG_ ppLearningCriterionAbs_BMS05 m1 : 15|8@0+ (0.005,0) [0|0] ""  PT
 SG_ ppLearningCriterionJoin_BMS05 m0 : 15|8@0+ (0.005,0) [0|0] ""  PT
 SG_ ppMaxModelMeasV_BMS05 m7 : 23|16@0+ (0.0001,0) [0|6.5535] "V"  PT
 SG_ currentRedundant_BMS05 m15 : 23|16@0+ (0.1,-3200) [-3200|3200] "A"  PT
 SG_ currentModule3_BMS05 m10 : 55|16@0+ (0.1,-3200) [-3200|3200] "A"  PT
 SG_ currentModule2_BMS05 m10 : 23|16@0+ (0.1,-3200) [-3200|3200] "A"  PT
 SG_ currentModule1_BMS05 m9 : 23|16@0+ (0.1,-3200) [-3200|3200] "A"  PT
 SG_ ppMeanRegenIntRes_BMS05 m6 : 55|16@0+ (0.01,0) [0|655.35] "mOhm"  PT
 SG_ ppMeanDchgIntRes_BMS05 m6 : 39|16@0+ (0.01,0) [0|655.35] "mOhm"  PT
 SG_ ppMinModelVoltageIndex_BMS05 m5 : 39|16@0+ (1,0) [0|65535] ""  PT
 SG_ ppMinModelLowpassV_BMS05 m4 : 55|16@0+ (0.0001,0) [0|0] "V"  PT
 SG_ ppMaxModelVoltageIndex_BMS05 m5 : 55|16@0+ (1,0) [0|65535] ""  PT
 SG_ ppMaxModelLowpassV_BMS05 m7 : 55|16@0+ (0.0001,0) [0|0] "V"  PT
 SG_ ppLearningTauDischarge_BMS05 m0 : 55|16@0+ (0.2,0) [0|0] "s"  PT
 SG_ ppMaxRegenAlpha_BMS05 m15 : 39|16@0+ (0.0001,0) [0|6.5535] ""  PT
 SG_ ppMaxModelledV_BMS05 m7 : 39|16@0+ (0.0001,0) [0|6.5535] "V"  PT
 SG_ ppMinDchgAlpha_BMS05 m15 : 55|16@0+ (0.0001,0) [0|6.5535] ""  PT
 SG_ ppMinModelledV_BMS05 m4 : 39|16@0+ (0.0001,0) [0|6.5535] "V"  PT
 SG_ ppMinModelMeasV_BMS05 m4 : 23|16@0+ (0.0001,0) [0|6.5535] "V"  PT
 SG_ debugSlowMpex2_BMS05 M : 7|8@0+ (1,0) [0|0] ""  PT
 SG_ ppRegenCurrPredShort_BMS05 m2 : 23|16@0+ (0.02,0) [0|1310.7] "A"  PT
 SG_ ppDischgCurrPredLong_BMS05 m0 : 39|16@0+ (0.05,-3200) [-3200|0] "A"  PT
 SG_ ppDischgCurrPredShort_BMS05 m0 : 23|16@0+ (0.05,-3200) [-3200|0] "A"  PT
 SG_ ppRegenCurrPredLong_BMS05 m2 : 39|16@0+ (0.02,0) [0|1310.7] "A"  PT
 SG_ ppRegenVPredShort_BMS05 m3 : 23|16@0+ (0.02,0) [0|1310.7] "V"  PT
 SG_ ppDischgVPredShort_BMS05 m1 : 23|16@0+ (0.02,0) [0|1310.7] "V"  PT
 SG_ ppRegenVPredLong_BMS05 m3 : 39|16@0+ (0.02,0) [0|1310.7] "V"  PT
 SG_ ppDischgVPredLong_BMS05 m1 : 39|16@0+ (0.02,0) [0|1310.7] "V"  PT
 SG_ SOHDeltaSOCCoulomb_BMS05 m8 : 23|16@0+ (0.005,-150) [-150|177.675] "PCT"  PT
 SG_ SOHAbsDeltaSOCCoulomb_BMS05 m8 : 39|16@0+ (0.05,0) [0|3276.75] "PCT"  PT
 SG_ SOHLastOCVRecalMinSOC_BMS05 m8 : 55|8@0+ (0.393,0) [0|100.215] "PCT"  PT
 SG_ SOHbalancingTimeMinSOH_BMS05 m8 : 63|8@0+ (1,0) [0|255] "Min"  PT

BO_ 1796 BMS05_DebugFastMpex2: 8 BMS05
 SG_ chargerDCOutV_BMS05 m1 : 55|16@0+ (0.04,-1250) [-1250|1250] "V"  PT
 SG_ DIGIO_CHARGERCC_BMS05 m1 : 10|1@0+ (1,0) [0|0] ""  PT
 SG_ chargerProximity_BMS05 m1 : 23|8@0+ (0.02,0) [0|12] "V"  PT
 SG_ chargerPilot_BMS05 m1 : 31|8@0+ (0.05,0) [0|12.75] "V"  PT
 SG_ chargerCurrAvail_BMS05 m1 : 39|8@0+ (0.5,0) [0|127.5] "A"  PT
 SG_ chargerCtrOn_BMS05 m1 : 8|1@0+ (1,0) [0|0] ""  PT
 SG_ chargerOn_BMS05 m1 : 9|1@0+ (1,0) [0|0] ""  PT
 SG_ debugFastMpex2_BMS05 M : 7|8@0+ (1,0) [0|0] ""  PT
 SG_ posPackDbg_BMS05 m0 : 39|16@0+ (0.04,-1250) [-1250|1250] "V"  PT
 SG_ negPackDbg_BMS05 m0 : 55|16@0+ (0.04,-1250) [-1250|1250] "V"  PT
 SG_ packVoltageHVMeas_BMS05 m0 : 23|16@0+ (0.04,-1250) [-1250|1250] "V"  PT

BA_DEF_ SG_  "GenSigSendType" ENUM  "Cyclic","OnWrite","OnWriteWithRepetition","OnChange","OnChangeWithRepetition","IfActive","IfActiveWithRepetition","NoSigSendType";
BA_DEF_ BO_  "GenMsgCycleTime" INT 0 0;
BA_DEF_ BO_  "GenMsgSendType" ENUM  "Cyclic","not_used","not_used","not_used","not_used","Cyclic","not_used","IfActive","NoMsgSendType";
BA_DEF_DEF_  "GenSigSendType" "Cyclic";
BA_DEF_DEF_  "GenMsgCycleTime" 0;
BA_DEF_DEF_  "GenMsgSendType" "NoMsgSendType";
BA_ "GenMsgCycleTime" BO_ 1217 1000;
BA_ "GenMsgCycleTime" BO_ 1281 1000;
BA_ "GenMsgCycleTime" BO_ 1345 1000;
BA_ "GenMsgCycleTime" BO_ 1409 1000;
BA_ "GenMsgCycleTime" BO_ 1473 1000;
BA_ "GenMsgCycleTime" BO_ 1601 100;
BA_ "GenMsgCycleTime" BO_ 1665 10;
BA_ "GenMsgCycleTime" BO_ 1921 100;
BA_ "GenMsgCycleTime" BO_ 1985 100;
BA_ "GenMsgCycleTime" BO_ 964 1000;
BA_ "GenMsgCycleTime" BO_ 1796 100;
VAL_ 1217 DEM096_SC_STATE_SELFTEST_BMS02 3 "DEM_INVALID" 2 "DEM_FAILED" 1 "DEM_PASSED" 0 "DEM_NOTTESTED" ;
VAL_ 1217 DEM097_SC_STATE_TEMP_BMS02 3 "DEM_INVALID" 2 "DEM_FAILED" 1 "DEM_PASSED" 0 "DEM_NOTTESTED" ;
VAL_ 1217 DEM098_SC_STATE_VOLTAGE_BMS02 3 "DEM_INVALID" 2 "DEM_FAILED" 1 "DEM_PASSED" 0 "DEM_NOTTESTED" ;
VAL_ 1217 DEM099_SC_STATE_HVIL_BMS02 3 "DEM_INVALID" 2 "DEM_FAILED" 1 "DEM_PASSED" 0 "DEM_NOTTESTED" ;
VAL_ 1217 DEM100_SC_STATE_CONTACTORS_BMS02 3 "DEM_INVALID" 2 "DEM_FAILED" 1 "DEM_PASSED" 0 "DEM_NOTTESTED" ;
VAL_ 1217 DEM101_SC_STATE_CURRENT_BMS02 3 "DEM_INVALID" 2 "DEM_FAILED" 1 "DEM_PASSED" 0 "DEM_NOTTESTED" ;
VAL_ 1217 DEM102_SC_STATE_CANRX_BMS02 3 "DEM_INVALID" 2 "DEM_FAILED" 1 "DEM_PASSED" 0 "DEM_NOTTESTED" ;
VAL_ 1217 DEM103_SC_STATE_CRASH_BMS02 3 "DEM_INVALID" 2 "DEM_FAILED" 1 "DEM_PASSED" 0 "DEM_NOTTESTED" ;
VAL_ 1217 DEM104_SC_STATE_CCTRL_BMS02 3 "DEM_INVALID" 2 "DEM_FAILED" 1 "DEM_PASSED" 0 "DEM_NOTTESTED" ;
VAL_ 1217 DEM105_SC_STATE_CANTX_BMS02 3 "DEM_INVALID" 2 "DEM_FAILED" 1 "DEM_PASSED" 0 "DEM_NOTTESTED" ;
VAL_ 1217 DEM106_SC_STATE_THERMALEVT_BMS02 3 "DEM_INVALID" 2 "DEM_FAILED" 1 "DEM_PASSED" 0 "DEM_NOTTESTED" ;
VAL_ 1217 DEM107_SC_STATE_COOLANT_BMS02 3 "DEM_INVALID" 2 "DEM_FAILED" 1 "DEM_PASSED" 0 "DEM_NOTTESTED" ;
VAL_ 1217 DEM108_SC_SELFTEST_SFTY_UC_BMS02 3 "DEM_INVALID" 2 "DEM_FAILED" 1 "DEM_PASSED" 0 "DEM_NOTTESTED" ;
VAL_ 1217 DEM109_SC_TEMP_HIGH_BMS02 3 "DEM_INVALID" 2 "DEM_FAILED" 1 "DEM_PASSED" 0 "DEM_NOTTESTED" ;
VAL_ 1217 DEM110_SC_TEMP_NTC_OPEN_BMS02 3 "DEM_INVALID" 2 "DEM_FAILED" 1 "DEM_PASSED" 0 "DEM_NOTTESTED" ;
VAL_ 1217 DEM111_SC_TEMP_NTC_SHORT_BMS02 3 "DEM_INVALID" 2 "DEM_FAILED" 1 "DEM_PASSED" 0 "DEM_NOTTESTED" ;
VAL_ 1217 DEM112_CMB_DISCONNECTED_BMS02 3 "DEM_INVALID" 2 "DEM_FAILED" 1 "DEM_PASSED" 0 "DEM_NOTTESTED" ;
VAL_ 1217 DEM113_CMB_DEFECT_BMS02 3 "DEM_INVALID" 2 "DEM_FAILED" 1 "DEM_PASSED" 0 "DEM_NOTTESTED" ;
VAL_ 1217 DEM114_CMB_COMMERROR_BMS02 3 "DEM_INVALID" 2 "DEM_FAILED" 1 "DEM_PASSED" 0 "DEM_NOTTESTED" ;
VAL_ 1217 DEM115_SC_CURR_HALL_PWR_LO_BMS02 3 "DEM_INVALID" 2 "DEM_FAILED" 1 "DEM_PASSED" 0 "DEM_NOTTESTED" ;
VAL_ 1217 DEM116_SC_CURR_HALL_VHIGH_BMS02 3 "DEM_INVALID" 2 "DEM_FAILED" 1 "DEM_PASSED" 0 "DEM_NOTTESTED" ;
VAL_ 1217 DEM117_SC_CURR_HALL_ADC_BMS02 3 "DEM_INVALID" 2 "DEM_FAILED" 1 "DEM_PASSED" 0 "DEM_NOTTESTED" ;
VAL_ 1217 DEM118_SC_CURR_HALL_VLOW_BMS02 3 "DEM_INVALID" 2 "DEM_FAILED" 1 "DEM_PASSED" 0 "DEM_NOTTESTED" ;
VAL_ 1217 DEM119_SC_CURR_ISENSE_PWR_BMS02 3 "DEM_INVALID" 2 "DEM_FAILED" 1 "DEM_PASSED" 0 "DEM_NOTTESTED" ;
VAL_ 1217 DEM120_SC_CURR_ISENSE1_MIA_BMS02 3 "DEM_INVALID" 2 "DEM_FAILED" 1 "DEM_PASSED" 0 "DEM_NOTTESTED" ;
VAL_ 1217 DEM121_SC_CURR_ISENSE2_MIA_BMS02 3 "DEM_INVALID" 2 "DEM_FAILED" 1 "DEM_PASSED" 0 "DEM_NOTTESTED" ;
VAL_ 1217 DEM122_SC_CURR_ISENSE3_MIA_BMS02 3 "DEM_INVALID" 2 "DEM_FAILED" 1 "DEM_PASSED" 0 "DEM_NOTTESTED" ;
VAL_ 1217 DEM123_SC_CURR_ISENSE4_MIA_BMS02 3 "DEM_INVALID" 2 "DEM_FAILED" 1 "DEM_PASSED" 0 "DEM_NOTTESTED" ;
VAL_ 1217 DEM124_SC_CURR_ISENSE5_MIA_BMS02 3 "DEM_INVALID" 2 "DEM_FAILED" 1 "DEM_PASSED" 0 "DEM_NOTTESTED" ;
VAL_ 1217 DEM125_SC_CURR_ISENSE1_FLT_BMS02 3 "DEM_INVALID" 2 "DEM_FAILED" 1 "DEM_PASSED" 0 "DEM_NOTTESTED" ;
VAL_ 1217 DEM126_SC_CURR_ISENSE2_FLT_BMS02 3 "DEM_INVALID" 2 "DEM_FAILED" 1 "DEM_PASSED" 0 "DEM_NOTTESTED" ;
VAL_ 1217 DEM127_SC_CURR_ISENSE3_FLT_BMS02 3 "DEM_INVALID" 2 "DEM_FAILED" 1 "DEM_PASSED" 0 "DEM_NOTTESTED" ;
VAL_ 1281 DEM128_SC_CURR_ISENSE4_FLT_BMS02 3 "DEM_INVALID" 2 "DEM_FAILED" 1 "DEM_PASSED" 0 "DEM_NOTTESTED" ;
VAL_ 1281 DEM129_SC_CURR_ISENSE5_FLT_BMS02 3 "DEM_INVALID" 2 "DEM_FAILED" 1 "DEM_PASSED" 0 "DEM_NOTTESTED" ;
VAL_ 1281 DEM130_SC_CURR_OFFSET_BMS02 3 "DEM_INVALID" 2 "DEM_FAILED" 1 "DEM_PASSED" 0 "DEM_NOTTESTED" ;
VAL_ 1281 DEM131_SC_CURR_PLAUSI_BMS02 3 "DEM_INVALID" 2 "DEM_FAILED" 1 "DEM_PASSED" 0 "DEM_NOTTESTED" ;
VAL_ 1281 DEM132_SC_CURR_CHARGE_HIGH_BMS02 3 "DEM_INVALID" 2 "DEM_FAILED" 1 "DEM_PASSED" 0 "DEM_NOTTESTED" ;
VAL_ 1281 DEM133_SC_CURR_DSCHAR_HIGH_BMS02 3 "DEM_INVALID" 2 "DEM_FAILED" 1 "DEM_PASSED" 0 "DEM_NOTTESTED" ;
VAL_ 1281 DEM134_SC_V_CMB_SUMOFCELL_BMS02 3 "DEM_INVALID" 2 "DEM_FAILED" 1 "DEM_PASSED" 0 "DEM_NOTTESTED" ;
VAL_ 1281 DEM135_SC_V_SENSE_OPENWIRE_BMS02 3 "DEM_INVALID" 2 "DEM_FAILED" 1 "DEM_PASSED" 0 "DEM_NOTTESTED" ;
VAL_ 1281 DEM136_SC_V_CMB_DRV_FROZEN_BMS02 3 "DEM_INVALID" 2 "DEM_FAILED" 1 "DEM_PASSED" 0 "DEM_NOTTESTED" ;
VAL_ 1281 DEM137_SC_V_PACK_PLAUSI_BMS02 3 "DEM_INVALID" 2 "DEM_FAILED" 1 "DEM_PASSED" 0 "DEM_NOTTESTED" ;
VAL_ 1281 DEM138_SC_HVIL_HW_FLT_BMS02 3 "DEM_INVALID" 2 "DEM_FAILED" 1 "DEM_PASSED" 0 "DEM_NOTTESTED" ;
VAL_ 1281 DEM139_SC_HVIL_OPEN_BMS02 3 "DEM_INVALID" 2 "DEM_FAILED" 1 "DEM_PASSED" 0 "DEM_NOTTESTED" ;
VAL_ 1281 DEM140_SC_HVIL_TO_SUP_BMS02 3 "DEM_INVALID" 2 "DEM_FAILED" 1 "DEM_PASSED" 0 "DEM_NOTTESTED" ;
VAL_ 1281 DEM141_SC_HVIL_TO_CHAS_BMS02 3 "DEM_INVALID" 2 "DEM_FAILED" 1 "DEM_PASSED" 0 "DEM_NOTTESTED" ;
VAL_ 1281 DEM142_SC_HVIL_R_HIGH_BMS02 3 "DEM_INVALID" 2 "DEM_FAILED" 1 "DEM_PASSED" 0 "DEM_NOTTESTED" ;
VAL_ 1281 DEM143_SC_HVIL_SHORT_BMS02 3 "DEM_INVALID" 2 "DEM_FAILED" 1 "DEM_PASSED" 0 "DEM_NOTTESTED" ;
VAL_ 1281 DEM144_SC_CN_ISO_FAIL_BMS02 3 "DEM_INVALID" 2 "DEM_FAILED" 1 "DEM_PASSED" 0 "DEM_NOTTESTED" ;
VAL_ 1281 DEM145_HVIL_SYS_BMS02 3 "DEM_INVALID" 2 "DEM_FAILED" 1 "DEM_PASSED" 0 "DEM_NOTTESTED" ;
VAL_ 1281 DEM146_SC_CN_POS1_WELDED_BMS02 3 "DEM_INVALID" 2 "DEM_FAILED" 1 "DEM_PASSED" 0 "DEM_NOTTESTED" ;
VAL_ 1281 DEM147_SC_CN_NEG1_WELDED_BMS02 3 "DEM_INVALID" 2 "DEM_FAILED" 1 "DEM_PASSED" 0 "DEM_NOTTESTED" ;
VAL_ 1281 DEM148_SC_CN_POS2_WELDED_BMS02 3 "DEM_INVALID" 2 "DEM_FAILED" 1 "DEM_PASSED" 0 "DEM_NOTTESTED" ;
VAL_ 1281 DEM149_SC_CN_NEG2_WELDED_BMS02 3 "DEM_INVALID" 2 "DEM_FAILED" 1 "DEM_PASSED" 0 "DEM_NOTTESTED" ;
VAL_ 1281 DEM150_SC_CN_POS3_WELDED_BMS02 3 "DEM_INVALID" 2 "DEM_FAILED" 1 "DEM_PASSED" 0 "DEM_NOTTESTED" ;
VAL_ 1281 DEM151_SC_CN_NEG3_WELDED_BMS02 3 "DEM_INVALID" 2 "DEM_FAILED" 1 "DEM_PASSED" 0 "DEM_NOTTESTED" ;
VAL_ 1281 DEM152_SC_CN_HIGH_CY_BMS02 3 "DEM_INVALID" 2 "DEM_FAILED" 1 "DEM_PASSED" 0 "DEM_NOTTESTED" ;
VAL_ 1281 DEM153_SC_CN_ISOANDPOTWELD_BMS02 3 "DEM_INVALID" 2 "DEM_FAILED" 1 "DEM_PASSED" 0 "DEM_NOTTESTED" ;
VAL_ 1281 DEM154_SC_TEMP_PLAUSI_BMS02 3 "DEM_INVALID" 2 "DEM_FAILED" 1 "DEM_PASSED" 0 "DEM_NOTTESTED" ;
VAL_ 1281 DEM155_SC_CURR_HALL_PWR_HI_BMS02 3 "DEM_INVALID" 2 "DEM_FAILED" 1 "DEM_PASSED" 0 "DEM_NOTTESTED" ;
VAL_ 1281 DEM156_SC_PYRO_TRIGGERED_BMS02 3 "DEM_INVALID" 2 "DEM_FAILED" 1 "DEM_PASSED" 0 "DEM_NOTTESTED" ;
VAL_ 1281 DEM157_SC_PYRO_OPEN_BMS02 3 "DEM_INVALID" 2 "DEM_FAILED" 1 "DEM_PASSED" 0 "DEM_NOTTESTED" ;
VAL_ 1281 DEM158_AUX_CTRS_END_OF_LIF_BMS02 3 "DEM_INVALID" 2 "DEM_FAILED" 1 "DEM_PASSED" 0 "DEM_NOTTESTED" ;
VAL_ 1281 DEM159_SC_CANRX_PT_MIA_BMS02 3 "DEM_INVALID" 2 "DEM_FAILED" 1 "DEM_PASSED" 0 "DEM_NOTTESTED" ;
VAL_ 1345 DEM160_SC_CANRX_PT_CRCALIV_BMS02 3 "DEM_INVALID" 2 "DEM_FAILED" 1 "DEM_PASSED" 0 "DEM_NOTTESTED" ;
VAL_ 1345 DEM161_SC_CANRX_LIN_SHUTDN_BMS02 3 "DEM_INVALID" 2 "DEM_FAILED" 1 "DEM_PASSED" 0 "DEM_NOTTESTED" ;
VAL_ 1345 DEM162_SC_CANRX_LIN_MIA_BMS02 3 "DEM_INVALID" 2 "DEM_FAILED" 1 "DEM_PASSED" 0 "DEM_NOTTESTED" ;
VAL_ 1345 DEM163_SC_CRASH1_BMS02 3 "DEM_INVALID" 2 "DEM_FAILED" 1 "DEM_PASSED" 0 "DEM_NOTTESTED" ;
VAL_ 1345 DEM164_SC_CRASH2_BMS02 3 "DEM_INVALID" 2 "DEM_FAILED" 1 "DEM_PASSED" 0 "DEM_NOTTESTED" ;
VAL_ 1345 DEM165_SC_CRASHCAN_BMS02 3 "DEM_INVALID" 2 "DEM_FAILED" 1 "DEM_PASSED" 0 "DEM_NOTTESTED" ;
VAL_ 1345 DEM166_SC_CCTRL_SELFTEST_BMS02 3 "DEM_INVALID" 2 "DEM_FAILED" 1 "DEM_PASSED" 0 "DEM_NOTTESTED" ;
VAL_ 1345 DEM167_SC_CCTRL_DRIVER_FAU_BMS02 3 "DEM_INVALID" 2 "DEM_FAILED" 1 "DEM_PASSED" 0 "DEM_NOTTESTED" ;
VAL_ 1345 DEM168_SC_CCTRL_HISIDESTCL_BMS02 3 "DEM_INVALID" 2 "DEM_FAILED" 1 "DEM_PASSED" 0 "DEM_NOTTESTED" ;
VAL_ 1345 DEM169_SC_CCTRL_HISIDESTOP_BMS02 3 "DEM_INVALID" 2 "DEM_FAILED" 1 "DEM_PASSED" 0 "DEM_NOTTESTED" ;
VAL_ 1345 DEM170_SC_CCTRL_LOSIDESTCL_BMS02 3 "DEM_INVALID" 2 "DEM_FAILED" 1 "DEM_PASSED" 0 "DEM_NOTTESTED" ;
VAL_ 1345 DEM171_SC_CCTRL_HVCNDITION_BMS02 3 "DEM_INVALID" 2 "DEM_FAILED" 1 "DEM_PASSED" 0 "DEM_NOTTESTED" ;
VAL_ 1345 DEM172_SC_CCTRL_POS1_OPN_BMS02 3 "DEM_INVALID" 2 "DEM_FAILED" 1 "DEM_PASSED" 0 "DEM_NOTTESTED" ;
VAL_ 1345 DEM173_SC_CCTRL_POS2_OPN_BMS02 3 "DEM_INVALID" 2 "DEM_FAILED" 1 "DEM_PASSED" 0 "DEM_NOTTESTED" ;
VAL_ 1345 DEM174_SC_CCTRL_POS3_OPN_BMS02 3 "DEM_INVALID" 2 "DEM_FAILED" 1 "DEM_PASSED" 0 "DEM_NOTTESTED" ;
VAL_ 1345 DEM175_SC_CCTRL_NEG1_OPN_BMS02 3 "DEM_INVALID" 2 "DEM_FAILED" 1 "DEM_PASSED" 0 "DEM_NOTTESTED" ;
VAL_ 1345 DEM176_SC_CCTRL_NEG2_OPN_BMS02 3 "DEM_INVALID" 2 "DEM_FAILED" 1 "DEM_PASSED" 0 "DEM_NOTTESTED" ;
VAL_ 1345 DEM177_SC_CCTRL_PRE2_OPN_BMS02 3 "DEM_INVALID" 2 "DEM_FAILED" 1 "DEM_PASSED" 0 "DEM_NOTTESTED" ;
VAL_ 1345 DEM178_SC_CCTRL_PRE1_OPN_BMS02 3 "DEM_INVALID" 2 "DEM_FAILED" 1 "DEM_PASSED" 0 "DEM_NOTTESTED" ;
VAL_ 1345 DEM179_SC_CCTRL_LOSIDESTOP_BMS02 3 "DEM_INVALID" 2 "DEM_FAILED" 1 "DEM_PASSED" 0 "DEM_NOTTESTED" ;
VAL_ 1345 DEM180_SC_CCTRL_UNEXPECTED_BMS02 3 "DEM_INVALID" 2 "DEM_FAILED" 1 "DEM_PASSED" 0 "DEM_NOTTESTED" ;
VAL_ 1345 DEM181_SC_V_OUT_OF_RANGE_BMS02 3 "DEM_INVALID" 2 "DEM_FAILED" 1 "DEM_PASSED" 0 "DEM_NOTTESTED" ;
VAL_ 1345 DEM182_SC_V_LATCHED_UVOV_BMS02 3 "DEM_INVALID" 2 "DEM_FAILED" 1 "DEM_PASSED" 0 "DEM_NOTTESTED" ;
VAL_ 1345 DEM183_ISO_EXT_STRAT_2_BMS02 3 "DEM_INVALID" 2 "DEM_FAILED" 1 "DEM_PASSED" 0 "DEM_NOTTESTED" ;
VAL_ 1345 DEM184_SC_CANTX_CTRS_BMS02 3 "DEM_INVALID" 2 "DEM_FAILED" 1 "DEM_PASSED" 0 "DEM_NOTTESTED" ;
VAL_ 1345 DEM185_SC_CANTX_HVIL_BMS02 3 "DEM_INVALID" 2 "DEM_FAILED" 1 "DEM_PASSED" 0 "DEM_NOTTESTED" ;
VAL_ 1345 DEM186_SC_CANTX_ISOL_BMS02 3 "DEM_INVALID" 2 "DEM_FAILED" 1 "DEM_PASSED" 0 "DEM_NOTTESTED" ;
VAL_ 1345 DEM187_SC_SBC_WATCHDOG_BMS02 3 "DEM_INVALID" 2 "DEM_FAILED" 1 "DEM_PASSED" 0 "DEM_NOTTESTED" ;
VAL_ 1345 DEM188_SC_SBC_FAULT_BMS02 3 "DEM_INVALID" 2 "DEM_FAILED" 1 "DEM_PASSED" 0 "DEM_NOTTESTED" ;
VAL_ 1345 DEM189_SC_WATCHDOG_BMS02 3 "DEM_INVALID" 2 "DEM_FAILED" 1 "DEM_PASSED" 0 "DEM_NOTTESTED" ;
VAL_ 1345 DEM190_SC_SELFTEST_RAM_BMS02 3 "DEM_INVALID" 2 "DEM_FAILED" 1 "DEM_PASSED" 0 "DEM_NOTTESTED" ;
VAL_ 1345 DEM191_SC_SELFTEST_FLASH_BMS02 3 "DEM_INVALID" 2 "DEM_FAILED" 1 "DEM_PASSED" 0 "DEM_NOTTESTED" ;
VAL_ 1409 DEM192_CMB_ONBOARDRH_OH_BMS02 3 "DEM_INVALID" 2 "DEM_FAILED" 1 "DEM_PASSED" 0 "DEM_NOTTESTED" ;
VAL_ 1409 DEM193_CMB_ONBOARDRH_SNA_BMS02 3 "DEM_INVALID" 2 "DEM_FAILED" 1 "DEM_PASSED" 0 "DEM_NOTTESTED" ;
VAL_ 1409 DEM194_CMB_ONBOARDT_OT_BMS02 3 "DEM_INVALID" 2 "DEM_FAILED" 1 "DEM_PASSED" 0 "DEM_NOTTESTED" ;
VAL_ 1409 DEM195_CMB_ONBOARDT_CHANGE_BMS02 3 "DEM_INVALID" 2 "DEM_FAILED" 1 "DEM_PASSED" 0 "DEM_NOTTESTED" ;
VAL_ 1409 DEM196_PRESSURE_CHANGE_BMS02 3 "DEM_INVALID" 2 "DEM_FAILED" 1 "DEM_PASSED" 0 "DEM_NOTTESTED" ;
VAL_ 1409 DEM197_PRESSURE_OVER_BMS02 3 "DEM_INVALID" 2 "DEM_FAILED" 1 "DEM_PASSED" 0 "DEM_NOTTESTED" ;
VAL_ 1409 DEM198_PRESSURE_UNDER_BMS02 3 "DEM_INVALID" 2 "DEM_FAILED" 1 "DEM_PASSED" 0 "DEM_NOTTESTED" ;
VAL_ 1409 DEM199_PRESSURE_INVALID_BMS02 3 "DEM_INVALID" 2 "DEM_FAILED" 1 "DEM_PASSED" 0 "DEM_NOTTESTED" ;
VAL_ 1409 DEM200_THERMAL_EVENT_BMS02 3 "DEM_INVALID" 2 "DEM_FAILED" 1 "DEM_PASSED" 0 "DEM_NOTTESTED" ;
VAL_ 1409 DEM201_CMB_ONBOARDT_SNA_BMS02 3 "DEM_INVALID" 2 "DEM_FAILED" 1 "DEM_PASSED" 0 "DEM_NOTTESTED" ;
VAL_ 1409 DEM202_REPLACE_DESICCANT_BMS02 3 "DEM_INVALID" 2 "DEM_FAILED" 1 "DEM_PASSED" 0 "DEM_NOTTESTED" ;
VAL_ 1409 DEM203_COOLANT_FLOOD_FAULT_BMS02 3 "DEM_INVALID" 2 "DEM_FAILED" 1 "DEM_PASSED" 0 "DEM_NOTTESTED" ;
VAL_ 1409 DEM204_LOW_BRICKCAPACITY_BMS02 3 "DEM_INVALID" 2 "DEM_FAILED" 1 "DEM_PASSED" 0 "DEM_NOTTESTED" ;
VAL_ 1409 DEM205_BMS_ONBOARDT_OT_BMS02 3 "DEM_INVALID" 2 "DEM_FAILED" 1 "DEM_PASSED" 0 "DEM_NOTTESTED" ;
VAL_ 1409 DEM206_HUMIDITY_CHANGE_BMS02 3 "DEM_INVALID" 2 "DEM_FAILED" 1 "DEM_PASSED" 0 "DEM_NOTTESTED" ;
VAL_ 1409 DEM207_ISENSE_SUPPLY_CURR_BMS02 3 "DEM_INVALID" 2 "DEM_FAILED" 1 "DEM_PASSED" 0 "DEM_NOTTESTED" ;
VAL_ 1409 DEM208_SOC_LOW_BMS02 3 "DEM_INVALID" 2 "DEM_FAILED" 1 "DEM_PASSED" 0 "DEM_NOTTESTED" ;
VAL_ 1409 DEM209_SOC_TOOLOW_BMS02 3 "DEM_INVALID" 2 "DEM_FAILED" 1 "DEM_PASSED" 0 "DEM_NOTTESTED" ;
VAL_ 1409 DEM210_SOC_TOOHIGH_BMS02 3 "DEM_INVALID" 2 "DEM_FAILED" 1 "DEM_PASSED" 0 "DEM_NOTTESTED" ;
VAL_ 1409 DEM211_BALANCING_REQUIRED_BMS02 3 "DEM_INVALID" 2 "DEM_FAILED" 1 "DEM_PASSED" 0 "DEM_NOTTESTED" ;
VAL_ 1409 DEM212_DEEP_DISCHARGE_BMS02 3 "DEM_INVALID" 2 "DEM_FAILED" 1 "DEM_PASSED" 0 "DEM_NOTTESTED" ;
VAL_ 1409 DEM213_CAN1_BUS_OFF_BMS02 3 "DEM_INVALID" 2 "DEM_FAILED" 1 "DEM_PASSED" 0 "DEM_NOTTESTED" ;
VAL_ 1409 DEM214_CAN2_BUS_OFF_BMS02 3 "DEM_INVALID" 2 "DEM_FAILED" 1 "DEM_PASSED" 0 "DEM_NOTTESTED" ;
VAL_ 1409 DEM215_CAN3_BUS_OFF_BMS02 3 "DEM_INVALID" 2 "DEM_FAILED" 1 "DEM_PASSED" 0 "DEM_NOTTESTED" ;
VAL_ 1409 DEM216_OUTLET_NTC_RATNAL_BMS02 3 "DEM_INVALID" 2 "DEM_FAILED" 1 "DEM_PASSED" 0 "DEM_NOTTESTED" ;
VAL_ 1409 DEM217_FUSE_PACK_BMS02 3 "DEM_INVALID" 2 "DEM_FAILED" 1 "DEM_PASSED" 0 "DEM_NOTTESTED" ;
VAL_ 1409 DEM218_FUSE_B_OPEN_BMS02 3 "DEM_INVALID" 2 "DEM_FAILED" 1 "DEM_PASSED" 0 "DEM_NOTTESTED" ;
VAL_ 1409 DEM219_FUSE_C_OPEN_BMS02 3 "DEM_INVALID" 2 "DEM_FAILED" 1 "DEM_PASSED" 0 "DEM_NOTTESTED" ;
VAL_ 1409 DEM220_FUSE_D_OPEN_BMS02 3 "DEM_INVALID" 2 "DEM_FAILED" 1 "DEM_PASSED" 0 "DEM_NOTTESTED" ;
VAL_ 1409 DEM221_FUSE_E_OPEN_BMS02 3 "DEM_INVALID" 2 "DEM_FAILED" 1 "DEM_PASSED" 0 "DEM_NOTTESTED" ;
VAL_ 1409 DEM222_PUMP_DRY_RUN_BMS02 3 "DEM_INVALID" 2 "DEM_FAILED" 1 "DEM_PASSED" 0 "DEM_NOTTESTED" ;
VAL_ 1409 DEM223_PUMP_PERFORMANCE_BMS02 3 "DEM_INVALID" 2 "DEM_FAILED" 1 "DEM_PASSED" 0 "DEM_NOTTESTED" ;
VAL_ 1473 DEM224_PUMP_LIN_FAILURE_BMS02 3 "DEM_INVALID" 2 "DEM_FAILED" 1 "DEM_PASSED" 0 "DEM_NOTTESTED" ;
VAL_ 1473 DEM225_PUMP_SUPPLY_VOLTAGE_BMS02 3 "DEM_INVALID" 2 "DEM_FAILED" 1 "DEM_PASSED" 0 "DEM_NOTTESTED" ;
VAL_ 1473 DEM226_PUMP_RECOVERY_FAIL_BMS02 3 "DEM_INVALID" 2 "DEM_FAILED" 1 "DEM_PASSED" 0 "DEM_NOTTESTED" ;
VAL_ 1473 DEM227_CTR_POS_OPENED_BMS02 3 "DEM_INVALID" 2 "DEM_FAILED" 1 "DEM_PASSED" 0 "DEM_NOTTESTED" ;
VAL_ 1473 DEM228_CTR_NEG_OPENED_BMS02 3 "DEM_INVALID" 2 "DEM_FAILED" 1 "DEM_PASSED" 0 "DEM_NOTTESTED" ;
VAL_ 1473 DEM229_STRSET_SLAVE1_FAULT_BMS02 3 "DEM_INVALID" 2 "DEM_FAILED" 1 "DEM_PASSED" 0 "DEM_NOTTESTED" ;
VAL_ 1473 DEM230_STRSET_SLAVE2_FAULT_BMS02 3 "DEM_INVALID" 2 "DEM_FAILED" 1 "DEM_PASSED" 0 "DEM_NOTTESTED" ;
VAL_ 1473 DEM231_CTRSAUX_CLFAIL_HVON_BMS02 3 "DEM_INVALID" 2 "DEM_FAILED" 1 "DEM_PASSED" 0 "DEM_NOTTESTED" ;
VAL_ 1473 DEM232_CTRSAUX_CLFAIL_VDIF_BMS02 3 "DEM_INVALID" 2 "DEM_FAILED" 1 "DEM_PASSED" 0 "DEM_NOTTESTED" ;
VAL_ 1473 DEM233_CTRSAUX_POS1_OPENED_BMS02 3 "DEM_INVALID" 2 "DEM_FAILED" 1 "DEM_PASSED" 0 "DEM_NOTTESTED" ;
VAL_ 1473 DEM234_CTRSAUX_NEG1_OPENED_BMS02 3 "DEM_INVALID" 2 "DEM_FAILED" 1 "DEM_PASSED" 0 "DEM_NOTTESTED" ;
VAL_ 1473 DEM235_CTRSAUX_POS1_WELDED_BMS02 3 "DEM_INVALID" 2 "DEM_FAILED" 1 "DEM_PASSED" 0 "DEM_NOTTESTED" ;
VAL_ 1473 DEM236_CTRSAUX_NEG1_WELDED_BMS02 3 "DEM_INVALID" 2 "DEM_FAILED" 1 "DEM_PASSED" 0 "DEM_NOTTESTED" ;
VAL_ 1473 DEM237_CTRSAUX_POS1_PULLIN_BMS02 3 "DEM_INVALID" 2 "DEM_FAILED" 1 "DEM_PASSED" 0 "DEM_NOTTESTED" ;
VAL_ 1473 DEM238_CTRSAUX_NEG1_PULLIN_BMS02 3 "DEM_INVALID" 2 "DEM_FAILED" 1 "DEM_PASSED" 0 "DEM_NOTTESTED" ;
VAL_ 1473 DEM239_INLET_NTC_RATNAL_BMS02 3 "DEM_INVALID" 2 "DEM_FAILED" 1 "DEM_PASSED" 0 "DEM_NOTTESTED" ;
VAL_ 1473 DEM240_INLET_NTC_HI_BMS02 3 "DEM_INVALID" 2 "DEM_FAILED" 1 "DEM_PASSED" 0 "DEM_NOTTESTED" ;
VAL_ 1473 DEM241_INLET_NTC_LO_BMS02 3 "DEM_INVALID" 2 "DEM_FAILED" 1 "DEM_PASSED" 0 "DEM_NOTTESTED" ;
VAL_ 1473 DEM242_VOLTAGE_LINK2_RATNA_BMS02 3 "DEM_INVALID" 2 "DEM_FAILED" 1 "DEM_PASSED" 0 "DEM_NOTTESTED" ;
VAL_ 1473 DEM243_VOLTAGE_LINK2_HI_BMS02 3 "DEM_INVALID" 2 "DEM_FAILED" 1 "DEM_PASSED" 0 "DEM_NOTTESTED" ;
VAL_ 1473 DEM244_VOLTAGE_LINK2_LO_BMS02 3 "DEM_INVALID" 2 "DEM_FAILED" 1 "DEM_PASSED" 0 "DEM_NOTTESTED" ;
VAL_ 1473 DEM245_CMB_ONBOARD_IMPOSSI_BMS02 3 "DEM_INVALID" 2 "DEM_FAILED" 1 "DEM_PASSED" 0 "DEM_NOTTESTED" ;
VAL_ 1473 DEM246_VOLTAGE_LINK1_HI_BMS02 3 "DEM_INVALID" 2 "DEM_FAILED" 1 "DEM_PASSED" 0 "DEM_NOTTESTED" ;
VAL_ 1473 DEM247_VOLTAGE_LINK1_LO_BMS02 3 "DEM_INVALID" 2 "DEM_FAILED" 1 "DEM_PASSED" 0 "DEM_NOTTESTED" ;
VAL_ 1473 DEM248_NTC_SUPPLY_LO_BMS02 3 "DEM_INVALID" 2 "DEM_FAILED" 1 "DEM_PASSED" 0 "DEM_NOTTESTED" ;
VAL_ 1473 DEM249_NTC_SUPPLY_HI_BMS02 3 "DEM_INVALID" 2 "DEM_FAILED" 1 "DEM_PASSED" 0 "DEM_NOTTESTED" ;
VAL_ 1473 DEM250_VOLTAGE_LINK3_RATNA_BMS02 3 "DEM_INVALID" 2 "DEM_FAILED" 1 "DEM_PASSED" 0 "DEM_NOTTESTED" ;
VAL_ 1473 DEM251_VOLTAGE_LINK3_HI_BMS02 3 "DEM_INVALID" 2 "DEM_FAILED" 1 "DEM_PASSED" 0 "DEM_NOTTESTED" ;
VAL_ 1473 DEM252_VOLTAGE_LINK3_LO_BMS02 3 "DEM_INVALID" 2 "DEM_FAILED" 1 "DEM_PASSED" 0 "DEM_NOTTESTED" ;
VAL_ 1473 DEM253_BALANCING_STUCK_BMS02 3 "DEM_INVALID" 2 "DEM_FAILED" 1 "DEM_PASSED" 0 "DEM_NOTTESTED" ;
VAL_ 1473 DEM254_ARM_EXCEPTION_BMS02 3 "DEM_INVALID" 2 "DEM_FAILED" 1 "DEM_PASSED" 0 "DEM_NOTTESTED" ;
VAL_ 1473 DEM255_ERROR_HOOKS_BMS02 3 "DEM_INVALID" 2 "DEM_FAILED" 1 "DEM_PASSED" 0 "DEM_NOTTESTED" ;
VAL_ 833 DEM256_XCP_CAL_CHANGE_BMS02 3 "DEM_INVALID" 2 "DEM_FAILED" 1 "DEM_PASSED" 0 "DEM_NOTTESTED" ;
VAL_ 833 DEM257_XCP_CAL_PERM_CHANGE_BMS02 3 "DEM_INVALID" 2 "DEM_FAILED" 1 "DEM_PASSED" 0 "DEM_NOTTESTED" ;
VAL_ 833 DEM258_TASK_TIME_OVERFLOW_BMS02 3 "DEM_INVALID" 2 "DEM_FAILED" 1 "DEM_PASSED" 0 "DEM_NOTTESTED" ;
VAL_ 833 DEM259_ISO_CIRCUIT_BMS02 3 "DEM_INVALID" 2 "DEM_FAILED" 1 "DEM_PASSED" 0 "DEM_NOTTESTED" ;
VAL_ 833 DEM260_COOLANT_MOIST_FAULT_BMS02 3 "DEM_INVALID" 2 "DEM_FAILED" 1 "DEM_PASSED" 0 "DEM_NOTTESTED" ;
VAL_ 833 DEM261_COOLANT_FLOOD_WARN_BMS02 3 "DEM_INVALID" 2 "DEM_FAILED" 1 "DEM_PASSED" 0 "DEM_NOTTESTED" ;
VAL_ 833 DEM262_COOLANT_MOIST_WARN_BMS02 3 "DEM_INVALID" 2 "DEM_FAILED" 1 "DEM_PASSED" 0 "DEM_NOTTESTED" ;
VAL_ 833 DEM263_MODULET_IMPLAUSIBLE_BMS02 3 "DEM_INVALID" 2 "DEM_FAILED" 1 "DEM_PASSED" 0 "DEM_NOTTESTED" ;
VAL_ 833 DEM264_REQUEST_ON_WITH_HV__BMS02 3 "DEM_INVALID" 2 "DEM_FAILED" 1 "DEM_PASSED" 0 "DEM_NOTTESTED" ;
VAL_ 833 DEM265_CSERS_PCODE_BMS02 3 "DEM_INVALID" 2 "DEM_FAILED" 1 "DEM_PASSED" 0 "DEM_NOTTESTED" ;
VAL_ 833 DEM266_PRELIM_CNTR_CL_FAIL_BMS02 3 "DEM_INVALID" 2 "DEM_FAILED" 1 "DEM_PASSED" 0 "DEM_NOTTESTED" ;
VAL_ 833 DEM267_FLUIDLVL_LOW_BMS02 3 "DEM_INVALID" 2 "DEM_FAILED" 1 "DEM_PASSED" 0 "DEM_NOTTESTED" ;
VAL_ 833 DEM268_FLUIDLVL_FAILURE_BMS02 3 "DEM_INVALID" 2 "DEM_FAILED" 1 "DEM_PASSED" 0 "DEM_NOTTESTED" ;
VAL_ 833 DEM269_SC_COOLANT_CONTAM_BMS02 3 "DEM_INVALID" 2 "DEM_FAILED" 1 "DEM_PASSED" 0 "DEM_NOTTESTED" ;
VAL_ 833 DEM270_SC_COOLANT_MIA_BMS02 3 "DEM_INVALID" 2 "DEM_FAILED" 1 "DEM_PASSED" 0 "DEM_NOTTESTED" ;
VAL_ 833 DEM271_PRESSURE_VHI_BMS02 3 "DEM_INVALID" 2 "DEM_FAILED" 1 "DEM_PASSED" 0 "DEM_NOTTESTED" ;
VAL_ 833 DEM272_PRESSURE_VLO_BMS02 3 "DEM_INVALID" 2 "DEM_FAILED" 1 "DEM_PASSED" 0 "DEM_NOTTESTED" ;
VAL_ 833 DEM273_SC_COOLANT_FAIL_BMS02 3 "DEM_INVALID" 2 "DEM_FAILED" 1 "DEM_PASSED" 0 "DEM_NOTTESTED" ;
VAL_ 833 DEM274_CTRSAUX_POS2_OPENED_BMS02 3 "DEM_INVALID" 2 "DEM_FAILED" 1 "DEM_PASSED" 0 "DEM_NOTTESTED" ;
VAL_ 833 DEM275_CTRSAUX_POS3_OPENED_BMS02 3 "DEM_INVALID" 2 "DEM_FAILED" 1 "DEM_PASSED" 0 "DEM_NOTTESTED" ;
VAL_ 833 DEM276_CTRSAUX_POS2_WELDED_BMS02 3 "DEM_INVALID" 2 "DEM_FAILED" 1 "DEM_PASSED" 0 "DEM_NOTTESTED" ;
VAL_ 833 DEM277_CTRSAUX_POS3_WELDED_BMS02 3 "DEM_INVALID" 2 "DEM_FAILED" 1 "DEM_PASSED" 0 "DEM_NOTTESTED" ;
VAL_ 833 DEM278_CTRSAUX_POS2_PULLIN_BMS02 3 "DEM_INVALID" 2 "DEM_FAILED" 1 "DEM_PASSED" 0 "DEM_NOTTESTED" ;
VAL_ 833 DEM279_CTRSAUX_POS3_PULLIN_BMS02 3 "DEM_INVALID" 2 "DEM_FAILED" 1 "DEM_PASSED" 0 "DEM_NOTTESTED" ;
VAL_ 833 DEM280_CMB_HUMIDITY_TEMP_C_BMS02 3 "DEM_INVALID" 2 "DEM_FAILED" 1 "DEM_PASSED" 0 "DEM_NOTTESTED" ;
VAL_ 833 DEM281_THERMAL_EVENT_CMB_R_BMS02 3 "DEM_INVALID" 2 "DEM_FAILED" 1 "DEM_PASSED" 0 "DEM_NOTTESTED" ;
VAL_ 833 DEM282_CUS_BRICKOV_BMS02 3 "DEM_INVALID" 2 "DEM_FAILED" 1 "DEM_PASSED" 0 "DEM_NOTTESTED" ;
VAL_ 833 DEM283_CUS_BRICKUV_BMS02 3 "DEM_INVALID" 2 "DEM_FAILED" 1 "DEM_PASSED" 0 "DEM_NOTTESTED" ;
VAL_ 833 DEM284_CUS_OVERCHRG_BMS02 3 "DEM_INVALID" 2 "DEM_FAILED" 1 "DEM_PASSED" 0 "DEM_NOTTESTED" ;
VAL_ 833 DEM285_CUS_OVERDCHRG_BMS02 3 "DEM_INVALID" 2 "DEM_FAILED" 1 "DEM_PASSED" 0 "DEM_NOTTESTED" ;
VAL_ 833 DEM286_CUS_CURRENT_CHG_BMS02 3 "DEM_INVALID" 2 "DEM_FAILED" 1 "DEM_PASSED" 0 "DEM_NOTTESTED" ;
VAL_ 833 DEM287_CUS_CURRENT_DCHG_BMS02 3 "DEM_INVALID" 2 "DEM_FAILED" 1 "DEM_PASSED" 0 "DEM_NOTTESTED" ;
VAL_ 1601 selfTestStartupFault_SC02 6 "SELFTEST_PBIST_OTHER_RAM_FAULT" 5 "SELFTEST_PBIST_CPU_RAM_FAULT" 4 "SELFTEST_PBIST_ROM_FAULT" 3 "SELFTEST_PBIST_STC_ROM_FAULT" 2 "SELFTEST_STC_FAULT" 1 "SELFTEST_CPU_FAULT" 0 "SELFTEST_STARTUP_OK" ;
VAL_ 1601 sbcARTimerStatus_SC02 15 "SNA" 6 "SBC_AR_COMPLETE" 5 "SBC_AR_INTERRUPTED" 4 "SBC_AR_READ_SUCCESS" 3 "SBC_AR_STOPPED" 2 "SBC_AR_RUNTOSTOP" 0 "SBC_AR_INIT" 1 "SBC_AR_RUNNING" ;
VAL_ 1601 sbcARTimerValue_SC02 255 "SNA" ;
VAL_ 1601 cmbVAIndex_SC02 255 "CMB_NONE" ;
VAL_ 1601 minVACMB_SC02 65535 "SNA" ;
VAL_ 1601 maxVACMB_SC02 65535 "SNA" ;
VAL_ 1601 pumpInternalFaultError_SC02 1 "ERROR" 0 "NO_ERROR" ;
VAL_ 1601 pumpShortCircuitError_SC02 1 "ERROR" 0 "NO_ERROR" ;
VAL_ 1601 pumpElectricError_SC02 1 "ERROR" 0 "NO_ERROR" 3 "SNA" ;
VAL_ 1601 pumpPostRunMode_SC02 7 "SNA" 4 "SPEED_4" 3 "SPEED_3" 2 "SPEED_2" 1 "SPEED_1" 0 "NO_POST_RUN" ;
VAL_ 1601 pumpRsError_SC02 1 "ERROR" 0 "NO_ERROR" ;
VAL_ 1601 pumpWakeUpStatus_SC02 2 "NDEF2" 1 "ACTIVE_WUP" 0 "NO_WUP" 3 "SNA" ;
VAL_ 1601 pumpRpmMonStat_SC02 1 "NO_MON" 0 "MON_ACTIVE" 3 "SNA" ;
VAL_ 1601 pumpPwmInStat_SC02 1 "HIGH" 0 "LOW" 3 "SNA" ;
VAL_ 1601 pumpDiagTriggered_SC02 1 "TRUE" 0 "FALSE" ;
VAL_ 1601 pumpHwFault_SC02 1 "ERROR" 0 "NO_ERROR" ;
VAL_ 1601 pumpPumpState_SC02 6 "ERROR" 5 "HARDWARE_ERROR" 1 "RUN" 0 "IDLE" 7 "SNA" ;
VAL_ 1601 pumpBlockError_SC02 0 "NO_ERROR" 1 "ERROR" 3 "SNA" ;
VAL_ 1601 pumpLinError_SC02 1 "ERROR" 0 "NO_ERROR" ;
VAL_ 1601 pumpDryRun_SC02 1 "ERROR" 0 "NO_ERROR" 3 "SNA" ;
VAL_ 1601 pumpOverCurrent_SC02 1 "ERROR" 0 "NO_ERROR" 3 "SNA" ;
VAL_ 1601 pumpVoltageDeratingError_SC02 1 "ERROR" 0 "NO_ERROR" ;
VAL_ 1601 pumpSupVoltageError_SC02 1 "ERROR" 0 "NO_ERROR" 3 "SNA" ;
VAL_ 1601 pumpUnderVoltage_SC02 1 "ERROR" 0 "NO_ERROR" ;
VAL_ 1601 pumpOverVoltage_SC02 1 "ERROR" 0 "NO_ERROR" ;
VAL_ 1601 pumpTempProtect_SC02 1 "ERROR" 0 "NO_ERROR" ;
VAL_ 1601 pumpOverTempDeratingErr_SC02 1 "ERROR" 0 "NO_ERROR" ;
VAL_ 1601 pumpOverTemperature_SC02 1 "ERROR" 0 "NO_ERROR" 3 "SNA" ;
VAL_ 1601 pressure2_SC02 255 "SNA" ;
VAL_ 1601 cmbSM29ScoutTempIndex_SC02 255 "SNA" ;
VAL_ 1601 cmbSM19ScoutPDO_SC02 65535 "SNA" ;
VAL_ 1601 isolationResInternRelaxed_SC02 65535 "SNA" ;
VAL_ 1601 appTask500HzMaxAvg_SC02 255 "SNA" ;
VAL_ 1601 safetyHangLastLinkReg_SC02 -1 "SNA" ;
VAL_ 1601 safetyHangPresentLinkReg_SC02 -1 "SNA" ;
VAL_ 1601 safetyHangDataFaultStatus_SC02 -1 "SNA" ;
VAL_ 1601 safetyHangDataFaultAddr_SC02 -1 "SNA" ;
VAL_ 1601 safetyHangLastARMMode_SC02 255 "MODE_UNKNOWN" 6 "MODE_SYS" 5 "MODE_UND" 4 "MODE_ABT" 3 "MODE_SVC" 2 "MODE_IRQ" 1 "MODE_FIQ" 0 "MODE_USER" ;
VAL_ 1601 safetyHangPresARMMode_SC02 255 "MODE_UNKNOWN" 6 "MODE_SYS" 5 "MODE_UND" 4 "MODE_ABT" 3 "MODE_SVC" 2 "MODE_IRQ" 1 "MODE_FIQ" 0 "MODE_USER" ;
VAL_ 1601 safetyHangESMGrp3Reg_SC02 -1 "SNA" ;
VAL_ 1601 safetyHangInstrFaultStatus_SC02 -1 "SNA" ;
VAL_ 1601 safetyHangInstrFaultAddr_SC02 -1 "SNA" ;
VAL_ 1601 pressure_SC02 255 "SNA" ;
VAL_ 1601 cmbMaxSM33Diff_SC02 255 "SNA" ;
VAL_ 1601 cmbMinSM29Diff_SC02 255 "SNA" ;
VAL_ 1601 cmbMinSM4Diff_SC02 65535 "SNA" ;
VAL_ 1601 cmbMaxSM4Diff_SC02 65535 "SNA" ;
VAL_ 1601 cmbMinSM27Diff_SC02 65535 "SNA" ;
VAL_ 1601 cmbMaxSM27Diff_SC02 65535 "SNA" ;
VAL_ 1601 adcDriverFail_SC02 12 "ADCDRIVER_SBCSUPPLY_FF" 11 "ADCDRIVER_MUX960_FF" 10 "ADCDRIVER_MUX910_FF" 9 "ADCDRIVER_UNDEF" 8 "ADCDRIVER_ADCVAR" 7 "ADCDRIVER_SLEEP_FF" 6 "ADCDRIVER_PYRO_FF" 5 "ADCDRIVER_MUX710_FF" 4 "ADCDRIVER_MUX440_FF" 3 "ADCDRIVER_MUX302A_FF" 2 "ADCDRIVER_MUX301B_FF" 1 "ADCDRIVER_MUX301A_FF" 0 "ADCDRIVER_NO_ISSUE" ;
VAL_ 1601 mainUcHvilState_SC02 2 "CANTX_HVIL_CLOSE" 3 "CANTX_HVIL_SNA" 1 "CANTX_HVIL_OPEN" 0 "CANTX_HVIL_NOT_AVAIL" ;
VAL_ 1601 mainUcIntIsoErr_SC02 3 "ISOLATION_SNA" 2 "ISOLATION_ERR_OFF" 1 "ISOLATION_ERROR" 0 "ISOLATION_OK" ;
VAL_ 1601 mainUcExtIsoErr_SC02 3 "ISOLATION_SNA" 2 "ISOLATION_ERR_OFF" 1 "ISOLATION_ERROR" 0 "ISOLATION_OK" ;
VAL_ 1601 safetyUcThermalStatus_SC02 3 "THERMALEVENT_SNA" 2 "THERMALEVENT_WARN_2" 1 "THERMALEVENT_WARN_1" 0 "THERMALEVENT_NO_WARN" ;
VAL_ 1601 mainUcThermalStatus_SC02 3 "THERMALEVENT_SNA" 2 "THERMALEVENT_WARN_2" 1 "THERMALEVENT_WARN_1" 0 "THERMALEVENT_NO_WARN" ;
VAL_ 1601 selfTestDataFaultStatus_SC02 -1 "SNA" ;
VAL_ 1601 selfTestInstrFaultAddr_SC02 -1 "SNA" ;
VAL_ 1601 selfTestDataFaultAddr_SC02 -1 "SNA" ;
VAL_ 1601 selfTestInstrFaultStatus_SC02 -1 "SNA" ;
VAL_ 1601 internalIsolationError_SC02 3 "ISOLATION_SNA" 2 "ISOLATION_ERR_OFF" 1 "ISOLATION_ERROR" 0 "ISOLATION_OK" ;
VAL_ 1601 externalIsolationError_SC02 3 "ISOLATION_SNA" 2 "ISOLATION_ERR_OFF" 1 "ISOLATION_ERROR" 0 "ISOLATION_OK" ;
VAL_ 1601 isolationTestState_SC02 3 "ISOLATION_TEST_POSNEG" 2 "ISOLATION_TEST_NEG" 1 "ISOLATION_TEST_POS" 0 "ISOLATION_OFF" ;
VAL_ 1601 isolationResistanceIntern_SC02 65535 "SNA" ;
VAL_ 1601 isolationResistanceExtern_SC02 65535 "SNA" ;
VAL_ 1601 maxAdolV13Diff_SC02 65535 "SNA" ;
VAL_ 1601 pumpType_SC02 0 "PUMP_NONE" 1 "PUMP_MAL" 2 "PUMP_BOSCH" 3 "PUMP_JOMA" 4 "PUMP_MAHLE" 255 "SNA" ;
VAL_ 1601 pumpPhaseCurrent_SC02 255 "SNA" ;
VAL_ 1601 hvWithstandTestQual_SC02 1 "QUAL_ERROR" 0 "QUAL_VALID" ;
VAL_ 1601 currentModuleMax_SC02 65535 "SNA" ;
VAL_ 1601 currentModuleMin_SC02 65535 "SNA" ;
VAL_ 1601 maxCMBDieTemp_SC02 255 "SNA" ;
VAL_ 1601 minCMBDieTemp_SC02 255 "SNA" ;
VAL_ 1601 appTaskSpiRxTx_SC02 255 "SNA" ;
VAL_ 1601 variantCodingCounts_SC02 255 "SNA" ;
VAL_ 1601 cmbMaxUpdateTime_SC02 255 "SNA" ;
VAL_ 1601 pumpSetSpeed_SC02 255 "SNA" ;
VAL_ 1601 hvilResistance_SC02 255 "SNA" ;
VAL_ 1601 cmbAvgUpdateTime_SC02 255 "SNA" ;
VAL_ 1601 pumpTemperature_SC02 255 "SNA" ;
VAL_ 1601 pumpSpeed_SC02 255 "SNA" ;
VAL_ 1601 pumpVoltage_SC02 255 "SNA" ;
VAL_ 1601 pumpCurrent_SC02 255 "SNA" ;
VAL_ 1601 posLink3_SC02 65535 "SNA" ;
VAL_ 1601 negLink3_SC02 65535 "SNA" ;
VAL_ 1601 posLink2_SC02 65535 "SNA" ;
VAL_ 1601 negLink2_SC02 65535 "SNA" ;
VAL_ 1601 cmbNrOfSamples_SC02 65535 "SNA" ;
VAL_ 1601 cmbTaskTime_SC02 65535 "SNA" ;
VAL_ 1601 appTask500HzMax_SC02 255 "SNA" ;
VAL_ 1601 analogHallSense_SC02 65535 "SNA" ;
VAL_ 1601 cmbMaxDiagStepPeriodicity_SC02 255 "SNA" ;
VAL_ 1601 minBrickVoltageLimit_SC02 65535 "SNA" ;
VAL_ 1601 appTask100Hz_SC02 255 "SNA" ;
VAL_ 1601 appTask10Hz_SC02 255 "SNA" ;
VAL_ 1601 appTaskAnalog_SC02 255 "SNA" ;
VAL_ 1601 appTaskADC_SC02 255 "SNA" ;
VAL_ 1601 appTask500HzAvg_SC02 255 "SNA" ;
VAL_ 1601 appTaskSBC_SC02 255 "SNA" ;
VAL_ 1601 appTaskCMBDriver_SC02 255 "SNA" ;
VAL_ 1601 safetyInitTime_SC02 255 "SNA" ;
VAL_ 1601 debugSlowMpex_SC02 45 "S45" 44 "S44" 43 "S43" 42 "S42" 41 "S41" 0 "S00" 1 "S01" 2 "S02" 3 "S03" 4 "S04" 5 "S05" 6 "S06" 7 "S07" 8 "S08" 9 "S09" 10 "S10" 11 "S11" 12 "S12" 13 "S13" 14 "S14" 15 "S15" 16 "S16" 17 "S17" 18 "S18" 19 "S19" 20 "S20" 21 "S21" 22 "S22" 23 "S23" 24 "S24" 25 "S25" 26 "S26" 27 "S27" 28 "S28" 29 "S29" 30 "S30" 31 "S31" 32 "S32" 33 "S33" 34 "S34" 35 "S35" 36 "S36" 37 "S37" 38 "S38" 39 "S39" 40 "S40" ;
VAL_ 1601 mux440Gnd_SC02 255 "SNA" ;
VAL_ 1601 analogHallGain_SC02 65535 "SNA" ;
VAL_ 1601 analogHallOffset_SC02 255 "SNA" ;
VAL_ 1601 negPackPrime_SC02 65535 "SNA" ;
VAL_ 1601 posPackPrime_SC02 65535 "SNA" ;
VAL_ 1601 packVoltage_SC02 65535 "SNA" ;
VAL_ 1601 sleepTime_SC02 65535 "SNA" ;
VAL_ 1601 analogNegHVOffset_SC02 255 "SNA" ;
VAL_ 1601 analogPosHVOffset_SC02 255 "SNA" ;
VAL_ 1601 analogNegHVGain_SC02 65535 "SNA" ;
VAL_ 1601 analogPosHVGain_SC02 65535 "SNA" ;
VAL_ 1601 mux910Gnd_SC02 255 "SNA" ;
VAL_ 1601 mux960Gnd_SC02 255 "SNA" ;
VAL_ 1601 analogAddr5_SC02 65535 "SNA" ;
VAL_ 1601 analogAddr4_SC02 65535 "SNA" ;
VAL_ 1601 analogAddr3_SC02 65535 "SNA" ;
VAL_ 1601 analogAddr2_SC02 65535 "SNA" ;
VAL_ 1601 analogAddr1_SC02 65535 "SNA" ;
VAL_ 1601 analogAddr0_SC02 65535 "SNA" ;
VAL_ 1601 sbcVREF2P5_SC02 255 "SNA" ;
VAL_ 1601 mux910N3VRef_SC02 65535 "SNA" ;
VAL_ 1601 mux910P2P5VRef_SC02 65535 "SNA" ;
VAL_ 1601 analogHvilCurrentPWM_SC02 255 "SNA" ;
VAL_ 1601 analogSBCSupply_SC02 255 "SNA" ;
VAL_ 1601 analogHvilCurrent_SC02 255 "SNA" ;
VAL_ 1601 analogPressureSense_SC02 255 "SNA" ;
VAL_ 1601 analog5VSensorSupply_SC02 255 "SNA" ;
VAL_ 1601 analogPrechgRel2CoilMinus_SC02 255 "SNA" ;
VAL_ 1601 analogPrechgRel1CoilMinus_SC02 255 "SNA" ;
VAL_ 1601 analogNegCntr3CoilMinus_SC02 255 "SNA" ;
VAL_ 1601 analogNegCntr2CoilMinus_SC02 255 "SNA" ;
VAL_ 1601 analogNegCntr1CoilMinus_SC02 255 "SNA" ;
VAL_ 1601 analogPosCntr3CoilMinus_SC02 255 "SNA" ;
VAL_ 1601 analogPosCntr2CoilMinus_SC02 255 "SNA" ;
VAL_ 1601 analogPosCntr1CoilMinus_SC02 255 "SNA" ;
VAL_ 1601 minModuleTemperature_SC02 255 "SNA" ;
VAL_ 1601 maxModuleTemperature_SC02 255 "SNA" ;
VAL_ 1601 analogHvilReturn_SC02 255 "SNA" ;
VAL_ 1601 analog5VDSupply_SC02 255 "SNA" ;
VAL_ 1601 analogHvilOut_SC02 255 "SNA" ;
VAL_ 1601 analogCurrentSensor12V_SC02 255 "SNA" ;
VAL_ 1601 maxVREF2_SC02 65535 "SNA" ;
VAL_ 1601 minVREF2_SC02 65535 "SNA" ;
VAL_ 1601 hallCurrentOffset_SC02 65535 "SNA" ;
VAL_ 1601 sumOfCurrentsFiltered_SC02 65535 "SNA" ;
VAL_ 1601 hallCurrentAveraged_SC02 65535 "SNA" ;
VAL_ 1601 analogHallSupply_SC02 65535 "SNA" ;
VAL_ 1601 contactorControlPos1_SC02 4 "CTRCTRL_CTRFAIL" 3 "CTRCTRL_CTRON" 2 "CTRCTRL_CTRCHECK" 1 "CTRCTRL_ADDITIONAL_CTRCHECK" 0 "CTRCTRL_CTROFF" ;
VAL_ 1601 contactorControlNeg1_SC02 4 "CTRCTRL_CTRFAIL" 3 "CTRCTRL_CTRON" 2 "CTRCTRL_CTRCHECK" 1 "CTRCTRL_ADDITIONAL_CTRCHECK" 0 "CTRCTRL_CTROFF" ;
VAL_ 1601 contactorControlPre1_SC02 4 "CTRCTRL_CTRFAIL" 3 "CTRCTRL_CTRON" 2 "CTRCTRL_CTRCHECK" 1 "CTRCTRL_ADDITIONAL_CTRCHECK" 0 "CTRCTRL_CTROFF" ;
VAL_ 1601 contactorControlPos2_SC02 4 "CTRCTRL_CTRFAIL" 3 "CTRCTRL_CTRON" 2 "CTRCTRL_CTRCHECK" 1 "CTRCTRL_ADDITIONAL_CTRCHECK" 0 "CTRCTRL_CTROFF" ;
VAL_ 1601 contactorControlNeg2_SC02 4 "CTRCTRL_CTRFAIL" 3 "CTRCTRL_CTRON" 2 "CTRCTRL_CTRCHECK" 1 "CTRCTRL_ADDITIONAL_CTRCHECK" 0 "CTRCTRL_CTROFF" ;
VAL_ 1601 contactorControlPre2_SC02 4 "CTRCTRL_CTRFAIL" 3 "CTRCTRL_CTRON" 2 "CTRCTRL_CTRCHECK" 1 "CTRCTRL_ADDITIONAL_CTRCHECK" 0 "CTRCTRL_CTROFF" ;
VAL_ 1601 contactorControlPos3_SC02 4 "CTRCTRL_CTRFAIL" 3 "CTRCTRL_CTRON" 2 "CTRCTRL_CTRCHECK" 1 "CTRCTRL_ADDITIONAL_CTRCHECK" 0 "CTRCTRL_CTROFF" ;
VAL_ 1601 contactorControlNeg3_SC02 4 "CTRCTRL_CTRFAIL" 3 "CTRCTRL_CTRON" 2 "CTRCTRL_CTRCHECK" 1 "CTRCTRL_ADDITIONAL_CTRCHECK" 0 "CTRCTRL_CTROFF" ;
VAL_ 1665 selfTestFaultCntrCtrl_SC02 4 "CTRCTRL_SELFTEST_NONE" 3 "CTRCTRL_SELFTEST_4" 2 "CTRCTRL_SELFTEST_3" 1 "CTRCTRL_SELFTEST_2" 0 "CTRCTRL_SELFTEST_1" ;
VAL_ 1665 cmbASICFault_SC02 20 "CMBDRIVER_ASIC_UNEXPECTED_MODULE" 19 "CMBDRIVER_ASIC_PEC_DIAGN_READ" 18 "CMBDRIVER_ASIC_PEC_DIAGN_DATA" 17 "CMBDRIVER_ASIC_PEC_DIAGN_CMD" 16 "CMBDRIVER_ASIC_REDUNDANT_FILTER" 15 "CMBDRIVER_ASIC_REDUNDANT_ADC" 14 "CMB_ASIC_CLOCK_LF" 13 "CMB_ASIC_CHARGE_PUMP_LF" 12 "CMB_ASIC_MUX_CHECK_LF" 11 "CMB_ASIC_INTERNAL_SUP_LF" 10 "CMB_ASIC_MUX_COMP_FAIL" 9 "CMB_ASIC_CHARGE_PUMP_FAIL" 8 "CMB_ASIC_OPEN_WIRE_CURR_FAIL" 255 "CMB_ASIC_FAULT_NONE" 7 "CMB_ASIC_VREF3_FAIL" 6 "CMB_ASIC_VREF2_FAIL" 5 "CMB_ASIC_ITEMP_FAIL" 4 "CMB_ASIC_VD_FAIL" 3 "CMB_ASIC_VA_FAIL" 2 "CMB_ASIC_TESTMODE" 1 "CMB_ASIC_CLOCK_FAIL" 0 "CMB_ASIC_MUX_FAIL" ;
VAL_ 1665 mainUcExtIsoResistance_SC02 65535 "SNA" ;
VAL_ 1665 BMS_C38_AR2MsgFault_SC02 3 "MSG_MISSING" 2 "MSG_SEQ_CNT_FAULT" 1 "MSG_CRC_FAULT" 0 "MSG_VALID" ;
VAL_ 1665 stateCoolant_SC02 1 "SAFESTATE_UNSAFE" 0 "SAFESTATE_SAFE" ;
VAL_ 1665 stateThermalEvent_SC02 1 "SAFESTATE_UNSAFE" 0 "SAFESTATE_SAFE" ;
VAL_ 1665 stateCANTx_SC02 1 "SAFESTATE_UNSAFE" 0 "SAFESTATE_SAFE" ;
VAL_ 1665 mainUcCntrCtrlReq_SC02 3 "SAFETYCAN_CNTR_CTRL_SNA" 1 "SAFETYCAN_CNTR_CTRL_CLS" 0 "SAFETYCAN_CNTR_CTRL_OPEN" ;
VAL_ 1665 mainUcCntrWeldState_SC02 7 "SAFETYCAN_WELD_HV_ALL_ERR" 6 "SAFETYCAN_WELD_HV_PLUS_MINUS_ERR" 15 "SAFETYCAN_WELD_SNA" 5 "SAFETYCAN_WELD_PRE_HV_MINUS_ERR" 4 "SAFETYCAN_WELD_HV_MINUS_ERR" 3 "SAFETYCAN_WELD_PRE_HV_PLUS_ERR" 2 "SAFETYCAN_WELD_HV_PLUS_ERR" 1 "SAFETYCAN_WELD_PRE_ERR" 0 "SAFETYCAN_WELD_NO_ERR" ;
VAL_ 1665 safetyUcCntrState_SC02 2 "SAFETYCAN_CNTR_CLS" 3 "SAFETYCAN_CNTR_SNA" 1 "SAFETYCAN_CNTR_PRECHRG" 0 "SAFETYCAN_CNTR_OPEN" ;
VAL_ 1665 mainUcCntrState_SC02 2 "SAFETYCAN_CNTR_CLS" 3 "SAFETYCAN_CNTR_SNA" 1 "SAFETYCAN_CNTR_PRECHRG" 0 "SAFETYCAN_CNTR_OPEN" ;
VAL_ 1665 safetyCANMsg4Fault_SC02 6 "SAFETYCAN_E2E_CRC" 15 "SAFETYCAN_SNA" 5 "SAFETYCAN_SPI_FAIL" 4 "SAFETYCAN_MSG_MISSING" 3 "SAFETYCAN_MSG_CNT_MISMATCH" 2 "SAFETYCAN_ALIVE_CNT" 1 "SAFETYCAN_SPI_CRC" 0 "SAFETYCAN_GOOD" ;
VAL_ 1665 safetyCANMsg3Fault_SC02 6 "SAFETYCAN_E2E_CRC" 15 "SAFETYCAN_SNA" 5 "SAFETYCAN_SPI_FAIL" 4 "SAFETYCAN_MSG_MISSING" 3 "SAFETYCAN_MSG_CNT_MISMATCH" 2 "SAFETYCAN_ALIVE_CNT" 1 "SAFETYCAN_SPI_CRC" 0 "SAFETYCAN_GOOD" ;
VAL_ 1665 safetyCANMsg2Fault_SC02 6 "SAFETYCAN_E2E_CRC" 15 "SAFETYCAN_SNA" 5 "SAFETYCAN_SPI_FAIL" 4 "SAFETYCAN_MSG_MISSING" 3 "SAFETYCAN_MSG_CNT_MISMATCH" 2 "SAFETYCAN_ALIVE_CNT" 1 "SAFETYCAN_SPI_CRC" 0 "SAFETYCAN_GOOD" ;
VAL_ 1665 safetyCANMsg1Fault_SC02 6 "SAFETYCAN_E2E_CRC" 15 "SAFETYCAN_SNA" 5 "SAFETYCAN_SPI_FAIL" 4 "SAFETYCAN_MSG_MISSING" 3 "SAFETYCAN_MSG_CNT_MISMATCH" 2 "SAFETYCAN_ALIVE_CNT" 1 "SAFETYCAN_SPI_CRC" 0 "SAFETYCAN_GOOD" ;
VAL_ 1665 contactorCntrSelfTest_SC02 9 "CTRCTRL_CHKLOSIDE_OPEN_CIRC" 8 "CTRCTRL_FAILED" 7 "CTRCTRL_PASSED" 6 "CTRCTRL_CHKHISIDE_STUCK_OPEN" 5 "CTRCTRL_CHK_CLOSE_OK_CIRCUIT" 4 "CTRCTRL_CHKLOSIDE_CTRL_OK" 3 "CTRCTRL_CHKLOSIDE_STUCK_CLOSED" 2 "CTRCTRL_CHKHISIDE_STUCK_CLOSED" 1 "CTRCTRL_PENDING" 0 "CTRCTRL_INIT" ;
VAL_ 1665 maxBrickVoltage_SC02 65535 "SNA" ;
VAL_ 1665 minBrickVoltage_SC02 65535 "SNA" ;
VAL_ 1665 cmbLastUpdateTime_SC02 255 "SNA" ;
VAL_ 1665 weldCheckState_SC02 4 "WELDCHECK_IDLE" 3 "WELDCHECK" 2 "WELDCHECK_ISO_2" 1 "WELDCHECK_ISO_1" 0 "WELDCHECK_INIT" ;
VAL_ 1665 debugFastMpex_SC02 0 "F00" 1 "F01" 2 "F02" 3 "F03" 4 "F04" 5 "F05" 6 "F06" 7 "F07" 8 "F08" 9 "F09" 10 "F10" 11 "F11" 12 "F12" 13 "F13" 14 "F14" 15 "F15" ;
VAL_ 1665 SPIRxTxTimeAllPckts_SC02 255 "SNA" ;
VAL_ 1665 stateContactorControl_SC02 1 "SAFESTATE_UNSAFE" 0 "SAFESTATE_SAFE" ;
VAL_ 1665 analogCntrPwrPlus_SC02 255 "SNA" ;
VAL_ 1665 weldedState_SC02 2 "CTR_WELD_SNA" 0 "CTR_NOTWELDED" 1 "CTR_ATLEASTONE_WELDED" ;
VAL_ 1665 stateVoltage_SC02 1 "SAFESTATE_UNSAFE" 0 "SAFESTATE_SAFE" ;
VAL_ 1665 stateTemperature_SC02 1 "SAFESTATE_UNSAFE" 0 "SAFESTATE_SAFE" ;
VAL_ 1665 stateSelfTest_SC02 1 "SAFESTATE_UNSAFE" 0 "SAFESTATE_SAFE" ;
VAL_ 1665 stateHVIL_SC02 1 "SAFESTATE_UNSAFE" 0 "SAFESTATE_SAFE" ;
VAL_ 1665 stateCurrent_SC02 1 "SAFESTATE_UNSAFE" 0 "SAFESTATE_SAFE" ;
VAL_ 1665 stateCrash2_SC02 1 "SAFESTATE_UNSAFE" 0 "SAFESTATE_SAFE" ;
VAL_ 1665 stateCrash1_SC02 1 "SAFESTATE_UNSAFE" 0 "SAFESTATE_SAFE" ;
VAL_ 1665 stateContactors_SC02 1 "SAFESTATE_UNSAFE" 0 "SAFESTATE_SAFE" ;
VAL_ 1665 stateCANRx_SC02 1 "SAFESTATE_UNSAFE" 0 "SAFESTATE_SAFE" ;
VAL_ 1665 itemState_SC02 15 "ITEM_INVALID" 2 "ITEM_EMERGENCY" 1 "ITEM_OFF" 0 "ITEM_ON" ;
VAL_ 1665 posPack_SC02 65535 "SNA" ;
VAL_ 1665 posLink_SC02 65535 "SNA" ;
VAL_ 1665 negPack_SC02 65535 "SNA" ;
VAL_ 1665 negLink_SC02 65535 "SNA" ;
VAL_ 1665 hallCurrent_SC02 4095 "SNA" ;
VAL_ 1665 analogCntrPwrPlusISense_SC02 255 "SNA" ;
VAL_ 1665 analogCntrPwrPlusSwitched_SC02 255 "SNA" ;
VAL_ 1921 cmbCoolantTemp08_BMS02 255 "SNA" ;
VAL_ 1921 cmbCoolantTemp07_BMS02 255 "SNA" ;
VAL_ 1921 cmbCoolantTemp06_BMS02 255 "SNA" ;
VAL_ 1921 cmbCoolantTemp05_BMS02 255 "SNA" ;
VAL_ 1921 cmbCoolantTemp04_BMS02 255 "SNA" ;
VAL_ 1921 cmbCoolantTemp03_BMS02 255 "SNA" ;
VAL_ 1921 cmbCoolantTemp02_BMS02 255 "SNA" ;
VAL_ 1921 cmbCoolantTemp01_BMS02 255 "SNA" ;
VAL_ 1921 cmbOnboardPressure32_BMS02 65535 "SNA" ;
VAL_ 1921 cmbOnboardPressure31_BMS02 65535 "SNA" ;
VAL_ 1921 cmbOnboardPressure30_BMS02 65535 "SNA" ;
VAL_ 1921 cmbOnboardPressure29_BMS02 65535 "SNA" ;
VAL_ 1921 cmbOnboardPressure28_BMS02 65535 "SNA" ;
VAL_ 1921 cmbOnboardPressure27_BMS02 65535 "SNA" ;
VAL_ 1921 cmbOnboardPressure26_BMS02 65535 "SNA" ;
VAL_ 1921 cmbOnboardPressure25_BMS02 65535 "SNA" ;
VAL_ 1921 cmbOnboardPressure24_BMS02 65535 "SNA" ;
VAL_ 1921 cmbOnboardPressure23_BMS02 65535 "SNA" ;
VAL_ 1921 cmbOnboardPressure22_BMS02 65535 "SNA" ;
VAL_ 1921 cmbOnboardPressure21_BMS02 65535 "SNA" ;
VAL_ 1921 cmbOnboardPressure20_BMS02 65535 "SNA" ;
VAL_ 1921 cmbOnboardPressure19_BMS02 65535 "SNA" ;
VAL_ 1921 cmbOnboardPressure18_BMS02 65535 "SNA" ;
VAL_ 1921 cmbOnboardPressure17_BMS02 65535 "SNA" ;
VAL_ 1921 cmbOnboardPressure16_BMS02 65535 "SNA" ;
VAL_ 1921 cmbOnboardPressure15_BMS02 65535 "SNA" ;
VAL_ 1921 cmbOnboardPressure14_BMS02 65535 "SNA" ;
VAL_ 1921 cmbOnboardPressure13_BMS02 65535 "SNA" ;
VAL_ 1921 cmbOnboardPressure12_BMS02 65535 "SNA" ;
VAL_ 1921 cmbOnboardPressure11_BMS02 65535 "SNA" ;
VAL_ 1921 cmbOnboardPressure10_BMS02 65535 "SNA" ;
VAL_ 1921 cmbOnboardPressure09_BMS02 65535 "SNA" ;
VAL_ 1921 cmbOnboardPressure08_BMS02 65535 "SNA" ;
VAL_ 1921 cmbOnboardPressure07_BMS02 65535 "SNA" ;
VAL_ 1921 cmbOnboardPressure06_BMS02 65535 "SNA" ;
VAL_ 1921 cmbOnboardPressure05_BMS02 65535 "SNA" ;
VAL_ 1921 cmbOnboardPressure04_BMS02 65535 "SNA" ;
VAL_ 1921 cmbOnboardPressure03_BMS02 65535 "SNA" ;
VAL_ 1921 cmbOnboardPressure02_BMS02 65535 "SNA" ;
VAL_ 1921 cmbOnboardPressure01_BMS02 65535 "SNA" ;
VAL_ 1921 onboardMultiplexor_BMS02 32 "O32" 31 "O31" 30 "O30" 29 "O29" 28 "O28" 27 "O27" 26 "O26" 25 "O25" 24 "O24" 23 "O23" 22 "O22" 21 "O21" 20 "O20" 19 "O19" 18 "O18" 17 "O17" 16 "O16" 15 "O15" 14 "O14" 13 "O13" 0 "O00" 1 "O01" 2 "O02" 3 "O03" 4 "O04" 5 "O05" 6 "O06" 7 "O07" 8 "O08" 9 "O09" 10 "O10" 11 "O11" 12 "O12" ;
VAL_ 1921 minCmbOnboardTemperature_BMS02 255 "SNA" ;
VAL_ 1921 minCmbOnboardHumidity_BMS02 255 "SNA" ;
VAL_ 1921 maxCmbOnboardTemperature_BMS02 255 "SNA" ;
VAL_ 1921 maxCmbOnboardHumidity_BMS02 255 "SNA" ;
VAL_ 1921 bmsOnboardTemperature_BMS02 255 "SNA" ;
VAL_ 1921 bmsOnboardHumidity_BMS02 255 "SNA" ;
VAL_ 1921 cmbOnboardTemperature01_BMS02 255 "SNA" ;
VAL_ 1921 cmbOnboardHumidity01_BMS02 255 "SNA" ;
VAL_ 1921 moduleHeaterCurrent01_BMS02 255 "SNA" ;
VAL_ 1921 cmbOnboardTemperature02_BMS02 255 "SNA" ;
VAL_ 1921 cmbOnboardHumidity02_BMS02 255 "SNA" ;
VAL_ 1921 moduleHeaterCurrent02_BMS02 255 "SNA" ;
VAL_ 1921 cmbOnboardTemperature03_BMS02 255 "SNA" ;
VAL_ 1921 cmbOnboardHumidity03_BMS02 255 "SNA" ;
VAL_ 1921 moduleHeaterCurrent03_BMS02 255 "SNA" ;
VAL_ 1921 cmbOnboardTemperature04_BMS02 255 "SNA" ;
VAL_ 1921 cmbOnboardHumidity04_BMS02 255 "SNA" ;
VAL_ 1921 moduleHeaterCurrent04_BMS02 255 "SNA" ;
VAL_ 1921 cmbOnboardTemperature05_BMS02 255 "SNA" ;
VAL_ 1921 cmbOnboardHumidity05_BMS02 255 "SNA" ;
VAL_ 1921 moduleHeaterCurrent05_BMS02 255 "SNA" ;
VAL_ 1921 cmbOnboardTemperature06_BMS02 255 "SNA" ;
VAL_ 1921 cmbOnboardHumidity06_BMS02 255 "SNA" ;
VAL_ 1921 moduleHeaterCurrent06_BMS02 255 "SNA" ;
VAL_ 1921 cmbOnboardTemperature07_BMS02 255 "SNA" ;
VAL_ 1921 cmbOnboardHumidity07_BMS02 255 "SNA" ;
VAL_ 1921 moduleHeaterCurrent07_BMS02 255 "SNA" ;
VAL_ 1921 cmbOnboardTemperature08_BMS02 255 "SNA" ;
VAL_ 1921 cmbOnboardHumidity08_BMS02 255 "SNA" ;
VAL_ 1921 moduleHeaterCurrent08_BMS02 255 "SNA" ;
VAL_ 1921 cmbOnboardTemperature09_BMS02 255 "SNA" ;
VAL_ 1921 cmbOnboardHumidity09_BMS02 255 "SNA" ;
VAL_ 1921 moduleHeaterCurrent09_BMS02 255 "SNA" ;
VAL_ 1921 cmbOnboardTemperature10_BMS02 255 "SNA" ;
VAL_ 1921 cmbOnboardHumidity10_BMS02 255 "SNA" ;
VAL_ 1921 moduleHeaterCurrent10_BMS02 255 "SNA" ;
VAL_ 1921 cmbOnboardTemperature11_BMS02 255 "SNA" ;
VAL_ 1921 cmbOnboardHumidity11_BMS02 255 "SNA" ;
VAL_ 1921 moduleHeaterCurrent11_BMS02 255 "SNA" ;
VAL_ 1921 cmbOnboardTemperature12_BMS02 255 "SNA" ;
VAL_ 1921 cmbOnboardHumidity12_BMS02 255 "SNA" ;
VAL_ 1921 moduleHeaterCurrent12_BMS02 255 "SNA" ;
VAL_ 1921 cmbOnboardTemperature13_BMS02 255 "SNA" ;
VAL_ 1921 cmbOnboardHumidity13_BMS02 255 "SNA" ;
VAL_ 1921 moduleHeaterCurrent13_BMS02 255 "SNA" ;
VAL_ 1921 cmbOnboardTemperature14_BMS02 255 "SNA" ;
VAL_ 1921 cmbOnboardHumidity14_BMS02 255 "SNA" ;
VAL_ 1921 moduleHeaterCurrent14_BMS02 255 "SNA" ;
VAL_ 1921 cmbOnboardTemperature15_BMS02 255 "SNA" ;
VAL_ 1921 cmbOnboardHumidity15_BMS02 255 "SNA" ;
VAL_ 1921 moduleHeaterCurrent15_BMS02 255 "SNA" ;
VAL_ 1921 cmbOnboardTemperature16_BMS02 255 "SNA" ;
VAL_ 1921 cmbOnboardHumidity16_BMS02 255 "SNA" ;
VAL_ 1921 moduleHeaterCurrent16_BMS02 255 "SNA" ;
VAL_ 1921 cmbOnboardTemperature17_BMS02 255 "SNA" ;
VAL_ 1921 cmbOnboardHumidity17_BMS02 255 "SNA" ;
VAL_ 1921 moduleHeaterCurrent17_BMS02 255 "SNA" ;
VAL_ 1921 cmbOnboardTemperature18_BMS02 255 "SNA" ;
VAL_ 1921 cmbOnboardHumidity18_BMS02 255 "SNA" ;
VAL_ 1921 moduleHeaterCurrent18_BMS02 255 "SNA" ;
VAL_ 1921 cmbOnboardTemperature19_BMS02 255 "SNA" ;
VAL_ 1921 cmbOnboardHumidity19_BMS02 255 "SNA" ;
VAL_ 1921 moduleHeaterCurrent19_BMS02 255 "SNA" ;
VAL_ 1921 cmbOnboardTemperature20_BMS02 255 "SNA" ;
VAL_ 1921 cmbOnboardHumidity20_BMS02 255 "SNA" ;
VAL_ 1921 moduleHeaterCurrent20_BMS02 255 "SNA" ;
VAL_ 1921 cmbOnboardTemperature21_BMS02 255 "SNA" ;
VAL_ 1921 cmbOnboardHumidity21_BMS02 255 "SNA" ;
VAL_ 1921 moduleHeaterCurrent21_BMS02 255 "SNA" ;
VAL_ 1921 cmbOnboardTemperature22_BMS02 255 "SNA" ;
VAL_ 1921 cmbOnboardHumidity22_BMS02 255 "SNA" ;
VAL_ 1921 moduleHeaterCurrent22_BMS02 255 "SNA" ;
VAL_ 1921 cmbOnboardTemperature23_BMS02 255 "SNA" ;
VAL_ 1921 cmbOnboardHumidity23_BMS02 255 "SNA" ;
VAL_ 1921 moduleHeaterCurrent23_BMS02 255 "SNA" ;
VAL_ 1921 cmbOnboardTemperature24_BMS02 255 "SNA" ;
VAL_ 1921 cmbOnboardHumidity24_BMS02 255 "SNA" ;
VAL_ 1921 moduleHeaterCurrent24_BMS02 255 "SNA" ;
VAL_ 1921 cmbOnboardTemperature25_BMS02 255 "SNA" ;
VAL_ 1921 cmbOnboardHumidity25_BMS02 255 "SNA" ;
VAL_ 1921 moduleHeaterCurrent25_BMS02 255 "SNA" ;
VAL_ 1921 cmbOnboardTemperature26_BMS02 255 "SNA" ;
VAL_ 1921 cmbOnboardHumidity26_BMS02 255 "SNA" ;
VAL_ 1921 moduleHeaterCurrent26_BMS02 255 "SNA" ;
VAL_ 1921 cmbOnboardTemperature27_BMS02 255 "SNA" ;
VAL_ 1921 cmbOnboardHumidity27_BMS02 255 "SNA" ;
VAL_ 1921 moduleHeaterCurrent27_BMS02 255 "SNA" ;
VAL_ 1921 cmbOnboardTemperature28_BMS02 255 "SNA" ;
VAL_ 1921 cmbOnboardHumidity28_BMS02 255 "SNA" ;
VAL_ 1921 moduleHeaterCurrent28_BMS02 255 "SNA" ;
VAL_ 1921 cmbOnboardTemperature29_BMS02 255 "SNA" ;
VAL_ 1921 cmbOnboardHumidity29_BMS02 255 "SNA" ;
VAL_ 1921 moduleHeaterCurrent29_BMS02 255 "SNA" ;
VAL_ 1921 cmbOnboardTemperature30_BMS02 255 "SNA" ;
VAL_ 1921 cmbOnboardHumidity30_BMS02 255 "SNA" ;
VAL_ 1921 moduleHeaterCurrent30_BMS02 255 "SNA" ;
VAL_ 1921 cmbOnboardTemperature31_BMS02 255 "SNA" ;
VAL_ 1921 cmbOnboardHumidity31_BMS02 255 "SNA" ;
VAL_ 1921 moduleHeaterCurrent31_BMS02 255 "SNA" ;
VAL_ 1921 cmbOnboardTemperature32_BMS02 255 "SNA" ;
VAL_ 1921 cmbOnboardHumidity32_BMS02 255 "SNA" ;
VAL_ 1921 moduleHeaterCurrent32_BMS02 255 "SNA" ;
VAL_ 1985 cmbMultiplexor_BMS02 0 "C000" 1 "C001" 2 "C002" 3 "C003" 4 "C004" 5 "C005" 6 "C006" 7 "C007" 8 "C008" 9 "C009" 10 "C010" 11 "C011" 12 "C012" 13 "C013" 14 "C014" 15 "C015" 16 "C016" 17 "C017" 18 "C018" 19 "C019" 20 "C020" 21 "C021" 22 "C022" 23 "C023" 24 "C024" 25 "C025" 26 "C026" 27 "C027" 28 "C028" 29 "C029" 30 "C030" 31 "C031" 32 "C032" 33 "C033" 34 "C034" 35 "C035" 36 "C036" 37 "C037" 38 "C038" 39 "C039" 40 "C040" 41 "C041" 42 "C042" 43 "C043" 44 "C044" 45 "C045" 46 "C046" 47 "C047" 48 "C048" 49 "C049" 50 "C050" 51 "C051" 52 "C052" 53 "C053" 54 "C054" 55 "C055" 56 "C056" 57 "C057" 58 "C058" 59 "C059" 60 "C060" 61 "C061" 62 "C062" 63 "C063" 64 "C064" 65 "C065" 66 "C066" 67 "C067" 68 "C068" 69 "C069" 70 "C070" 71 "C071" 72 "C072" 73 "C073" 74 "C074" 75 "C075" 76 "C076" 77 "C077" 78 "C078" 79 "C079" 80 "C080" 81 "C081" 82 "C082" 83 "C083" 84 "C084" 85 "C085" 86 "C086" 87 "C087" 88 "C088" 89 "C089" 90 "C090" 91 "C091" 92 "C092" 93 "C093" 94 "C094" 95 "C095" 96 "C096" 97 "C097" 98 "C098" 99 "C099" 100 "C100" 101 "C101" 102 "C102" 103 "C103" 104 "C104" 105 "C105" 106 "C106" 107 "C107" 108 "C108" 109 "C109" 110 "C110" 111 "C111" 112 "C112" 113 "C113" 114 "C114" 115 "C115" 116 "C116" 117 "C117" 118 "C118" 119 "C119" 120 "C120" 121 "C121" 122 "C122" 123 "C123" 124 "C124" 125 "C125" 126 "C126" 127 "C127" 128 "C128" 129 "C129" 130 "C130" 131 "C131" 132 "C132" 133 "C133" 134 "C134" 135 "C135" 136 "C136" 137 "C137" 138 "C138" 139 "C139" 140 "C140" 141 "C141" 142 "C142" 143 "C143" 144 "C144" 145 "C145" 146 "C146" 147 "C147" 148 "C148" 149 "C149" 150 "C150" 151 "C151" 152 "C152" 153 "C153" 154 "C154" 155 "C155" 156 "C156" 157 "C157" 158 "C158" 159 "C159" 160 "C160" 161 "C161" 162 "C162" 163 "C163" 164 "C164" 165 "C165" 166 "C166" 167 "C167" 168 "C168" 169 "C169" 170 "C170" 171 "C171" 172 "C172" 173 "C173" 174 "C174" 175 "C175" 176 "C176" 177 "C177" 178 "C178" 179 "C179" 180 "C180" 181 "C181" 182 "C182" 183 "C183" 184 "C184" 185 "C185" 186 "C186" 187 "C187" 188 "C188" 189 "C189" 190 "C190" 191 "C191" 192 "C192" ;
VAL_ 1985 moduleTemperature01_BMS02 255 "SNA" ;
VAL_ 1985 brickVoltage001_BMS02 65535 "SNA" ;
VAL_ 1985 brickVoltage002_BMS02 65535 "SNA" ;
VAL_ 1985 brickVoltage003_BMS02 65535 "SNA" ;
VAL_ 1985 moduleTemperature02_BMS02 255 "SNA" ;
VAL_ 1985 brickVoltage004_BMS02 65535 "SNA" ;
VAL_ 1985 brickVoltage005_BMS02 65535 "SNA" ;
VAL_ 1985 brickVoltage006_BMS02 65535 "SNA" ;
VAL_ 1985 moduleTemperature03_BMS02 255 "SNA" ;
VAL_ 1985 brickVoltage007_BMS02 65535 "SNA" ;
VAL_ 1985 brickVoltage008_BMS02 65535 "SNA" ;
VAL_ 1985 brickVoltage009_BMS02 65535 "SNA" ;
VAL_ 1985 moduleTemperature04_BMS02 255 "SNA" ;
VAL_ 1985 brickVoltage010_BMS02 65535 "SNA" ;
VAL_ 1985 brickVoltage011_BMS02 65535 "SNA" ;
VAL_ 1985 brickVoltage012_BMS02 65535 "SNA" ;
VAL_ 1985 moduleTemperature05_BMS02 255 "SNA" ;
VAL_ 1985 brickVoltage013_BMS02 65535 "SNA" ;
VAL_ 1985 brickVoltage014_BMS02 65535 "SNA" ;
VAL_ 1985 brickVoltage015_BMS02 65535 "SNA" ;
VAL_ 1985 moduleTemperature06_BMS02 255 "SNA" ;
VAL_ 1985 brickVoltage016_BMS02 65535 "SNA" ;
VAL_ 1985 brickVoltage017_BMS02 65535 "SNA" ;
VAL_ 1985 brickVoltage018_BMS02 65535 "SNA" ;
VAL_ 1985 moduleTemperature07_BMS02 255 "SNA" ;
VAL_ 1985 brickVoltage019_BMS02 65535 "SNA" ;
VAL_ 1985 brickVoltage020_BMS02 65535 "SNA" ;
VAL_ 1985 brickVoltage021_BMS02 65535 "SNA" ;
VAL_ 1985 moduleTemperature08_BMS02 255 "SNA" ;
VAL_ 1985 brickVoltage022_BMS02 65535 "SNA" ;
VAL_ 1985 brickVoltage023_BMS02 65535 "SNA" ;
VAL_ 1985 brickVoltage024_BMS02 65535 "SNA" ;
VAL_ 1985 moduleTemperature09_BMS02 255 "SNA" ;
VAL_ 1985 brickVoltage025_BMS02 65535 "SNA" ;
VAL_ 1985 brickVoltage026_BMS02 65535 "SNA" ;
VAL_ 1985 brickVoltage027_BMS02 65535 "SNA" ;
VAL_ 1985 moduleTemperature10_BMS02 255 "SNA" ;
VAL_ 1985 brickVoltage028_BMS02 65535 "SNA" ;
VAL_ 1985 brickVoltage029_BMS02 65535 "SNA" ;
VAL_ 1985 brickVoltage030_BMS02 65535 "SNA" ;
VAL_ 1985 moduleTemperature11_BMS02 255 "SNA" ;
VAL_ 1985 brickVoltage031_BMS02 65535 "SNA" ;
VAL_ 1985 brickVoltage032_BMS02 65535 "SNA" ;
VAL_ 1985 brickVoltage033_BMS02 65535 "SNA" ;
VAL_ 1985 moduleTemperature12_BMS02 255 "SNA" ;
VAL_ 1985 brickVoltage034_BMS02 65535 "SNA" ;
VAL_ 1985 brickVoltage035_BMS02 65535 "SNA" ;
VAL_ 1985 brickVoltage036_BMS02 65535 "SNA" ;
VAL_ 1985 moduleTemperature13_BMS02 255 "SNA" ;
VAL_ 1985 brickVoltage037_BMS02 65535 "SNA" ;
VAL_ 1985 brickVoltage038_BMS02 65535 "SNA" ;
VAL_ 1985 brickVoltage039_BMS02 65535 "SNA" ;
VAL_ 1985 moduleTemperature14_BMS02 255 "SNA" ;
VAL_ 1985 brickVoltage040_BMS02 65535 "SNA" ;
VAL_ 1985 brickVoltage041_BMS02 65535 "SNA" ;
VAL_ 1985 brickVoltage042_BMS02 65535 "SNA" ;
VAL_ 1985 moduleTemperature15_BMS02 255 "SNA" ;
VAL_ 1985 brickVoltage043_BMS02 65535 "SNA" ;
VAL_ 1985 brickVoltage044_BMS02 65535 "SNA" ;
VAL_ 1985 brickVoltage045_BMS02 65535 "SNA" ;
VAL_ 1985 moduleTemperature16_BMS02 255 "SNA" ;
VAL_ 1985 brickVoltage046_BMS02 65535 "SNA" ;
VAL_ 1985 brickVoltage047_BMS02 65535 "SNA" ;
VAL_ 1985 brickVoltage048_BMS02 65535 "SNA" ;
VAL_ 1985 moduleTemperature17_BMS02 255 "SNA" ;
VAL_ 1985 brickVoltage049_BMS02 65535 "SNA" ;
VAL_ 1985 brickVoltage050_BMS02 65535 "SNA" ;
VAL_ 1985 brickVoltage051_BMS02 65535 "SNA" ;
VAL_ 1985 moduleTemperature18_BMS02 255 "SNA" ;
VAL_ 1985 brickVoltage052_BMS02 65535 "SNA" ;
VAL_ 1985 brickVoltage053_BMS02 65535 "SNA" ;
VAL_ 1985 brickVoltage054_BMS02 65535 "SNA" ;
VAL_ 1985 moduleTemperature19_BMS02 255 "SNA" ;
VAL_ 1985 brickVoltage055_BMS02 65535 "SNA" ;
VAL_ 1985 brickVoltage056_BMS02 65535 "SNA" ;
VAL_ 1985 brickVoltage057_BMS02 65535 "SNA" ;
VAL_ 1985 moduleTemperature20_BMS02 255 "SNA" ;
VAL_ 1985 brickVoltage058_BMS02 65535 "SNA" ;
VAL_ 1985 brickVoltage059_BMS02 65535 "SNA" ;
VAL_ 1985 brickVoltage060_BMS02 65535 "SNA" ;
VAL_ 1985 moduleTemperature21_BMS02 255 "SNA" ;
VAL_ 1985 brickVoltage061_BMS02 65535 "SNA" ;
VAL_ 1985 brickVoltage062_BMS02 65535 "SNA" ;
VAL_ 1985 brickVoltage063_BMS02 65535 "SNA" ;
VAL_ 1985 moduleTemperature22_BMS02 255 "SNA" ;
VAL_ 1985 brickVoltage064_BMS02 65535 "SNA" ;
VAL_ 1985 brickVoltage065_BMS02 65535 "SNA" ;
VAL_ 1985 brickVoltage066_BMS02 65535 "SNA" ;
VAL_ 1985 moduleTemperature23_BMS02 255 "SNA" ;
VAL_ 1985 brickVoltage067_BMS02 65535 "SNA" ;
VAL_ 1985 brickVoltage068_BMS02 65535 "SNA" ;
VAL_ 1985 brickVoltage069_BMS02 65535 "SNA" ;
VAL_ 1985 moduleTemperature24_BMS02 255 "SNA" ;
VAL_ 1985 brickVoltage070_BMS02 65535 "SNA" ;
VAL_ 1985 brickVoltage071_BMS02 65535 "SNA" ;
VAL_ 1985 brickVoltage072_BMS02 65535 "SNA" ;
VAL_ 1985 moduleTemperature25_BMS02 255 "SNA" ;
VAL_ 1985 brickVoltage073_BMS02 65535 "SNA" ;
VAL_ 1985 brickVoltage074_BMS02 65535 "SNA" ;
VAL_ 1985 brickVoltage075_BMS02 65535 "SNA" ;
VAL_ 1985 moduleTemperature26_BMS02 255 "SNA" ;
VAL_ 1985 brickVoltage076_BMS02 65535 "SNA" ;
VAL_ 1985 brickVoltage077_BMS02 65535 "SNA" ;
VAL_ 1985 brickVoltage078_BMS02 65535 "SNA" ;
VAL_ 1985 moduleTemperature27_BMS02 255 "SNA" ;
VAL_ 1985 brickVoltage079_BMS02 65535 "SNA" ;
VAL_ 1985 brickVoltage080_BMS02 65535 "SNA" ;
VAL_ 1985 brickVoltage081_BMS02 65535 "SNA" ;
VAL_ 1985 moduleTemperature28_BMS02 255 "SNA" ;
VAL_ 1985 brickVoltage082_BMS02 65535 "SNA" ;
VAL_ 1985 brickVoltage083_BMS02 65535 "SNA" ;
VAL_ 1985 brickVoltage084_BMS02 65535 "SNA" ;
VAL_ 1985 moduleTemperature29_BMS02 255 "SNA" ;
VAL_ 1985 brickVoltage085_BMS02 65535 "SNA" ;
VAL_ 1985 brickVoltage086_BMS02 65535 "SNA" ;
VAL_ 1985 brickVoltage087_BMS02 65535 "SNA" ;
VAL_ 1985 moduleTemperature30_BMS02 255 "SNA" ;
VAL_ 1985 brickVoltage088_BMS02 65535 "SNA" ;
VAL_ 1985 brickVoltage089_BMS02 65535 "SNA" ;
VAL_ 1985 brickVoltage090_BMS02 65535 "SNA" ;
VAL_ 1985 moduleTemperature31_BMS02 255 "SNA" ;
VAL_ 1985 brickVoltage091_BMS02 65535 "SNA" ;
VAL_ 1985 brickVoltage092_BMS02 65535 "SNA" ;
VAL_ 1985 brickVoltage093_BMS02 65535 "SNA" ;
VAL_ 1985 moduleTemperature32_BMS02 255 "SNA" ;
VAL_ 1985 brickVoltage094_BMS02 65535 "SNA" ;
VAL_ 1985 brickVoltage095_BMS02 65535 "SNA" ;
VAL_ 1985 brickVoltage096_BMS02 65535 "SNA" ;
VAL_ 1985 brickVoltage097_BMS02 65535 "SNA" ;
VAL_ 1985 brickVoltage098_BMS02 65535 "SNA" ;
VAL_ 1985 brickVoltage099_BMS02 65535 "SNA" ;
VAL_ 1985 brickVoltage100_BMS02 65535 "SNA" ;
VAL_ 1985 brickVoltage101_BMS02 65535 "SNA" ;
VAL_ 1985 brickVoltage102_BMS02 65535 "SNA" ;
VAL_ 1985 brickVoltage103_BMS02 65535 "SNA" ;
VAL_ 1985 brickVoltage104_BMS02 65535 "SNA" ;
VAL_ 1985 brickVoltage105_BMS02 65535 "SNA" ;
VAL_ 1985 brickVoltage106_BMS02 65535 "SNA" ;
VAL_ 1985 brickVoltage107_BMS02 65535 "SNA" ;
VAL_ 1985 brickVoltage108_BMS02 65535 "SNA" ;
VAL_ 1985 brickVoltage109_BMS02 65535 "SNA" ;
VAL_ 1985 brickVoltage110_BMS02 65535 "SNA" ;
VAL_ 1985 brickVoltage111_BMS02 65535 "SNA" ;
VAL_ 1985 brickVoltage112_BMS02 65535 "SNA" ;
VAL_ 1985 brickVoltage113_BMS02 65535 "SNA" ;
VAL_ 1985 brickVoltage114_BMS02 65535 "SNA" ;
VAL_ 1985 brickVoltage115_BMS02 65535 "SNA" ;
VAL_ 1985 brickVoltage116_BMS02 65535 "SNA" ;
VAL_ 1985 brickVoltage117_BMS02 65535 "SNA" ;
VAL_ 1985 brickVoltage118_BMS02 65535 "SNA" ;
VAL_ 1985 brickVoltage119_BMS02 65535 "SNA" ;
VAL_ 1985 brickVoltage120_BMS02 65535 "SNA" ;
VAL_ 1985 brickVoltage121_BMS02 65535 "SNA" ;
VAL_ 1985 brickVoltage122_BMS02 65535 "SNA" ;
VAL_ 1985 brickVoltage123_BMS02 65535 "SNA" ;
VAL_ 1985 brickVoltage124_BMS02 65535 "SNA" ;
VAL_ 1985 brickVoltage125_BMS02 65535 "SNA" ;
VAL_ 1985 brickVoltage126_BMS02 65535 "SNA" ;
VAL_ 1985 brickVoltage127_BMS02 65535 "SNA" ;
VAL_ 1985 brickVoltage128_BMS02 65535 "SNA" ;
VAL_ 1985 brickVoltage129_BMS02 65535 "SNA" ;
VAL_ 1985 brickVoltage130_BMS02 65535 "SNA" ;
VAL_ 1985 brickVoltage131_BMS02 65535 "SNA" ;
VAL_ 1985 brickVoltage132_BMS02 65535 "SNA" ;
VAL_ 1985 brickVoltage133_BMS02 65535 "SNA" ;
VAL_ 1985 brickVoltage134_BMS02 65535 "SNA" ;
VAL_ 1985 brickVoltage135_BMS02 65535 "SNA" ;
VAL_ 1985 brickVoltage136_BMS02 65535 "SNA" ;
VAL_ 1985 brickVoltage137_BMS02 65535 "SNA" ;
VAL_ 1985 brickVoltage138_BMS02 65535 "SNA" ;
VAL_ 1985 brickVoltage139_BMS02 65535 "SNA" ;
VAL_ 1985 brickVoltage140_BMS02 65535 "SNA" ;
VAL_ 1985 brickVoltage141_BMS02 65535 "SNA" ;
VAL_ 1985 brickVoltage142_BMS02 65535 "SNA" ;
VAL_ 1985 brickVoltage143_BMS02 65535 "SNA" ;
VAL_ 1985 brickVoltage144_BMS02 65535 "SNA" ;
VAL_ 1985 brickVoltage145_BMS02 65535 "SNA" ;
VAL_ 1985 brickVoltage146_BMS02 65535 "SNA" ;
VAL_ 1985 brickVoltage147_BMS02 65535 "SNA" ;
VAL_ 1985 brickVoltage148_BMS02 65535 "SNA" ;
VAL_ 1985 brickVoltage149_BMS02 65535 "SNA" ;
VAL_ 1985 brickVoltage150_BMS02 65535 "SNA" ;
VAL_ 1985 brickVoltage151_BMS02 65535 "SNA" ;
VAL_ 1985 brickVoltage152_BMS02 65535 "SNA" ;
VAL_ 1985 brickVoltage153_BMS02 65535 "SNA" ;
VAL_ 1985 brickVoltage154_BMS02 65535 "SNA" ;
VAL_ 1985 brickVoltage155_BMS02 65535 "SNA" ;
VAL_ 1985 brickVoltage156_BMS02 65535 "SNA" ;
VAL_ 1985 brickVoltage157_BMS02 65535 "SNA" ;
VAL_ 1985 brickVoltage158_BMS02 65535 "SNA" ;
VAL_ 1985 brickVoltage159_BMS02 65535 "SNA" ;
VAL_ 1985 brickVoltage160_BMS02 65535 "SNA" ;
VAL_ 1985 brickVoltage161_BMS02 65535 "SNA" ;
VAL_ 1985 brickVoltage162_BMS02 65535 "SNA" ;
VAL_ 1985 brickVoltage163_BMS02 65535 "SNA" ;
VAL_ 1985 brickVoltage164_BMS02 65535 "SNA" ;
VAL_ 1985 brickVoltage165_BMS02 65535 "SNA" ;
VAL_ 1985 brickVoltage166_BMS02 65535 "SNA" ;
VAL_ 1985 brickVoltage167_BMS02 65535 "SNA" ;
VAL_ 1985 brickVoltage168_BMS02 65535 "SNA" ;
VAL_ 1985 brickVoltage169_BMS02 65535 "SNA" ;
VAL_ 1985 brickVoltage170_BMS02 65535 "SNA" ;
VAL_ 1985 brickVoltage171_BMS02 65535 "SNA" ;
VAL_ 1985 brickVoltage172_BMS02 65535 "SNA" ;
VAL_ 1985 brickVoltage173_BMS02 65535 "SNA" ;
VAL_ 1985 brickVoltage174_BMS02 65535 "SNA" ;
VAL_ 1985 brickVoltage175_BMS02 65535 "SNA" ;
VAL_ 1985 brickVoltage176_BMS02 65535 "SNA" ;
VAL_ 1985 brickVoltage177_BMS02 65535 "SNA" ;
VAL_ 1985 brickVoltage178_BMS02 65535 "SNA" ;
VAL_ 1985 brickVoltage179_BMS02 65535 "SNA" ;
VAL_ 1985 brickVoltage180_BMS02 65535 "SNA" ;
VAL_ 1985 brickVoltage181_BMS02 65535 "SNA" ;
VAL_ 1985 brickVoltage182_BMS02 65535 "SNA" ;
VAL_ 1985 brickVoltage183_BMS02 65535 "SNA" ;
VAL_ 1985 brickVoltage184_BMS02 65535 "SNA" ;
VAL_ 1985 brickVoltage185_BMS02 65535 "SNA" ;
VAL_ 1985 brickVoltage186_BMS02 65535 "SNA" ;
VAL_ 1985 brickVoltage187_BMS02 65535 "SNA" ;
VAL_ 1985 brickVoltage188_BMS02 65535 "SNA" ;
VAL_ 1985 brickVoltage189_BMS02 65535 "SNA" ;
VAL_ 1985 brickVoltage190_BMS02 65535 "SNA" ;
VAL_ 1985 brickVoltage191_BMS02 65535 "SNA" ;
VAL_ 1985 brickVoltage192_BMS02 65535 "SNA" ;
VAL_ 1985 brickVoltage193_BMS02 65535 "SNA" ;
VAL_ 1985 brickVoltage194_BMS02 65535 "SNA" ;
VAL_ 1985 brickVoltage195_BMS02 65535 "SNA" ;
VAL_ 1985 brickVoltage196_BMS02 65535 "SNA" ;
VAL_ 1985 brickVoltage197_BMS02 65535 "SNA" ;
VAL_ 1985 brickVoltage198_BMS02 65535 "SNA" ;
VAL_ 1985 brickVoltage199_BMS02 65535 "SNA" ;
VAL_ 1985 brickVoltage200_BMS02 65535 "SNA" ;
VAL_ 1985 brickVoltage201_BMS02 65535 "SNA" ;
VAL_ 1985 brickVoltage202_BMS02 65535 "SNA" ;
VAL_ 1985 brickVoltage203_BMS02 65535 "SNA" ;
VAL_ 1985 brickVoltage204_BMS02 65535 "SNA" ;
VAL_ 1985 brickVoltage205_BMS02 65535 "SNA" ;
VAL_ 1985 brickVoltage206_BMS02 65535 "SNA" ;
VAL_ 1985 brickVoltage207_BMS02 65535 "SNA" ;
VAL_ 1985 brickVoltage208_BMS02 65535 "SNA" ;
VAL_ 1985 brickVoltage209_BMS02 65535 "SNA" ;
VAL_ 1985 brickVoltage210_BMS02 65535 "SNA" ;
VAL_ 1985 brickVoltage211_BMS02 65535 "SNA" ;
VAL_ 1985 brickVoltage212_BMS02 65535 "SNA" ;
VAL_ 1985 brickVoltage213_BMS02 65535 "SNA" ;
VAL_ 1985 brickVoltage214_BMS02 65535 "SNA" ;
VAL_ 1985 brickVoltage215_BMS02 65535 "SNA" ;
VAL_ 1985 brickVoltage216_BMS02 65535 "SNA" ;
VAL_ 1985 brickVoltage217_BMS02 65535 "SNA" ;
VAL_ 1985 brickVoltage218_BMS02 65535 "SNA" ;
VAL_ 1985 brickVoltage219_BMS02 65535 "SNA" ;
VAL_ 1985 brickVoltage220_BMS02 65535 "SNA" ;
VAL_ 1985 brickVoltage221_BMS02 65535 "SNA" ;
VAL_ 1985 brickVoltage222_BMS02 65535 "SNA" ;
VAL_ 1985 brickVoltage223_BMS02 65535 "SNA" ;
VAL_ 1985 brickVoltage224_BMS02 65535 "SNA" ;
VAL_ 1985 brickVoltage225_BMS02 65535 "SNA" ;
VAL_ 1985 brickVoltage226_BMS02 65535 "SNA" ;
VAL_ 1985 brickVoltage227_BMS02 65535 "SNA" ;
VAL_ 1985 brickVoltage228_BMS02 65535 "SNA" ;
VAL_ 1985 brickVoltage229_BMS02 65535 "SNA" ;
VAL_ 1985 brickVoltage230_BMS02 65535 "SNA" ;
VAL_ 1985 brickVoltage231_BMS02 65535 "SNA" ;
VAL_ 1985 brickVoltage232_BMS02 65535 "SNA" ;
VAL_ 1985 brickVoltage233_BMS02 65535 "SNA" ;
VAL_ 1985 brickVoltage234_BMS02 65535 "SNA" ;
VAL_ 1985 brickVoltage235_BMS02 65535 "SNA" ;
VAL_ 1985 brickVoltage236_BMS02 65535 "SNA" ;
VAL_ 1985 brickVoltage237_BMS02 65535 "SNA" ;
VAL_ 1985 brickVoltage238_BMS02 65535 "SNA" ;
VAL_ 1985 brickVoltage239_BMS02 65535 "SNA" ;
VAL_ 1985 brickVoltage240_BMS02 65535 "SNA" ;
VAL_ 1985 brickVoltage241_BMS02 65535 "SNA" ;
VAL_ 1985 brickVoltage242_BMS02 65535 "SNA" ;
VAL_ 1985 brickVoltage243_BMS02 65535 "SNA" ;
VAL_ 1985 brickVoltage244_BMS02 65535 "SNA" ;
VAL_ 1985 brickVoltage245_BMS02 65535 "SNA" ;
VAL_ 1985 brickVoltage246_BMS02 65535 "SNA" ;
VAL_ 1985 brickVoltage247_BMS02 65535 "SNA" ;
VAL_ 1985 brickVoltage248_BMS02 65535 "SNA" ;
VAL_ 1985 brickVoltage249_BMS02 65535 "SNA" ;
VAL_ 1985 brickVoltage250_BMS02 65535 "SNA" ;
VAL_ 1985 brickVoltage251_BMS02 65535 "SNA" ;
VAL_ 1985 brickVoltage252_BMS02 65535 "SNA" ;
VAL_ 1985 brickVoltage253_BMS02 65535 "SNA" ;
VAL_ 1985 brickVoltage254_BMS02 65535 "SNA" ;
VAL_ 1985 brickVoltage255_BMS02 65535 "SNA" ;
VAL_ 1985 brickVoltage256_BMS02 65535 "SNA" ;
VAL_ 1985 brickVoltage257_BMS02 65535 "SNA" ;
VAL_ 1985 brickVoltage258_BMS02 65535 "SNA" ;
VAL_ 1985 brickVoltage259_BMS02 65535 "SNA" ;
VAL_ 1985 brickVoltage260_BMS02 65535 "SNA" ;
VAL_ 1985 brickVoltage261_BMS02 65535 "SNA" ;
VAL_ 1985 brickVoltage262_BMS02 65535 "SNA" ;
VAL_ 1985 brickVoltage263_BMS02 65535 "SNA" ;
VAL_ 1985 brickVoltage264_BMS02 65535 "SNA" ;
VAL_ 1985 brickVoltage265_BMS02 65535 "SNA" ;
VAL_ 1985 brickVoltage266_BMS02 65535 "SNA" ;
VAL_ 1985 brickVoltage267_BMS02 65535 "SNA" ;
VAL_ 1985 brickVoltage268_BMS02 65535 "SNA" ;
VAL_ 1985 brickVoltage269_BMS02 65535 "SNA" ;
VAL_ 1985 brickVoltage270_BMS02 65535 "SNA" ;
VAL_ 1985 brickVoltage271_BMS02 65535 "SNA" ;
VAL_ 1985 brickVoltage272_BMS02 65535 "SNA" ;
VAL_ 1985 brickVoltage273_BMS02 65535 "SNA" ;
VAL_ 1985 brickVoltage274_BMS02 65535 "SNA" ;
VAL_ 1985 brickVoltage275_BMS02 65535 "SNA" ;
VAL_ 1985 brickVoltage276_BMS02 65535 "SNA" ;
VAL_ 1985 brickVoltage277_BMS02 65535 "SNA" ;
VAL_ 1985 brickVoltage278_BMS02 65535 "SNA" ;
VAL_ 1985 brickVoltage279_BMS02 65535 "SNA" ;
VAL_ 1985 brickVoltage280_BMS02 65535 "SNA" ;
VAL_ 1985 brickVoltage281_BMS02 65535 "SNA" ;
VAL_ 1985 brickVoltage282_BMS02 65535 "SNA" ;
VAL_ 1985 brickVoltage283_BMS02 65535 "SNA" ;
VAL_ 1985 brickVoltage284_BMS02 65535 "SNA" ;
VAL_ 1985 brickVoltage285_BMS02 65535 "SNA" ;
VAL_ 1985 brickVoltage286_BMS02 65535 "SNA" ;
VAL_ 1985 brickVoltage287_BMS02 65535 "SNA" ;
VAL_ 1985 brickVoltage288_BMS02 65535 "SNA" ;
VAL_ 1985 brickVoltage289_BMS02 65535 "SNA" ;
VAL_ 1985 brickVoltage290_BMS02 65535 "SNA" ;
VAL_ 1985 brickVoltage291_BMS02 65535 "SNA" ;
VAL_ 1985 brickVoltage292_BMS02 65535 "SNA" ;
VAL_ 1985 brickVoltage293_BMS02 65535 "SNA" ;
VAL_ 1985 brickVoltage294_BMS02 65535 "SNA" ;
VAL_ 1985 brickVoltage295_BMS02 65535 "SNA" ;
VAL_ 1985 brickVoltage296_BMS02 65535 "SNA" ;
VAL_ 1985 brickVoltage297_BMS02 65535 "SNA" ;
VAL_ 1985 brickVoltage298_BMS02 65535 "SNA" ;
VAL_ 1985 brickVoltage299_BMS02 65535 "SNA" ;
VAL_ 1985 brickVoltage300_BMS02 65535 "SNA" ;
VAL_ 1985 moduleTemperature33_BMS02 255 "SNA" ;
VAL_ 1985 moduleTemperature34_BMS02 255 "SNA" ;
VAL_ 1985 moduleTemperature35_BMS02 255 "SNA" ;
VAL_ 1985 moduleTemperature36_BMS02 255 "SNA" ;
VAL_ 1985 moduleTemperature37_BMS02 255 "SNA" ;
VAL_ 1985 moduleTemperature38_BMS02 255 "SNA" ;
VAL_ 1985 moduleTemperature39_BMS02 255 "SNA" ;
VAL_ 1985 moduleTemperature40_BMS02 255 "SNA" ;
VAL_ 1985 moduleTemperature41_BMS02 255 "SNA" ;
VAL_ 1985 moduleTemperature42_BMS02 255 "SNA" ;
VAL_ 1985 moduleTemperature43_BMS02 255 "SNA" ;
VAL_ 1985 moduleTemperature44_BMS02 255 "SNA" ;
VAL_ 1985 moduleTemperature45_BMS02 255 "SNA" ;
VAL_ 1985 moduleTemperature46_BMS02 255 "SNA" ;
VAL_ 1985 moduleTemperature47_BMS02 255 "SNA" ;
VAL_ 1985 moduleTemperature48_BMS02 255 "SNA" ;
VAL_ 1985 moduleTemperature49_BMS02 255 "SNA" ;
VAL_ 1985 moduleTemperature50_BMS02 255 "SNA" ;
VAL_ 1985 moduleTemperature51_BMS02 255 "SNA" ;
VAL_ 1985 moduleTemperature52_BMS02 255 "SNA" ;
VAL_ 1985 moduleTemperature53_BMS02 255 "SNA" ;
VAL_ 1985 moduleTemperature54_BMS02 255 "SNA" ;
VAL_ 1985 moduleTemperature55_BMS02 255 "SNA" ;
VAL_ 1985 moduleTemperature56_BMS02 255 "SNA" ;
VAL_ 1985 moduleTemperature57_BMS02 255 "SNA" ;
VAL_ 1985 moduleTemperature58_BMS02 255 "SNA" ;
VAL_ 1985 moduleTemperature59_BMS02 255 "SNA" ;
VAL_ 1985 moduleTemperature60_BMS02 255 "SNA" ;
VAL_ 1985 moduleTemperature61_BMS02 255 "SNA" ;
VAL_ 1985 moduleTemperature62_BMS02 255 "SNA" ;
VAL_ 1985 moduleTemperature63_BMS02 255 "SNA" ;
VAL_ 1985 moduleTemperature64_BMS02 255 "SNA" ;
VAL_ 1985 moduleTemperature65_BMS02 255 "SNA" ;
VAL_ 1985 moduleTemperature66_BMS02 255 "SNA" ;
VAL_ 1985 moduleTemperature67_BMS02 255 "SNA" ;
VAL_ 1985 moduleTemperature68_BMS02 255 "SNA" ;
VAL_ 1985 moduleTemperature69_BMS02 255 "SNA" ;
VAL_ 1985 moduleTemperature70_BMS02 255 "SNA" ;
VAL_ 1985 moduleTemperature71_BMS02 255 "SNA" ;
VAL_ 1985 moduleTemperature72_BMS02 255 "SNA" ;
VAL_ 1985 moduleTemperature73_BMS02 255 "SNA" ;
VAL_ 1985 moduleTemperature74_BMS02 255 "SNA" ;
VAL_ 1985 moduleTemperature75_BMS02 255 "SNA" ;
VAL_ 1985 moduleTemperature76_BMS02 255 "SNA" ;
VAL_ 1985 moduleTemperature77_BMS02 255 "SNA" ;
VAL_ 1985 moduleTemperature78_BMS02 255 "SNA" ;
VAL_ 1985 moduleTemperature79_BMS02 255 "SNA" ;
VAL_ 1985 moduleTemperature80_BMS02 255 "SNA" ;
VAL_ 1985 moduleTemperature81_BMS02 255 "SNA" ;
VAL_ 1985 moduleTemperature82_BMS02 255 "SNA" ;
VAL_ 1985 moduleTemperature83_BMS02 255 "SNA" ;
VAL_ 1985 moduleTemperature84_BMS02 255 "SNA" ;
VAL_ 1985 moduleTemperature85_BMS02 255 "SNA" ;
VAL_ 1985 moduleTemperature86_BMS02 255 "SNA" ;
VAL_ 1985 moduleTemperature87_BMS02 255 "SNA" ;
VAL_ 1985 moduleTemperature88_BMS02 255 "SNA" ;
VAL_ 1985 moduleTemperature89_BMS02 255 "SNA" ;
VAL_ 1985 moduleTemperature90_BMS02 255 "SNA" ;
VAL_ 1985 moduleTemperature91_BMS02 255 "SNA" ;
VAL_ 1985 moduleTemperature92_BMS02 255 "SNA" ;
VAL_ 1985 moduleTemperature93_BMS02 255 "SNA" ;
VAL_ 1985 moduleTemperature94_BMS02 255 "SNA" ;
VAL_ 1985 moduleTemperature95_BMS02 255 "SNA" ;
VAL_ 1985 moduleTemperature96_BMS02 255 "SNA" ;
VAL_ 1985 moduleTemperature97_BMS02 255 "SNA" ;
VAL_ 1985 moduleTemperature98_BMS02 255 "SNA" ;
VAL_ 1985 moduleTemperature99_BMS02 255 "SNA" ;
VAL_ 1985 moduleTemperature100_BMS02 255 "SNA" ;
VAL_ 900 DEM319_HV_DISABLE_DURING_S_BMS05 3 "DEM_INVALID" 2 "DEM_FAILED" 1 "DEM_PASSED" 0 "DEM_NOTTESTED" ;
VAL_ 900 DEM318_HV_ENABLE_IMPLAUSIB_BMS05 3 "DEM_INVALID" 2 "DEM_FAILED" 1 "DEM_PASSED" 0 "DEM_NOTTESTED" ;
VAL_ 900 DEM317_STRING_SUSPECT_OPEN_BMS05 3 "DEM_INVALID" 2 "DEM_FAILED" 1 "DEM_PASSED" 0 "DEM_NOTTESTED" ;
VAL_ 900 DEM316_UNEXPCTD_BMS_ON_CAN_BMS05 3 "DEM_INVALID" 2 "DEM_FAILED" 1 "DEM_PASSED" 0 "DEM_NOTTESTED" ;
VAL_ 900 DEM315_HV_WITHSTAND_TESTS__BMS05 3 "DEM_INVALID" 2 "DEM_FAILED" 1 "DEM_PASSED" 0 "DEM_NOTTESTED" ;
VAL_ 900 DEM314_OBC_PILOT_ERROR_BMS05 3 "DEM_INVALID" 2 "DEM_FAILED" 1 "DEM_PASSED" 0 "DEM_NOTTESTED" ;
VAL_ 900 DEM313_OBC_PILOT_HIGH_BMS05 3 "DEM_INVALID" 2 "DEM_FAILED" 1 "DEM_PASSED" 0 "DEM_NOTTESTED" ;
VAL_ 900 DEM312_OBC_PROXIMITY_ERROR_BMS05 3 "DEM_INVALID" 2 "DEM_FAILED" 1 "DEM_PASSED" 0 "DEM_NOTTESTED" ;
VAL_ 900 DEM311_CTRS_END_OF_LIFE_WA_BMS05 3 "DEM_INVALID" 2 "DEM_FAILED" 1 "DEM_PASSED" 0 "DEM_NOTTESTED" ;
VAL_ 900 DEM310_BMSMIA_STRNGMSTR_AL_BMS05 3 "DEM_INVALID" 2 "DEM_FAILED" 1 "DEM_PASSED" 0 "DEM_NOTTESTED" ;
VAL_ 900 DEM309_VOLTAGE_BRICKOV_WAR_BMS05 3 "DEM_INVALID" 2 "DEM_FAILED" 1 "DEM_PASSED" 0 "DEM_NOTTESTED" ;
VAL_ 900 DEM308_PRESSURE_FLT_BMS05 3 "DEM_INVALID" 2 "DEM_FAILED" 1 "DEM_PASSED" 0 "DEM_NOTTESTED" ;
VAL_ 900 DEM307_PRESSURE_MIA_BMS05 3 "DEM_INVALID" 2 "DEM_FAILED" 1 "DEM_PASSED" 0 "DEM_NOTTESTED" ;
VAL_ 900 DEM306_SW_VERSION_MISMATCH_BMS05 3 "DEM_INVALID" 2 "DEM_FAILED" 1 "DEM_PASSED" 0 "DEM_NOTTESTED" ;
VAL_ 900 DEM305_MODULET_OVERTEMP_WA_BMS05 3 "DEM_INVALID" 2 "DEM_FAILED" 1 "DEM_PASSED" 0 "DEM_NOTTESTED" ;
VAL_ 900 DEM304_PCHG_OPENCIRCUIT_IN_BMS05 3 "DEM_INVALID" 2 "DEM_FAILED" 1 "DEM_PASSED" 0 "DEM_NOTTESTED" ;
VAL_ 900 DEM303_MODULET_UNDERTEMP_W_BMS05 3 "DEM_INVALID" 2 "DEM_FAILED" 1 "DEM_PASSED" 0 "DEM_NOTTESTED" ;
VAL_ 900 DEM302_MODULET_UT_BMS05 3 "DEM_INVALID" 2 "DEM_FAILED" 1 "DEM_PASSED" 0 "DEM_NOTTESTED" ;
VAL_ 900 DEM301_FUSI_LOCK_BMS05 3 "DEM_INVALID" 2 "DEM_FAILED" 1 "DEM_PASSED" 0 "DEM_NOTTESTED" ;
VAL_ 900 DEM300_DEBUG_SM_DISABLED_BMS05 3 "DEM_INVALID" 2 "DEM_FAILED" 1 "DEM_PASSED" 0 "DEM_NOTTESTED" ;
VAL_ 900 DEM299_5V_SENSOR_SUPPLY_OU_BMS05 3 "DEM_INVALID" 2 "DEM_FAILED" 1 "DEM_PASSED" 0 "DEM_NOTTESTED" ;
VAL_ 900 DEM298_IMPL_DRIVE_REQUEST_BMS05 3 "DEM_INVALID" 2 "DEM_FAILED" 1 "DEM_PASSED" 0 "DEM_NOTTESTED" ;
VAL_ 900 DEM297_PCHG2_OPENCIRCUIT_BMS05 3 "DEM_INVALID" 2 "DEM_FAILED" 1 "DEM_PASSED" 0 "DEM_NOTTESTED" ;
VAL_ 900 DEM296_CTRSAUX_IMPLAUSIBLE_BMS05 3 "DEM_INVALID" 2 "DEM_FAILED" 1 "DEM_PASSED" 0 "DEM_NOTTESTED" ;
VAL_ 900 DEM295_CTRSAUX_LINKV_UNSAF_BMS05 3 "DEM_INVALID" 2 "DEM_FAILED" 1 "DEM_PASSED" 0 "DEM_NOTTESTED" ;
VAL_ 900 DEM294_CANRX_PT_EMERGENCY_BMS05 3 "DEM_INVALID" 2 "DEM_FAILED" 1 "DEM_PASSED" 0 "DEM_NOTTESTED" ;
VAL_ 900 DEM293_SBC_LDT_IMPLAUSIBLE_BMS05 3 "DEM_INVALID" 2 "DEM_FAILED" 1 "DEM_PASSED" 0 "DEM_NOTTESTED" ;
VAL_ 900 DEM292_NUM_EXPECTED_STRING_BMS05 3 "DEM_INVALID" 2 "DEM_FAILED" 1 "DEM_PASSED" 0 "DEM_NOTTESTED" ;
VAL_ 900 DEM291_NUM_EXPECTED_STRING_BMS05 3 "DEM_INVALID" 2 "DEM_FAILED" 1 "DEM_PASSED" 0 "DEM_NOTTESTED" ;
VAL_ 900 DEM290_CMB_ONBOARD_DEFECT_BMS05 3 "DEM_INVALID" 2 "DEM_FAILED" 1 "DEM_PASSED" 0 "DEM_NOTTESTED" ;
VAL_ 900 DEM289_TEMP_STATE_LATCHED_BMS05 3 "DEM_INVALID" 2 "DEM_FAILED" 1 "DEM_PASSED" 0 "DEM_NOTTESTED" ;
VAL_ 900 DEM288_CURR_STATE_LATCHED_BMS05 3 "DEM_INVALID" 2 "DEM_FAILED" 1 "DEM_PASSED" 0 "DEM_NOTTESTED" ;
VAL_ 964 balancingInDriveTimer_BMS05 65535 "SNA" ;
VAL_ 964 SOCRestPolarization_BMS05 255 "SNA" ;
VAL_ 964 CoolantSensorState_BMS05 3 "OIL_OK" 2 "SENSOR_FAILURE" 1 "WATER_DETECTED" 0 "SENSOR_CAN_MIA" ;
VAL_ 964 temperatureModelOffset_BMS05 255 "SNA" ;
VAL_ 964 SOHCMinBrickHighEst_BMS05 255 "SNA" ;
VAL_ 964 SOHCMaxBrickHighEst_BMS05 255 "SNA" ;
VAL_ 964 regenCurrOpLkyBktThrs1_BMS05 255 "SNA" ;
VAL_ 964 dischargeCurrOpLkyBktThrs1_BMS05 255 "SNA" ;
VAL_ 964 regenCurrentOpLoadValue_BMS05 255 "SNA" ;
VAL_ 964 dischargeCurrOpLoadValue_BMS05 255 "SNA" ;
VAL_ 964 minBrickVoltageLimit_BMS05 65535 "SNA" ;
VAL_ 964 currentModule3Integral_BMS05 65535 "SNA" ;
VAL_ 964 currentModule2Integral_BMS05 65535 "SNA" ;
VAL_ 964 currentModule1Integral_BMS05 65535 "SNA" ;
VAL_ 964 currentModuleMin_BMS05 65535 "SNA" ;
VAL_ 964 currentModuleMax_BMS05 65535 "SNA" ;
VAL_ 964 maxBrickVoltageSync_BMS05 65535 "SNA" ;
VAL_ 964 minBrickVoltageSync_BMS05 65535 "SNA" ;
VAL_ 964 SOHCMinBrickLowEst_BMS05 255 "SNA" ;
VAL_ 964 SOHCMaxBrickLowEst_BMS05 255 "SNA" ;
VAL_ 964 gradLimSOC_BMS05 65535 "SNA" ;
VAL_ 964 SOCRecalSlowOp_BMS05 255 "SNA" ;
VAL_ 964 SOHCMinIndex_BMS05 65535 "SNA" ;
VAL_ 964 SOHCMaxIndex_BMS05 65535 "SNA" ;
VAL_ 964 SOHRMinRegen_BMS05 255 "SNA" ;
VAL_ 964 SOHRMinDchg_BMS05 255 "SNA" ;
VAL_ 964 SOHRMeanRegen_BMS05 255 "SNA" ;
VAL_ 964 SOHRMeanDchg_BMS05 255 "SNA" ;
VAL_ 964 SOHRMaxRegen_BMS05 255 "SNA" ;
VAL_ 964 SOHRMaxDchg_BMS05 255 "SNA" ;
VAL_ 964 SOHCMin_BMS05 255 "SNA" ;
VAL_ 964 SOHCMean_BMS05 255 "SNA" ;
VAL_ 964 SOHCMax_BMS05 255 "SNA" ;
VAL_ 964 ppRegenCurrLimitPredShort_BMS05 255 "SNA" ;
VAL_ 964 ppRegenCurrLimitPredLong_BMS05 255 "SNA" ;
VAL_ 964 ppDchgCurrLimitPredShort_BMS05 255 "SNA" ;
VAL_ 964 ppDchgCurrLimitPredLong_BMS05 255 "SNA" ;
VAL_ 964 ppPolarizationV_BMS05 65535 "SNA" ;
VAL_ 964 SOCRecalMinOCVEst_BMS05 65535 "SNA" ;
VAL_ 964 SOCRecalMaxOCVEst_BMS05 65535 "SNA" ;
VAL_ 964 SOCRecalMinSOCUpp_BMS05 255 "SNA" ;
VAL_ 964 SOCRecalMinSOCLow_BMS05 255 "SNA" ;
VAL_ 964 SOCRecalMinSOC_BMS05 255 "SNA" ;
VAL_ 964 SOCRecalMaxSOCUpp_BMS05 255 "SNA" ;
VAL_ 964 SOCRecalMaxSOCLow_BMS05 255 "SNA" ;
VAL_ 964 SOCRecalMaxSOC_BMS05 255 "SNA" ;
VAL_ 964 ppNewtonStepsRegen_BMS05 7 "SNA" ;
VAL_ 964 ppNewtonStepsDchg_BMS05 7 "SNA" ;
VAL_ 964 ppNewtonRegenVRes_BMS05 255 "SNA" ;
VAL_ 964 ppNewtonDchgVRes_BMS05 255 "SNA" ;
VAL_ 964 ppMinModelAlphaTarget_BMS05 255 "SNA" ;
VAL_ 964 ppMaxModelAlphaTarget_BMS05 255 "SNA" ;
VAL_ 964 ppLearningTauRegen_BMS05 65535 "SNA" ;
VAL_ 964 ppLearningCriterionDyn_BMS05 255 "SNA" ;
VAL_ 964 ppLearningCriterionAbs_BMS05 255 "SNA" ;
VAL_ 964 ppLearningCriterionJoin_BMS05 255 "SNA" ;
VAL_ 964 currentRedundant_BMS05 65535 "SNA" ;
VAL_ 964 currentModule3_BMS05 65535 "SNA" ;
VAL_ 964 currentModule2_BMS05 65535 "SNA" ;
VAL_ 964 currentModule1_BMS05 65535 "SNA" ;
VAL_ 964 ppMeanDchgIntRes_BMS05 65535 "SNA" ;
VAL_ 964 ppMinModelLowpassV_BMS05 65535 "SNA" ;
VAL_ 964 ppMaxModelVoltageIndex_BMS05 65535 "SNA" ;
VAL_ 964 ppMaxModelLowpassV_BMS05 65535 "SNA" ;
VAL_ 964 ppLearningTauDischarge_BMS05 65535 "SNA" ;
VAL_ 964 ppMaxRegenAlpha_BMS05 255 "SNA" ;
VAL_ 964 ppMaxModelledV_BMS05 65535 "SNA" ;
VAL_ 964 ppMinDchgAlpha_BMS05 255 "SNA" ;
VAL_ 964 ppMinModelledV_BMS05 65535 "SNA" ;
VAL_ 964 debugSlowMpex2_BMS05 0 "S00" 1 "S01" 2 "S02" 3 "S03" 4 "S04" 5 "S05" 6 "S06" 7 "S07" 8 "S08" 9 "S09" 10 "S10" 11 "S11" 12 "S12" 13 "S13" 14 "S14" 15 "S15" 16 "S16" 17 "S17" 18 "S18" 19 "S19" 20 "S20" 21 "S21" 22 "S22" 23 "S23" 24 "S24" 25 "S25" ;
VAL_ 964 ppRegenCurrPredShort_BMS05 65535 "SNA" ;
VAL_ 964 ppDischgCurrPredLong_BMS05 65535 "SNA" ;
VAL_ 964 ppDischgCurrPredShort_BMS05 65535 "SNA" ;
VAL_ 964 ppRegenCurrPredLong_BMS05 65535 "SNA" ;
VAL_ 964 ppRegenVPredShort_BMS05 65535 "SNA" ;
VAL_ 964 ppDischgVPredShort_BMS05 65535 "SNA" ;
VAL_ 964 ppRegenVPredLong_BMS05 65535 "SNA" ;
VAL_ 964 ppDischgVPredLong_BMS05 65535 "SNA" ;
VAL_ 964 SOHDeltaSOCCoulomb_BMS05 65535 "SNA" ;
VAL_ 964 SOHAbsDeltaSOCCoulomb_BMS05 65535 "SNA" ;
VAL_ 964 SOHLastOCVRecalMinSOC_BMS05 255 "SNA" ;
VAL_ 964 SOHbalancingTimeMinSOH_BMS05 255 "SNA" ;
VAL_ 1796 chargerDCOutV_BMS05 65535 "SNA" ;
VAL_ 1796 chargerProximity_BMS05 255 "SNA" ;
VAL_ 1796 chargerPilot_BMS05 255 "SNA" ;
VAL_ 1796 chargerCurrAvail_BMS05 255 "SNA" ;
VAL_ 1796 chargerCtrOn_BMS05 1 "TRUE" 0 "FALSE" ;
VAL_ 1796 chargerOn_BMS05 1 "TRUE" 0 "FALSE" ;
VAL_ 1796 debugFastMpex2_BMS05 0 "F00" 1 "F01" 2 "F02" 3 "F03" 4 "F04" 5 "F05" 6 "F06" 7 "F07" 8 "F08" 9 "F09" 10 "F10" 11 "F11" 12 "F12" 13 "F13" 14 "F14" 15 "F15" ;
VAL_ 1796 posPackDbg_BMS05 65535 "SNA" ;
VAL_ 1796 negPackDbg_BMS05 65535 "SNA" ;
VAL_ 1796 packVoltageHVMeas_BMS05 65535 "SNA" ;
